## drivers/mbox/Kconfig.xec
```kconfig
# Copyright 2025 Microchip Technology Inc.
# SPDX-License-Identifier: Apache-2.0

config MBOX_MICROCHIP_XEC_MAILBOX
	bool "Microchip XEC Mailbox driver"
	default y
	depends on DT_HAS_MICROCHIP_XEC_MAILBOX_ENABLED
	help
	  Driver for Microchip XEC family mailbox on eSPI bus.

if MBOX_MICROCHIP_XEC_MAILBOX

config MBOX_MICROCHIP_XEC_SEND_TIMEOUT_MS
	int "Timeout in milliseconds waitng for Host to acknowledge message"
	default 10
	help
	  Host acknowleges receipt of a message sent by EC by clearing to
	  EC-to-Host mailbox hardware register. Mailbox hardware does not
	  generate an interrupt when register is cleared. The driver must
	  poll until Host clears EC-to-Host.  A value of 0 disables polling
	  and the driver returns immediately.

endif # MBOX_MICROCHIP_XEC_MAILBOX
```

## drivers/mspi/Kconfig.mchp_xec
```kconfig
# Microchip XEC MSPI driver configuration
#
# Copyright (c) 2026 Microchip Technology Inc. and its subsidiaries.
# SPDX-License-Identifier: Apache-2.0

config MSPI_MCHP_XEC_GPSPI_V2
	bool "Microchip MEC175x GPSPI MSPI driver"
	default y
	depends on DT_HAS_MICROCHIP_XEC_GPSPI_V2_MSPI_CONTROLLER_ENABLED
	select PINCTRL
	select PINCTRL_KEEP_SLEEP_STATE
	help
	  Enable the Zephyr MSPI master driver for the Microchip MEC175x
	  GPSPI block (compatible "microchip,xec-gpspi-v2").

	  Features:
	    - Standard (1-bit) and Dual (2-bit) wire modes
	    - All four CPOL/CPHA combinations (mspi_cpp_mode 0..3)
	    - 16-bit clock divider (up to clock_frequency / 2 bit-rate)
	    - Hardware chip-enable on CE0 / CE1 with programmable
	      CS_TIMING (assert / deassert / inter-frame gap)
	    - Synchronous and asynchronous transceive on both
	      MSPI_PIO and MSPI_DMA paths

	  Returns -ENOTSUP for: DDR data rate, Quad / split-line io_modes,
	  active-high CE, big-endian transfers, dqs_enable, op_mode
	  peripheral, and per-packet total > 0x7FFF bytes
	  (CONTROL.XFR_LENGTH limit).
```

## drivers/mspi/Kconfig.xec
```kconfig
# Copyright (c) 2025 Microchip Technology Inc.
# SPDX-License-Identifier: Apache-2.0

config MSPI_XEC_QMSPI_LDMA
	bool "Microchip QMSPI-LDMA controller used as MSPI"
	default y
	depends on DT_HAS_MICROCHIP_XEC_MSPI_LDMA_ENABLED
	select PINCTRL
	imply MSPI_TIMING

if MSPI_XEC_QMSPI_LDMA

config MSPI_XEC_QMSPI_LDMA_MAX_FREQ
	int "MCHP XEC MSPI max frequency"
	default 960000000 if SOC_SERIES_MEC175X
	default 960000000 if SOC_SERIES_MEC174X
	default 960000000 if SOC_SERIES_MEC172X
	default 960000000 if SOC_SERIES_MEC165XB
	default 480000000 if SOC_SERIES_MEC15XX
	default 480000000

config MSPI_XEC_QMSPI_LDMA_MAX_SPI_DEVICES
	int "MCHP XEC maximum number of SPI devices"
	default 2
	help
	  Microchip MEC QSPI controller implements two
	  hardware controlled chip selects. GPIO chip
	  selects may also be used. This value specifies
	  the number of devices connected to the controller.
	  The driver must instantiate a MSPI device structure
	  for each device connected to the controller. If GPIO
	  pins are need for additional chip selects this value
	  should be adjusted.

endif # MSPI_XEC_QMSPI_LDMA
```

## drivers/pinctrl/Kconfig.xec
```kconfig
# Copyright (c) 2021 Microchip Technology Inc.
# SPDX-License-Identifier: Apache-2.0

config PINCTRL_MCHP_XEC
	bool "Pin controller driver for MCHP XEC MCUs"
	depends on SOC_SERIES_MEC172X
	default y
	help
	  Enable pin controller driver for Microchip XEC MCUs
```

## drivers/ps2/Kconfig.mec5
```kconfig
# Microchip MEC5 HAL PS2 configuration options

# Copyright (c) Microchip Technology Inc.
# SPDX-License-Identifier: Apache-2.0

config PS2_MCHP_MEC5
	bool "Microchip MEC5 HAL based PS2 target interface driver"
	default y
	depends on DT_HAS_MICROCHIP_MEC5_PS2_ENABLED
	select PINCTRL
	help
	  Enable the Microchip MEC5 PS/2 target interface.
```

## drivers/rtc/Kconfig.mchp_xec
```kconfig
# Microchip XEC PWM configuration options

# Copyright (c) 2019 Intel Corporation
# SPDX-License-Identifier: Apache-2.0

config RTC_XEC
	bool "Microchip XEC RTC"
	default y
	depends on DT_HAS_MICROCHIP_XEC_RTC_ENABLED
	help
		Enable driver to utilize RTC on the Microchip XEC IP block

config RTC_DATA_MODE_BCD
	bool "Select data mode"
	default y
	depends on DT_HAS_MICROCHIP_XEC_RTC_ENABLED
	help
		Select binary or BCD representation of time

config RTC_HOUR_FORMAT_24
	bool "Select hour format"
	default y
	depends on DT_HAS_MICROCHIP_XEC_RTC_ENABLED
	help
		Select hour format 24/12 representation of time

#VAL 	INTERRUPT PERIOD
#0x00	Never Triggered
#0x01	3.90625 ms
#0x02	7.8125 ms
#0x03	122.070 us
#0x04	244.141 us
#0x05	488.281 us
#0x06	976.5625 us
#0x07	1.953125 ms
#0x08	3.90625 ms
#0x09	7.8125 ms
#0x0A	15.625 ms
#0x0B	31.25 ms
#0x0C	62.5 ms
#0x0D	125 ms
#0x0E	250 ms
#0x0F	500 ms

config RTC_PERIODIC_ALARM_RATE_SEL
	hex "Periodic alarm rate"
	default 0x0F
	depends on DT_HAS_MICROCHIP_XEC_RTC_ENABLED
	help
		Select RTC periodic alarm rate
```

## drivers/timer/Kconfig.mchp_xec
```kconfig
# Copyright (c) 2026 Microchip Technology Inc.
#
# SPDX-License-Identifier: Apache-2.0

config MCHP_XEC_CCT_KTIMER
	bool "Microchip XEC Capture Compare timer as kernel timer"
	default y
	depends on DT_HAS_MICROCHIP_XEC_CCT_KTIMER_ENABLED && !MCHP_XEC_RTOS_TIMER
	select TICKLESS_CAPABLE
	select SYSTEM_TIMER_HAS_DISABLE_SUPPORT
	# Advertise LPM-companion capability; the actual mode (HOOKS) is chosen as a
	# default of the SYSTEM_TIMER_LPM_COMPANION choice (select cannot target a
	# choice symbol). See drivers/timer/Kconfig.system_timer_lpm.
	select SYSTEM_TIMER_HAS_LPM_COMPANION_SUPPORT
	help
	  Kernel device driver for system tick with tickless capability.
	  The capture compare timer uses a 48MHz input clock with a power of 2
	  clock divider register dividing by 1 through 128. (48MHz through 375 KHz).
	  The device has a 32-bit free run auto-wrapping counter at the selected frequency,
	  two 32-bit compare registers, and 6 32-bit capture registers. Each compare register
	  can generate a separate interrupt when the free counter matches the value in the
	  compare register. CCT requires the SoC PLL enabled. For sleep modes where the PLL
	  is turn off, this driver implements the system timer LPM companion hooks called by
	  the SoC PM code.
```

## drivers/watchdog/Kconfig.mec5
```kconfig
# Microchip MEC5 HAL based Watchdog Timer configuration

# Copyright (c) 2024 Microchip Technology Inc.
# SPDX-License-Identifier: Apache-2.0

config WDT_MCHP_MEC5
	bool "Microchip MEC5 SoC series Watchdog Timer (WDT) driver"
	default y
	depends on DT_HAS_MICROCHIP_MEC5_WATCHDOG_ENABLED
	select HAS_WDT_DISABLE_AT_BOOT
	help
	  Enable WDT driver for Microchip MEC5 HAL based SoC series.
```

## drivers/watchdog/Kconfig.xec
```kconfig
# Microchip XEC Watchdog Timer configuration

# Copyright (c) 2019 Intel Corporation
# SPDX-License-Identifier: Apache-2.0

config WDT_XEC
	bool "Microchip XEC series Watchdog Timer (WDT) driver"
	depends on SOC_FAMILY_MEC
	default y
	help
	  Enable WDT driver for Microchip XEC MCU series.

config WDT_XEC_DELAY_CYCLES
	int "Number of delay cycles before generating watchdog event/signal"
	depends on WDT_XEC
	range 1 255
	default 10
	help
	  This option defines the window in which a watchdog event must be
	  handled, in units of 31ms. After this time window, the watchdog reset
	  triggers immediately.
```

## dts/bindings/adc/microchip,xec-adc.yaml
```yaml
# Copyright (c) 2019, Intel Corporation
# SPDX-License-Identifier: Apache-2.0

description: Microchip XEC ADC

compatible: "microchip,xec-adc"

include: [adc-controller.yaml, pinctrl-device.yaml]

properties:
    reg:
      required: true

    interrupts:
      required: true

    "#io-channel-cells":
      const: 1

    pinctrl-0:
      required: false

    pinctrl-names:
      required: false

    clktime:
      type: int
      required: true
      description: ADC clock high & low time count value <1:255>

    girqs:
      type: array
      required: true
      description: Array of pairs of GIRQ number and bit position

    pcrs:
      type: array
      required: true
      description: ADC PCR register index and bit position

    "#girq-cells":
      type: int
      const: 2

    "#pcr-cells":
      type: int
      const: 2

io-channel-cells:
    - input

girq-cells:
    - girqnum
    - bitpos

pcr-cells:
    - regidx
    - bitpos
```

## dts/bindings/counter/microchip,xec-counter-btmr.yaml
```yaml
# Copyright (c) 2025 Microchip Technology Inc.
# SPDX-License-Identifier: Apache-2.0

description: Microchip XEC counter driver using two basic timers

compatible: "microchip,xec-counter-btmr"

include: ["base.yaml", "microchip,dmec-ecia-girq.yaml"]

properties:
  reg:
    required: true

  interrupts:
    required: true

  clock-frequency:
    type: int
    required: true
    const: 48000000
    description: |
      XEC basic timers input frequency is 48 MHz. Counter rate is
      scaled down using a prescaler.

  prescaler:
    type: int
    required: true
    description: |
      XEC basic timers implement a 16-bit prescaler used to derive
      the counter frequency.
      Count frequency = clock_freq / (prescaler + 1)

  alarm-timer:
    type: phandle
    required: true
    description: |
      A handle to another basic timer hardware node for use as
      the alarm timer in the counter driver. This node does
      not need a driver only a binding describing its properties.

  max-value:
    type: int
    description: |
      Maximum counter value. XEC basic timers are implemented with
      either a 16 or 32 bit counter.
```

## dts/bindings/dma/microchip,xec-dmac.yaml
```yaml
# Copyright 2025 Microchip Technology Inc.
# SPDX-License-Identifier: Apache-2.0

description: Microchip XEC DMA controller

compatible: "microchip,xec-dmac"

include: dma-controller.yaml

properties:
  reg:
    required: true

  interrupts:
    required: true

  pcr:
    type: int
    required: true
    description: PCR register index and bit position

  girqs:
    type: array
    required: true
    description: Encoded interrupt information

  "#dma-cells":
    const: 2

# #dma-cells : Must be <2>.
# The 1st cell specifies the DMAC channel to be used for the data transfer.
#   This channel should be unique between all peripherals that are using the
#   DMAC instance.
# The 2nd cell defines the peripheral trigger which is the source of the transfer.
#   For details on trigger selection and trigger modes, refer to
#   "Transfer Triggers and Actions".
#   See the SoC's reference manual for all the supported request sources.
#
# Example of devicetree dma channel configuration:
#
# &sercom3 {
#     /* Configure DMA channels for async operation */
#     dmas = <&dmac 10 7>, <&dmac 11 8>;
#     dma-names = "rx", "tx";
# };
#
# In above fragment 10 and 11 represents the different channels used to
# transfer data between peripheral and ram. The numbers 7/8 are, for instance,
# uart_rx/tx peripheral trigger for sercom3.
dma-cells:
  - channel
  - trigsrc
```

## dts/bindings/espi/microchip,mec5-espi-mailbox.yaml
```yaml
# Copyright (c) 2024 Microchip Technology Inc.
# SPDX-License-Identifier: Apache-2.0

description: Microchip MEC5 eSPI Mailbox host facing device

compatible: "microchip,mec5-espi-mailbox"

include: [base.yaml]

properties:
  reg:
    description: mmio register space
    required: true

  interrupts:
    required: true
    description: Interrupt number and priority for Mailbox interrupt.

  espi-parent:
    type: phandle
    required: true
    description: Handle to eSPI parent controller node

  host-infos:
    type: phandles
    description: |
      Handles to the two logical device nodes containing host
      properties: logical device number, host address, etc.
```

## dts/bindings/espi/microchip,mec5-espi-pc-acpi_ec.yaml
```yaml
# Copyright (c) 2025 Microchip Technology Inc.
# SPDX-License-Identifier: Apache-2.0

description: |
  Microchip MEC5 eSPI Peripheral Channel ACPI embedded controller.

compatible: "microchip,mec5-espi-pc-acpi_ec"

include: ["microchip,mec5-espi-pc-common.yaml"]

properties:
  four-byte-data-mode:
    type: boolean
    description: |
      Enable support of four byte data mode. In four byte mode the
      data register is four bytes and status is set when the host
      write byte lane 3 of the data register.
```

## dts/bindings/espi/microchip,mec5-espi-pc-bdp.yaml
```yaml
# Copyright (c) 2025 Microchip Technology Inc.
# SPDX-License-Identifier: Apache-2.0

description: |
  Microchip MEC5 eSPI Peripheral Channel BIOS I/O port capture device.

compatible: "microchip,mec5-espi-pc-bdp"

include: ["microchip,mec5-espi-pc-common.yaml"]

properties:
  fifo-threshold:
    type: string
    description: |
      BDP will generate an interrupt to the EC when the number of
      Host I/O writes to the capture range is equal to or greater
      than this value.
    enum:
      - "1"
      - "4"
      - "8"
      - "16"
      - "20"
      - "24"
      - "28"
      - "30"

  alias-byte-lane:
    type: int
    description: |
      Store the byte captured on the alias I/O port into the specified
      byte lane [0 - 3].
```

## dts/bindings/espi/microchip,mec5-espi-pc-common.yaml
```yaml
# Copyright (c) 2025 Microchip Technology Inc.
# SPDX-License-Identifier: Apache-2.0

description: |
  Microchip MEC5 eSPI Peripheral Channel device common properties

include: ["base.yaml", "microchip,dmec-ecia-girq.yaml"]

on-bus: espi

properties:
  reg:
    required: true

  interrupts:
    required: true

  hostinfos:
    type: phandles
    required: true
    description:
      Handles to one or more nodes from the mchp-mec5-esp-pc-host-dev table.
```

## dts/bindings/espi/microchip,mec5-espi-pc-device.yaml
```yaml
# Copyright (c) 2024 Microchip Technology Inc.
# SPDX-License-Identifier: Apache-2.0

description: Microchip MEC5 eSPI Host Logical Devices

compatible: "microchip,mec5-espi-pc-device"

include: [base.yaml]

child-binding:
  description: |
    Child node containing eSPI Peripheral Channel device Host properties
  properties:
    ldn:
      type: int
      required: true
      description: Host device logical device number.

    host-address:
      type: int
      required: true
      description: |
        Host address the logical device appears at. On x86 systems this
        address may be I/O or memory space. Address values are interpreted
        as: 0 = disabled, [1, 0xffff] I/O space, [0x10000, UINT32_MAX]
        memory space.

    sirqs:
      type: array
      description: |
        Host Serial IRQ numbers assigned to this device. Each entry is
        a hardware slot index and slot value. A slot value of 255
        disables SIRQ genaration. Refer to SoC data sheet eSPI Seria-IRQ
        assignment table.

        Example: KBC implements two Serial IRQ slots and indices 2 and 3.
                 We map them to Serial-IRQ slots 1 and 12.
          sirqs = <2 1 3 12>;
        Example: UART0 implements one Serial IRQ slot at hardware index 9.
          sirqs = <9 3>;

    sirq-names:
      type: string-array
      description: |
        Names for the provided Serial IRQs. The number of names needs to match the
        number of sirqs.

    "#sirq-cells":
      type: int
      const: 1
```

## dts/bindings/espi/microchip,mec5-espi-pc-emi.yaml
```yaml
# Copyright (c) 2025 Microchip Technology Inc.
# SPDX-License-Identifier: Apache-2.0

description: |
  Microchip MEC5 eSPI Peripheral Channel EMI.
  Embedded memory interface provides a mechanism for the host
  to access EC memory.

compatible: "microchip,mec5-espi-pc-emi"

include: ["microchip,mec5-espi-pc-common.yaml"]

properties:
  app-id:
    type: int
    required: true
    description: |
      An 8-bit application ID value passed via callbacks. The application
      can identify the peripheral channel device making the callback.
```
