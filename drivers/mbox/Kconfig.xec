## dts/bindings/espi/microchip,mec5-espi-pc-kbc.yaml
```yaml
# Copyright (c) 2025 Microchip Technology Inc.
# SPDX-License-Identifier: Apache-2.0

description: |
  Microchip MEC5 eSPI Peripheral Channel 8042 keyboard controller
  with Port 92h fast keyboard support.

compatible: "microchip,mec5-espi-pc-kbc"

include: ["microchip,mec5-espi-pc-common.yaml"]

properties:
  port92-enable:
    type: boolean
    description: Enable fast keyboard Gate A20 hardware support
```

## dts/bindings/espi/microchip,mec5-espi-pc-mbox.yaml
```yaml
# Copyright (c) 2025 Microchip Technology Inc.
# SPDX-License-Identifier: Apache-2.0

description: |
  Microchip MEC5 eSPI Peripheral Channel Mailbox

compatible: "microchip,mec5-espi-pc-mbox"

include: ["microchip,mec5-espi-pc-common.yaml"]
```

## dts/bindings/espi/microchip,mec5-espi-pc-uart.yaml
```yaml
# Copyright (c) 2025 Microchip Technology Inc.
# SPDX-License-Identifier: Apache-2.0

description: |
  Microchip MEC5 eSPI Peripheral Channel UART.
  The 16550 compatible UART registers are mapped to
  eSPI host I/O address space.

compatible: "microchip,mec5-espi-pc-uart"

include: ["microchip,mec5-espi-pc-common.yaml"]
```

## dts/bindings/espi/microchip,mec5-espi-shm-emi.yaml
```yaml
# Copyright (c) 2024 Microchip Technology Inc.
# SPDX-License-Identifier: Apache-2.0

description: |
  Microchip MEC5 eSPI EMI host facing device

compatible: "microchip,mec5-espi-shm-emi"

include: [base.yaml]

properties:
  reg:
    description: mmio register space
    required: true

  interrupts:
    required: true
    description: Interrupt number and priority for EMI interrupt.

  espi-parent:
    type: phandle
    required: true
    description: Handle to eSPI parent controller node

  host-infos:
    type: phandles
    description: |
      Handles to the two logical device nodes containing host
      properties: logical device number, host address, etc.
```

## dts/bindings/espi/microchip,mec5-espi-taf-flash.yaml
```yaml
# Copyright (c) 2024 Microchip Technology Inc.
# SPDX-License-Identifier: Apache-2.0

description: Microchip MEC5 HAL based ESPI TAF flash device

compatible: "microchip,mec5-espi-taf-flash"

child-binding:
  description: |
    Child node describing a SPI flash device attached to one
    of the two chip selects of the QSPI controller used by
    eSPI TAF.

properties:
  version:
    type: int
    description: TAF flash configuration version

  chip-select:
    type: int
    description: |
      QSPI chip select this flash is attached to. Two chip
      selects are support (0 and 1).

  flash-size:
    type: int
    description: SPI flash size in bytes.

  spi-freq-mhz:
    type: int
    description: |
      SPI frequency in megahertz for all SPI commands except read data.

  spi-read-data-freq-mhz:
    type: int
    description: SPI frequency to use for flash read data.

  four-byte-addressing:
    type: boolean
    description: |
      Flash supports 4-byte addressing mode. NOTE: application is
      expected to enable 4-byte address mode in the flash before
      TAF is activated.

  opcode-write-enable:
    type: int
    description: 8-bit opcode for flash write enable.

  opcode-suspend:
    type: int
    description: 8-bit opcode for flash suspend.

  opcode-resume:
    type: int
    description: 8-bit opcode for flash resume from suspend.

  opcode-poll1:
    type: int
    description: 8-bit opcode for flash read status register.

  opcode-erase4k:
    type: int
    description: 8-bit opcode for flash 4KB sector erase.

  opcode-erase32k:
    type: int
    description: 8-bit opcode for flash 32KB erase.

  opcode-erase64k:
    type: int
    description: 8-bit opcode for flash 64KB erase.

  opcode-page-program:
    type: int
    description: 8-bit opcode for flash page program.

  opcode-read-data:
    type: int
    description: |
      8-bit opcode for reading data in quad or dual
      I/O mode. A continuous mode command may be
      used here.

  opcode-mode-cont:
    type: int
    description: |
      Optional 8-bit command used to put or keep the flash
      device in continuous mode.

  opcode-poll2:
    type: int
    description: |
      Optional 8-bit command used to confirm a flash device
      is in suspend state.

  opcode-enter-pd:
    type: int
    description: 8-bit command for the flash to enter power down state.

  opcode-exit-pd:
    type: int
    description: 8-bit command for the flash to exit power down state.

  poll2-mask:
    type: int
    description: |
      A 16-bit mask value for ignoring bits returned by the flash in
      response to the TAF flash poll2 command.

  continuous-prefix-required:
    type: boolean
    description: |
      Flash device requires transmission of a prefix byte
      before transmitting the enter continous mode entry
      or data read commands.

  continuous-mode-entry-prefix:
    type: int
    description: |
      Prefix byte transmitted before CM entry command if continous
      prefix required is true.

  continuous-mode-data-prefix:
    type: int
    description:
      Prefix byte transmitted before CM data read command if continous
      prefix required is true.

  rpmc-op1:
    type: int
    description: |
      RPMC OP1 command opcode for flash devices containing RPMC hardware.
      This opcode is optional and only require if RPMC flash devices
      are used and the application wants to use the RPMC hardware
      feature.

  rpmc-op2:
    type: int
    description: |
      RPMC OP2 command opcode for flash device containing RPMC hardware.

  rpmc-nc:
    type: int
    description: |
      Number of RPMC hardware counters in the flash device.
      Currently 1 to 16 counters are supported by the eSPI
      TAF specification.

  qspi_descriptors:
    type: array
    description: |
      QSPI requires 16 32-bit descriptors describing the
      SPI commands TAF uses to communicate with the flash
      device(s). Refer to Microchip eSPI data sheets for
      determining the descriptor values. NOTE: values
      do depend upon the specific flash devices.

        DESCR[0:2] flash at CS0 continuous mode read.
        DESCR[3:5] flash at CS0 enter continous mode.
        DESCR[6:8] flash at CS1 continuous mode read.
        DESCR[9:11] flash at CS1 enter continous mode.
        DESCR[12:13] exit from continous mode for both flashes.
        DESCR[14:15] flash read status command.
```

## dts/bindings/espi/microchip,mec5-espi-taf.yaml
```yaml
# Copyright (c) 2024 Microchip Technology Inc.
# SPDX-License-Identifier: Apache-2.0

description: Microchip MEC5 HAL based ESPI TAF controller

compatible: "microchip,mec5-espi-taf"

include: espi-controller.yaml

properties:
  reg:
    description: mmio register space
    required: true

  version:
    type: int
    description: TAF configuration version

  flash-at-cs0:
    type: boolean
    description: |
      Indicates a flash device is connected to QSPI chip select 0.

  flash-at-cs1:
    type: boolean
    description: |
      Indicates a flash device is connected to QSPI chip select 1

  poll-timeout:
    type: int
    description: |
      Total time for polling flash busy timeout in micro-seconds.
      Hardware counter is 32KHz based therefore this value should be a multiple
      of 30.5 us. Recommended value is 5000000 us (5 seconds).

  poll-interval:
    type: int
    description: |
      Interval between flash busy poll in nano-seconds. Hardware counter is 48MHz
      therefore this value should be a multiple of 21 ns. Recommended value is 0
      meaning issue Poll-1 SPI commands as quickly as possible.

  consec-rd-timeout:
    type: int
    description: |
      Timeout in nano-seconds after the last read request. When this timeout expires
      any suspended erase or program operation will be resumed. Hardware counter is
      48MHz (20.8 ns). If this value is set it is suggested the value be <= 20,000 ns.

  sus-chk-delay:
    type: int
    description: |
      If the flash has been suspended delay this amount in nano-seconds before issueing
      a Poll-1 status command. Hardware delay is based on the 48MHz clock therefore this
      value should be a multiple of 21 ns. Recommended value is 20,000 ns.

  sus-rsm-interval:
    type: int
    description: |
      Timeout in microseconds to suspend or resume an in-progress erase or program operation.
      Hardware uses a 32KHz timer therefore the value should be a multiple of 32 us. The default
      value is 32 us.

  power_down_timeout:
    type: int
    description: |
      TAF will send power down command to flash device(s) after
      inactivity.

  power_down_min_interval:
    type: int
    description: |
      Minimum time interval between consecutive power down
      commands to the flash device(s).

  qspi_freq_mhz:
    type: int
    description: |
      Frequency in MHz for QSPI controller TAF uses. Not present or 0 defaults
      to using the currently configured QSPI controller frequency.

  qspi_cpol:
    type: int
    description: QSPI clock state while idle (0 = low, 1 = high).

  qspi_cpha_sdi:
    type: int
    description: |
      QSPI output data change clock phase. 0 means data changes on
      the second clock edge whereas 1 means data changes on the
      first clock edge of each clock pulse.

  qspi_cpha_sdo:
    type: int
    description: |
      QSPI data capture clock phase. 0 means data is captured on
      the first clock edge whereas 1 means data is captured on the
      second clock edge of each clock pulse.

  qspi_taps_sel:
    type: int
    description: QSPI tuning taps

  qspi_cs_timing:
    type: int
    description: QSPI chip select timing adjustment

  qspi_descriptors:
    type: array
    description: |
      QSPI requires 16 32-bit descriptors describing the
      SPI commands TAF uses to communicate with the flash
      device(s). Refer to Microchip eSPI data sheets for
      determining the descriptor values. NOTE: values
      do depend upon the specific flash devices.

        DESCR[0:2] flash at CS0 continuous mode read.
        DESCR[3:5] flash at CS0 enter continous mode.
        DESCR[6:8] flash at CS1 continuous mode read.
        DESCR[9:11] flash at CS1 enter continous mode.
        DESCR[12:13] exit from continous mode for both flashes.
        DESCR[14:15] flash read status command.
```

## dts/bindings/espi/microchip,xec-espi-ng-pc-acpi_ec.yaml
```yaml
# Copyright (c) 2025 Microchip Technology Inc.
# SPDX-License-Identifier: Apache-2.0

description: |
  Microchip XEC eSPI next gen Peripheral Channel ACPI embedded controller.

compatible: "microchip,xec-espi-ng-pc-acpi_ec"

include: ["microchip,mec5-espi-pc-common.yaml"]

properties:
  app-id:
    type: int
    required: true
    description: |
      An 8-bit application ID value passed via callbacks. The application
      can identify the peripheral channel device making the callback.

  four-byte-data-mode:
    type: boolean
    description: |
      Enable support of four byte data mode. In four byte mode the
      data register is four bytes and status is set when the host
      write byte lane 3 of the data register.
```
