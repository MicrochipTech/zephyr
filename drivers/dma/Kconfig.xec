## drivers/dma/Kconfig.xec
```kconfig
# Microchip XEC DMAC configuration options

# Copyright (c) 2023 Microchip Technology Inc.
# SPDX-License-Identifier: Apache-2.0

config DMA_MCHP_XEC
	bool "Microchip XEC series DMAC driver"
	default y
	depends on DT_HAS_MICROCHIP_XEC_DMAC_ENABLED
	help
	  DMA driver for Microchip XEC series MCUs.

if DMA_MCHP_XEC

XEC_DMA_NODE_PATH := $(dt_nodelabel_path,dmac)
XEC_DMA_MAX_CHANS := $(dt_node_int_prop_int,$(XEC_DMA_NODE_PATH),dma-channels)

config DMA_MCHP_XEC_DMAC_MAX_CHANNELS
	int "Microchip XEC central DMA maximum channels"
	default $(XEC_DMA_MAX_CHANS)
	help
	  The number of channels this instance of the DMAC
	  controller supports.

config DMA_MCHP_XEC_MAX_BLOCKS_PER_CHAN
	int "Maximum DMA blocks per channel"
	default 1
	range 1 16
	help
	  Maximum number of dma_block_config entries the driver will cache
	  from a multi-block dma_config call. The XEC central DMA hardware
	  programs one block at a time; the driver chains the remaining
	  blocks in its ISR by ABORTing the channel, rewriting the address
	  registers from the cached block, and re-issuing RUN.

	  Set to 1 (the default) to preserve single-block behavior bit-for-bit
	  and the lowest RAM footprint. Increase when a peripheral driver
	  needs scatter or cyclic (ping-pong) transfers on one transaction.

endif # DMA_MCHP_XEC
```

## drivers/espi/Kconfig.xec
```kconfig
# Microchip XEC ESPI configuration options

# Copyright (c) 2019 Intel Corporation
# SPDX-License-Identifier: Apache-2.0

config ESPI_XEC
	bool "XEC Microchip ESPI driver"
	default y
	depends on DT_HAS_MICROCHIP_XEC_ESPI_ENABLED && SOC_SERIES_MEC15XX
	select PINCTRL
	help
	  Enable the Microchip XEC ESPI driver for MEC15xx family.

config ESPI_XEC_V2
	bool "XEC Microchip ESPI V2 driver"
	default y
	depends on DT_HAS_MICROCHIP_XEC_ESPI_V2_ENABLED && !SOC_SERIES_MEC15XX
	select PINCTRL
	help
	  Enable the Microchip XEC ESPI driver for MEC172x/4x/5x series.

config ESPI_XEC_V3
	bool "XEC Microchip eSPI V3 driver"
	default y
	depends on DT_HAS_MICROCHIP_XEC_ESPI_V3_ENABLED && !SOC_SERIES_MEC15XX
	depends on !ESPI_XEC_V2
	select PINCTRL
	help
	  Enable the Microchip XEC eSPI V3 driver for MEC172x/4x/5x series.
	  Unlike the V2 driver the peripheral (logical) channel devices are not
	  implemented by this driver. Each one is a separate Zephyr driver bound
	  to its own devicetree child node. This driver keeps ownership of the
	  Host I/O BAR, Memory BAR and Serial IRQ registers, which MEC hardware
	  holds in reset while ESPI_RESET or PLTRST is asserted, and notifies the
	  peripheral drivers when that hardware becomes usable.

if ESPI_XEC || ESPI_XEC_V2 || ESPI_XEC_V3

config ESPI_OOB_CHANNEL
	default y

config ESPI_FLASH_CHANNEL
	default y

config ESPI_PERIPHERAL_HOST_IO
	default  y

config ESPI_PERIPHERAL_HOST_IO_PVT
	default  y

config ESPI_PERIPHERAL_DEBUG_PORT_80
	default y

config ESPI_PERIPHERAL_UART
	default y

config ESPI_PERIPHERAL_UART_SOC_MAPPING
	int "SoC port exposed as logical eSPI UART"
	default 2 if SOC_SERIES_MEC15XX
	default 1 if !SOC_SERIES_MEC15XX
	depends on ESPI_PERIPHERAL_UART
	help
	  This tells the driver to which SoC UART to direct the UART traffic
	  send over eSPI from host.

config ESPI_OOB_BUFFER_SIZE
	int "eSPI OOB channel buffer size in bytes"
	default 128
	depends on ESPI_OOB_CHANNEL
	help
	  Use minimum RAM buffer size by default but allow applications to
	  override the value.
	  Maximum OOB payload is 73 bytes.

config ESPI_FLASH_BUFFER_SIZE
	int "eSPI Flash channel buffer size in bytes"
	default 256
	depends on ESPI_FLASH_CHANNEL
	help
	  Use maximum RAM buffer size defined by spec but allow applications
	  to override if eSPI host doesn't support it.

config ESPI_TAF_XEC
	bool "XEC Microchip ESPI TAF driver"
	default y
	depends on SOC_SERIES_MEC15XX
	depends on DT_HAS_MICROCHIP_XEC_ESPI_SAF_ENABLED
	help
	  Enable the Microchip XEC TAF ESPI driver for MEC15xx family.

if SOC_SERIES_MEC172X || SOC_SERIES_MEC174X || SOC_SERIES_MEC175X || SOC_SERIES_MEC165XB
config ESPI_TAF_XEC_V2
	bool "XEC Microchip ESPI TAF V2 driver"
	default y
	depends on DT_HAS_MICROCHIP_XEC_ESPI_SAF_V2_ENABLED
	help
	  Enable the Microchip XEC TAF ESPI driver for MEC172x series.
endif #SOC_SERIES_MEC172X || SOC_SERIES_MEC174X || SOC_SERIES_MEC175X || SOC_SERIES_MEC165XB

endif # ESPI_XEC || ESPI_XEC_V2 || ESPI_XEC_V3

if ESPI_XEC_V2

config ESPI_XEC_PERIPHERAL_ACPI_SHD_MEM_SIZE
	int "Host I/O peripheral port size for shared memory in MEC172X series"
	depends on ESPI_XEC_V2 || ESPI_PERIPHERAL_ACPI_SHM_REGION
	default 256
	help
	  This is the port size used by the Host and EC to communicate over
	  the shared memory region to return the ACPI response data.

config ESPI_XEC_PERIPHERAL_HOST_CMD_PARAM_SIZE
	int "Host I/O peripheral port size for ec host command in MEC172X series"
	depends on ESPI_XEC_V2 || ESPI_PERIPHERAL_EC_HOST_CMD
	default 256
	help
	  This is the port size used by the Host and EC to communicate over
	  the shared memory region to return the host command parameter data.

config ESPI_PERIPHERAL_8042_KBC
	default y

config ESPI_XEC_P80_MULTIBYTE
	bool "Host can write 1/2/4 bytes of Port80 data in a eSPI transaction"
	depends on ESPI_XEC_V2 && ESPI_PERIPHERAL_DEBUG_PORT_80
	help
	  EC can accept 1/2/4 bytes of Port 80 data written from the Host in an
	  eSPI transaction.

if ESPI_PERIPHERAL_CHANNEL

config ESPI_PERIPHERAL_XEC_MAILBOX
	bool "SoC Mailbox over eSPI"
	help
	  Enable a 32 byte mailbox interface accessible via Host I/O over the
	  ESPI Peripheral Channel.

if ESPI_PERIPHERAL_XEC_MAILBOX

config ESPI_PERIPHERAL_XEC_MAILBOX_PORT_NUM
	hex "Host I/O peripheral port for the XEC Mailbox"
	default 0x0360
	help
	  Host I/O port the XEC Mailbox BAR is mapped to. Make sure the value
	  does not clash with other Host I/O peripherals.

config ESPI_PERIPHERAL_XEC_MAILBOX_SIRQ_SLOT
	int "XEC Mailbox peripheral Serial-IRQ slot number"
	default 255
	range 0 255
	help
	  Serial-IRQ slot number for a non-SMI interrupt to the Host.
	  Range is 0 - 255 where 255 is disabled.

config ESPI_PERIPHERAL_XEC_MAILBOX_SMI_SIRQ_SLOT
	int "XEC Mailbox peripheral SMI Serial-IRQ slot number"
	default 255
	range 0 255
	help
	  Serial-IRQ slot number for a SMI interrupt to the Host.
	  Range is 0 - 255 where 255 is disabled.

endif # ESPI_PERIPHERAL_XEC_MAILBOX

config ESPI_PERIPHERAL_XEC_ACPI_EC2
	bool "SoC ACPI EC 2 over eSPI"
	help
	  Enable ACPI EC2 interface accessible via Host I/O over the
	  ESPI Peripheral Channel.

config ESPI_PERIPHERAL_XEC_ACPI_EC3
	bool "SoC ACPI EC 3 over eSPI"
	help
	  Enable ACPI EC3 interface accessible via Host I/O over the
	  ESPI Peripheral Channel.

config ESPI_PERIPHERAL_XEC_ACPI_EC4
	bool "SoC ACPI EC 4 over eSPI"
	help
	  Enable ACPI EC4 interface accessible via Host I/O over the
	  ESPI Peripheral Channel.

config ESPI_PERIPHERAL_XEC_ACPI_PM1
	bool "SoC ACPI PM1 over eSPI"
	help
	  Enable ACPI PM1 interface accessible via Host I/O over the
	  ESPI Peripheral Channel.

config ESPI_PERIPHERAL_XEC_EMI0
	bool "SoC EMI 0 over eSPI"
	help
	  Enable EMI 0 interface accessible via Host I/O over the
	  ESPI Peripheral Channel.

config ESPI_PERIPHERAL_XEC_EMI1
	bool "SoC EMI 1 over eSPI"
	help
	  Enable EMI 1 interface accessible via Host I/O over the
	  ESPI Peripheral Channel.

config ESPI_PERIPHERAL_XEC_EMI2
	bool "SoC EMI 2 over eSPI"
	help
	  Enable EMI 2 interface accessible via Host I/O over the
	  ESPI Peripheral Channel.

config ESPI_PERIPHERAL_8042_FAST_KBC_PORT92
	bool "8042 keyboard fast alternate GATE A20 support at Host I/O 92h"
	help
	  The 8042 Keyboard support of fast, alternate GATE A20 control
	  using I/O port 92h.

endif #ESPI_PERIPHERAL_CHANNEL

config ESPI_PERIPHERAL_ACPI_EC_IBF_EVT_DATA
	bool "Read ACPI EC Event Data in IBF ISR"
	depends on ESPI_PERIPHERAL_CHANNEL
	help
	  Enable reading event data in ACPI EC IBF ISR. This is used in OS
	  environment where application expects IBF ISR to read data and pass
	  to callback.

endif #ESPI_XEC_V2

if ESPI_XEC_V2 && ESPI_PERIPHERAL_8042_KBC

config ESPI_PERIPHERAL_KBC_IBF_EVT_DATA
	bool "KBC event data format in IBF"
	help
	  Enable espi_evt_data_kbc format for encoding event in KBC IBF ISR

config ESPI_PERIPHERAL_KBC_OBE_CBK
	bool "KBC OBE Callback"
	help
	  Enable KBC OBE callback from OBE ISR

endif #ESPI_XEC_V2 && ESPI_PERIPHERAL_8042_KBC

if ESPI_XEC_V3

config ESPI_XEC_V3_PC_INIT_PRIORITY
	int "eSPI V3 peripheral channel device init priority"
	default 4
	help
	  Initialization priority of the eSPI peripheral (logical) channel device
	  drivers. Must be greater than ESPI_INIT_PRIORITY so that the eSPI
	  controller is initialized first: every peripheral driver registers with
	  the controller for ESPI_RESET, channel enable, and PLTRST events in its
	  own init function.

config ESPI_XEC_V3_PC_KBC
	bool "eSPI V3 8042 keyboard controller peripheral"
	default y
	depends on DT_HAS_MICROCHIP_XEC_ESPI_PC_KBC_ENABLED
	help
	  Enable the standalone driver for the eSPI peripheral channel 8042
	  keyboard controller.

if ESPI_XEC_V3_PC_KBC

config ESPI_XEC_V3_PC_KBC_IBF_EVT_DATA
	bool "eSPI V3 KBC event data format in IBF"
	help
	  Encode the KBC input buffer full event using the espi_evt_data_kbc
	  format instead of passing the raw data byte.

config ESPI_XEC_V3_PC_KBC_OBE_CBK
	bool "eSPI V3 KBC output buffer empty callback"
	help
	  Invoke the application callback from the KBC output buffer empty ISR.

endif # ESPI_XEC_V3_PC_KBC

config ESPI_XEC_V3_PC_ACPI_EC
	bool "eSPI V3 ACPI EC peripherals"
	default y
	depends on DT_HAS_MICROCHIP_XEC_ESPI_PC_ACPI_EC_ENABLED
	help
	  Enable the standalone driver for the eSPI peripheral channel ACPI
	  Embedded Controller interfaces. One driver serves every enabled
	  instance.

if ESPI_XEC_V3_PC_ACPI_EC

config ESPI_XEC_V3_PC_ACPI_EC_IBF_EVT_DATA
	bool "eSPI V3 read ACPI EC event data in the IBF ISR"
	help
	  Read the event data in the ACPI EC input buffer full ISR and pass it to
	  the callback. Used in OS environments where the application expects the
	  ISR to have already consumed the data.

config ESPI_XEC_V3_PC_ACPI_SHD_MEM_SIZE
	int "eSPI V3 ACPI shared memory region size in bytes"
	default 256
	help
	  Size of the shared memory region the Host reads ACPI response data
	  from.

config ESPI_XEC_V3_PC_HOST_CMD_PARAM_SIZE
	int "eSPI V3 EC host command parameter region size in bytes"
	default 256
	help
	  Size of the shared memory region used for EC host command parameter
	  data.

endif # ESPI_XEC_V3_PC_ACPI_EC

config ESPI_XEC_V3_PC_ACPI_PM1
	bool "eSPI V3 ACPI PM1 block peripheral"
	default y
	depends on DT_HAS_MICROCHIP_XEC_ESPI_PC_ACPI_PM1_ENABLED
	help
	  Enable the standalone driver for the eSPI peripheral channel ACPI PM1
	  fixed hardware register block.

config ESPI_XEC_V3_PC_EMI
	bool "eSPI V3 embedded memory interface peripherals"
	default y
	depends on DT_HAS_MICROCHIP_XEC_ESPI_PC_EMI_ENABLED
	help
	  Enable the standalone driver for the eSPI peripheral channel embedded
	  memory interfaces. One driver serves every enabled instance.

config ESPI_XEC_V3_PC_MBOX
	bool "eSPI V3 mailbox peripheral"
	default y
	depends on DT_HAS_MICROCHIP_XEC_ESPI_PC_MBOX_ENABLED
	help
	  Enable the standalone driver for the eSPI peripheral channel 32 byte
	  mailbox. Provides the mchp_xec_espi_pc_mailbox_* API declared in
	  include/zephyr/drivers/espi/mchp_xec_espi.h.

config ESPI_XEC_V3_PC_PORT92
	bool "eSPI V3 fast Port92h peripheral"
	default y
	depends on DT_HAS_MICROCHIP_XEC_ESPI_PC_PORT92_ENABLED
	help
	  Enable the standalone driver for the eSPI peripheral channel fast
	  Port92h GATE A20 and CPU reset logic.

config ESPI_XEC_V3_PC_P80BD
	bool "eSPI V3 Port80 BIOS debug peripheral"
	default y
	depends on DT_HAS_MICROCHIP_XEC_ESPI_PC_P80BD_ENABLED
	help
	  Enable the standalone driver for the eSPI peripheral channel Port80
	  BIOS debug capture port.

if ESPI_XEC_V3_PC_P80BD

config ESPI_XEC_V3_PC_P80BD_MULTIBYTE
	bool "eSPI V3 Port80 multi-byte Host writes"
	help
	  Accept 1, 2 or 4 bytes of Port80 data written by the Host in a single
	  eSPI transaction.

endif # ESPI_XEC_V3_PC_P80BD

config ESPI_XEC_V3_PC_GLUE
	bool "eSPI V3 glue logic peripheral"
	default y
	depends on DT_HAS_MICROCHIP_XEC_ESPI_PC_GLUE_ENABLED
	help
	  Enable the standalone driver for the eSPI peripheral channel glue
	  logic, which aggregates the Host power management handshake signals.

endif # ESPI_XEC_V3
```

## drivers/gpio/Kconfig.xec
```kconfig
# Microchip XEC GPIO configuration options

# Copyright (c) 2019 Intel Corporation
# SPDX-License-Identifier: Apache-2.0

config GPIO_XEC
	bool "XEC Microchip GPIO driver"
	default y
	depends on DT_HAS_MICROCHIP_XEC_GPIO_ENABLED
	help
	  Enable the Microchip XEC gpio driver.

config GPIO_XEC_INTERRUPT
	bool "XEC Microchip GPIO interrupt support"
	default y
	depends on GPIO_XEC
	help
	  Enable GPIO interrupt (edge/level detection) support in the XEC GPIO
	  driver. This requires a functional EC Interrupt Aggregator (ECIA/GIRQ)
	  block, which the driver programs via soc_ecia_girq_*() at init and when
	  configuring per-pin interrupts.

	  Disable this on SoCs/targets where the ECIA block is not present or not
	  yet enabled (e.g. some FPGA bring-up bitstreams): the driver then skips
	  all ECIA/NVIC setup and operates in polled (output/input read) mode, and
	  gpio_pin_interrupt_configure() returns -ENOTSUP.
```
