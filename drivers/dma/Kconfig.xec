## dts/bindings/i2c/microchip,xec-i2c-nl.yaml
```yaml
# Copyright (c) 2026, Microchip Technology Inc.
# SPDX-License-Identifier: Apache-2.0

description: |
  Microchip XEC version 3.8 HW I2C driver using network layer
  I2C protocol FSM plus DMA.

compatible: "microchip,xec-i2c-nl"

include: base.yaml

properties:
  reg:
    required: true
    description: MMIO Base address register mapping.

  interrupts:
    required: true
    description: Hardware interrupt vector assignment.

  girqs:
    type: array
    required: true
    description: |
      Hardware GIRQ encoded interrupt routing. Each peripheral
      interrupt line is routed to a GIRQ bit in the XEC ECIA.
      The GIRQ result bits which are bitwise AND of GIRQ enable
      and status are routed to the peripheral's NVIC input.
      The value is the encoded GIRQ number and bit position
      for this peripheral instance. The array has a maximum of
      two entries. The first is the runtime GIRQ and the second is
      the wake GIRQ.

  pcr-scr:
    type: int
    required: true
    description: |
      Each peripheral instance has sleep enable, clock required, and
      reset bits in the PCR block. The value is the encoded PCR register
      index and bit position for the peripheral instance.

  default-port:
    type: phandle
    dependency-mode: "ignore"
    description: |
      Phandle to one of this controller's port nodes whose pin routing is
      applied at boot, before the first transfer. Optional: if omitted, no
      port is pre-routed and the first transfer lazily applies its own
      port's routing. The referenced port's "controller" phandle must point
      back to this node (enforced by build assertion).

  dmas:
    required: true
    description: |
      Phandle and channel specs mapping this block to its DMA engine(s).
      The driver expects up to two named entries:

        "host"   - DMA channel + trigger source for controller-mode
                   transfers (HCMD/HTX/HRX). Always required.
        "target" - DMA channel + trigger source for target-mode
                   transfers (TCMD/TTX/TRX). Required only when an
                   application registers an I2C target via
                   i2c_target_register(); target_register returns
                   -ENODEV at runtime if this entry is absent.

      The two entries must reference the same DMA controller but use
      different channels and different trigger sources.

  dma-names:
    required: true
    description: |
      Names for the dmas entries. Use ["host"] for controller-only
      use; use ["host", "target"] when target mode will be used.

  target-buffer-size:
    type: int
    description: |
      Per-instance size, in bytes, of the target-mode RX buffer the
      driver stages incoming bytes into before invoking the
      buf_write_received callback. Sized to the largest write the
      external host will issue plus one byte for the matched target
      address (which the driver strips before passing data to the
      callback). If absent, the driver does not allocate a target
      buffer and i2c_target_register returns -ENOSYS. The hardware
      receive-byte counter is 16 bits, so this value must be
      <= 65535 (0xFFFF); a build assertion enforces the cap.

  clock-frequency:
    type: int
    description: |
      Clock frequency is unused for the controller node and required
      for the port node. We keep it here to prevent build errors on
      code trees that will have clock-frequency in the chip level DTSI.

  timing-100k:
    type: array
    description: |
      Bus-timing register overrides applied when the bus rate is
      programmed to 100 kHz or below. Optional: when absent the driver
      uses its datasheet defaults, so a board only names the rows it
      needs to tune.

      Exactly six cells, in this order:

        0  data-timing       DT     (0x40) full 32-bit register
        1  idle-scaling      ISC    (0x24) full 32-bit register
        2  timeout-scaling   TMOUT_SC (0x44) full 32-bit register
        3  bus-clock         BCLK   (0x2c) 16 bits: low period in 7:0,
                                   high period in 15:8
        4  rpt-start-hold    RSHT   (0x18) 8 bits
        5  mr0-timing        MR0    (0x3c) bits 7:0, BAUD clock select

      All six are required when the property is present; there is no
      per-cell fallback. Default row: <0x0C4D5006 0x01FC01ED 0x4B9CC2C7
      0x4F4F 0x4D 0x05>.

      Every count in cells 0-4 is expressed in BAUD-clock periods, and
      cell 5 selects that clock: 0x05 is the 16 MHz source all the
      default rows assume, where one count is 62.5 ns. Changing cell 5
      rescales the other five, so change them together.

      Cells 0-2 are full 32-bit registers. Devicetree cells are signed
      32-bit, so a value above 0x7fffffff is stored as a negative number
      and is not range-checked at build time; it still reaches the
      hardware register with the correct bits.

      Tuning bus-clock is how a board compensates for SCL edge rates.
      The controller samples SCL and times the high period from the real
      V_IH crossing, so on a bus with a slow rise the achieved rate sits
      below the programmed one; shortening the high period in bits 15:8
      claws that back, subject to the I2C minimum high and low times for
      the mode in use.

  timing-400k:
    type: array
    description: |
      Bus-timing register overrides applied above 100 kHz and up to
      400 kHz. Same six cells and the same rules as timing-100k.
      Default row: <0x040A0A06 0x01000050 0x159CC2C7 0x0F17 0x0A 0x05>.

  timing-1000k:
    type: array
    description: |
      Bus-timing register overrides applied above 400 kHz. Same six
      cells and the same rules as timing-100k. Default row:
      <0x04060601 0x00320030 0x089CC2C7 0x0509 0x06 0x05>.

  timing-dt:
    type: array
    description: |
      A fourth timing row for an operating point the three frequency
      bands above do not describe. Same six cells and the same rules as
      timing-100k, but no default: the row exists only when this
      property is present.

      It is reached only by an explicit
      i2c_configure(dev, I2C_MODE_CONTROLLER | I2C_SPEED_SET(I2C_SPEED_DT)).
      A port's clock-frequency continues to select one of the three
      bands, so adding this property changes nothing until an
      application asks for I2C_SPEED_DT. When the property is absent,
      I2C_SPEED_DT keeps its previous meaning and programs the
      controller's default frequency.

      Because the row is raw register values with no nominal rate, the
      driver reports I2C_SPEED_DT back from i2c_get_config while it is
      active rather than guessing a frequency band.
```

## dts/bindings/i2c/microchip,xec-i2c-v3-nl.yaml
```yaml
# Copyright (c) 2026, Microchip Technology Inc.
# SPDX-License-Identifier: Apache-2.0

description: |
  Microchip XEC I2Cv3-NL driver using network layer I2C protocol FSM plus DMA

compatible: "microchip,xec-i2c-v3-nl"

include: base.yaml

properties:
  reg:
    required: true

  interrupts:
    required: true

  girqs:
    type: array
    required: true
    description: |
      Hardware GIRQ encoded interrupt routing. Each peripheral
      interrupt line is routed to a GIRQ bit in the XEC ECIA.
      The GIRQ result bits are a bitwise AND of GIRQ enable and
      status bits are routed to the peripheral's NVIC input.
      Each value in the array is the encoded GIRQ number and bit
      position for this peripheral instance. For I2Cv3-NL the array
      has a maximum of two entries. The first entry is the runtime
      I2C activity and the second is the wake-only interrupt. The
      wake-only is not routed to the NVIC.

  pcr-scr:
    type: int
    required: true
    description: |
      Each I2C instance has a sleep enable, clock required, and reset
      enable bits in the XEC PCR block. The integer value encodes the
      logical register index and bit position.

  dmas:
    required: true
    description: |
      Phandle and channel specs mapping this block to its DMA engine.
      The driver expects up to two named entries:

        "host"    - DMA channel + trigger source for controller-mode transfers
                    Alwasy required.
        "target"  - DMA channel + trigger source for target-mode transfers.
                    Required only when the driver is built with target support.

        The two entries must reference the same DMA controller but use different
        channels and trigger sources.

  dma-names:
    required: true
    description: |
      Names for the dmas entries. Use ["host"] for controller-only use.
      Use ["host", "target"] when target mode is enabled in the build.

  default-port:
    type: phandle
    dependency-mode: "ignore"
    description: |
      Phandle to a port node handled by this controller. Port nodes handle
      pin routing for their hardware port. Optional: if omitted, no port
      is pre-routned and the first transfer lazily appplies its own port's
      routing. The referenced port's "controller" phandle must point back
      to this node (enforced by build assertion).
```

## dts/bindings/i3c/microchip,xec-i3c.yaml
```yaml
# Copyright (C) 2020 Samsung Electronics Co., Ltd.
# Copyright (C) 2023 Meta Platforms
# Copyright (c) 2026 Microchip Technology Inc.
# SPDX-License-Identifier: Apache-2.0

description: |
    Microchip XEC I3C controller.

    The MEC SoCs integrate the Synopsys DesignWare DWC_mipi_i3c IP behind an
    XEC-specific wrapper, so this binding shares the i3c_dw.c driver with
    snps,designware-i3c. The wrapper adds a HOST_CFG port-select register, and
    routes the interrupt through the XEC Interrupt Aggregator (ECIA)

compatible: "microchip,xec-i3c"

include:
  - name: i3c-controller.yaml
  - name: pinctrl-device.yaml
  - name: microchip,dmec-ecia-girq.yaml

class: [i3c, i2c]

properties:
  reg:
    required: true

  interrupts:
    required: true

  clocks:
    required: true
    description: |
      PCR clock specifier: <&pcr regidx bitpos MCHP_XEC_PCR_CLK_I3C>.
      regidx and bitpos locate this controller's bit in the PCR sleep-enable /
      clock-required / reset-enable registers. The clock ID selects the 192 MHz
      I3C domain reported by the XEC clock control driver, which requires a SoC
      that selects HAS_MCHP_MEC_I3C.

  port-sel:
    type: int
    default: 0
    description: |
      I3C port selection written to HOST_CFG[2:0]. Selects which SoC pad group
      the controller drives. Must agree with the pinctrl-0 pin group.

  bcr:
    type: int
    description: |
      Bus Characteristics Register. The device role field, bits [7:6], selects
      the boot role of the instance during driver initialization: 0 boots as
      target, 1 as controller. A dual-role instance resets in controller mode,
      so an instance used as a target on a bus with another controller must set
      a target BCR to avoid two controllers driving the bus. The value is also
      reported during dynamic address assignment; bits the hardware fixes keep
      their hardware value. When absent, the hardware reset mode is kept.

  static-address:
    type: int
    description: |
      Target static address, programmed at init when the instance boots as a
      target. Lets the controller assign the dynamic address with SETDASA
      during its bus initialization, before the application configures the
      target.

  tgt-pid:
    type: array
    description: |
      Target 48-bit Provisioned ID, programmed at init when the instance boots
      as a target.
      array[0]: PID[47:32].
      array[1]: PID[31:0].

  maximum-read:
    type: int
    description: |
      Target maximum read length (MRL) in bytes, programmed at init when the
      instance boots as a target.

  maximum-write:
    type: int
    description: |
      Target maximum write length (MWL) in bytes, programmed at init when the
      instance boots as a target.
```

## dts/bindings/i3c/snps,designware-i3c.yaml
```yaml
# Copyright (C) 2020 Samsung Electronics Co., Ltd.
# Copyright (C) 2023 Meta Platforms
# SPDX-License-Identifier: Apache-2.0

description: >
    This is a binding for the Synopsys I3C interface

compatible: "snps,designware-i3c"

include: [i3c-controller.yaml, pinctrl-device.yaml]

class: [i3c, i2c]

properties:
  clocks:
    required: true

  bcr:
    type: int
    description: |
      Bus Characteristics Register. The device role field, bits [7:6], selects
      the boot role of the instance during driver initialization: 0 boots as
      target, 1 as controller. A dual-role instance resets in controller mode,
      so an instance used as a target on a bus with another controller must set
      a target BCR to avoid two controllers driving the bus. The value is also
      reported during dynamic address assignment; bits the hardware fixes keep
      their hardware value. When absent, the hardware reset mode is kept.

  static-address:
    type: int
    description: |
      Target static address, programmed at init when the instance boots as a
      target. Lets the controller assign the dynamic address with SETDASA
      during its bus initialization, before the application configures the
      target.

  tgt-pid:
    type: array
    description: |
      Target 48-bit Provisioned ID, programmed at init when the instance boots
      as a target.
      array[0]: PID[47:32].
      array[1]: PID[31:0].

  maximum-read:
    type: int
    description: |
      Target maximum read length (MRL) in bytes, programmed at init when the
      instance boots as a target.

  maximum-write:
    type: int
    description: |
      Target maximum write length (MWL) in bytes, programmed at init when the
      instance boots as a target.
```

## dts/bindings/tach/microchip,mec5-tach.yaml
```yaml
# Copyright (c) 2024, Microchip Technology Inc.
# SPDX-License-Identifier: Apache-2.0

description: Microchip MEC5 HAL based tachometer

compatible: "microchip,mec5-tach"

include: [tach.yaml, pinctrl-device.yaml]

properties:
  reg:
    required: true

  interrupts:
    required: true

  read-mode:
    type: string
    description: |
      Select the method to increment the tachometer counter. Power on default
      is to increment the counter on the rising edge of the tachometer input.
      The second method is increment on the rising edge of the internal 100KHz
      clock. The counter is latched into the tachometers counter read-only bit
      field in its control register and reset when the programmed number of edges
      is detected.
    enum:
      - "input rising edge"
      - "internal 100kHz rising edge"

  edges-count:
    type: string
    description: |
      The number of edges on the tachometer input triggering capture of the
      100 KHz counter. Typically, two periods of the input represent one fan
      revolution. A tachometer input period consists of three edges. This value
      is the number of edges used to determine the interval over which the
      tachometers 100KHz internal pulses will be counted.
      Nine tach edges is 4 Tach periods.
      Five tach edges is 2 Tach periods.
      Three tach edges is 1 Tach period.
      Two tach edges is 1/2 Tach period.
    enum:
      - "9"
      - "5"
      - "3"
      - "2"

  pulses-per-revolution:
    type: int
    default: 2
    description: |
      Number of tachometer output pulses the fan produces per revolution.
      Most brushless DC fans emit two pulses per revolution, which is the
      default. This is required to convert the captured edge interval into
      RPM: the capture window is expressed in tach input periods, so the
      driver must know how many periods make up one revolution.

  "#address-cells":
    required: true
    const: 1
  "#size-cells":
    type: int
    const: 0
```
