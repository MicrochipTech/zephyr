## dts/bindings/espi/microchip,xec-espi-pc-acpi-ec.yaml
```yaml
# Copyright (c) 2026 Microchip Technology Inc.
# SPDX-License-Identifier: Apache-2.0

description: |
  Microchip XEC eSPI peripheral channel ACPI Embedded Controller interface.

  Each ACPI EC instance implements one Host I/O decoder for its four byte
  command/data window, one Memory BAR for the same window in Host memory
  space, and one OBF Serial IRQ.

compatible: "microchip,xec-espi-pc-acpi-ec"

include: ["microchip,xec-espi-pc-base.yaml"]

properties:
  reg:
    required: true

  peripheral-type:
    type: string
    required: true
    enum:
      - "host-io"
      - "host-io-pvt"
      - "host-io-pvt2"
      - "host-io-pvt3"
      - "ec-host-cmd"
    description: |
      Role this ACPI EC instance plays for the Host, selecting the
      enum espi_virtual_peripheral value reported in the evt_details field of
      the eSPI event the driver generates. The V2 driver picks this per
      instance at build time from the CONFIG_ESPI_PERIPHERAL_HOST_IO,
      CONFIG_ESPI_PERIPHERAL_HOST_IO_PVT and
      CONFIG_ESPI_PERIPHERAL_EC_HOST_CMD symbols.

      Two of the roles answer an opcode range of espi_read_lpc_request() and
      espi_write_lpc_request(), so at most one instance may claim either:

      - "host-io" answers the EACPI_* range.
      - "ec-host-cmd" answers ECUSTOM_HOST_CMD_GET_PARAM_MEMORY,
        ECUSTOM_HOST_CMD_GET_PARAM_MEMORY_SIZE and
        ECUSTOM_HOST_CMD_SEND_RESULT, which is what the eSPI backend in
        subsys/mgmt/ec_host_cmd calls. It requires
        CONFIG_ESPI_PERIPHERAL_EC_HOST_CMD for the reported peripheral value,
        CONFIG_ESPI_PERIPHERAL_CUSTOM_OPCODE for the opcodes, and a
        shared-memory-size, which becomes the host command parameter region.

  shared-memory-size:
    type: int
    description: |
      Size in bytes of a driver owned, eight byte aligned region of SoC data
      memory the driver allocates for this instance and hands to the caller that
      asks for it. Omit it on instances that have no shared memory region.

      The two roles that answer an opcode are the two that can hand the address
      out, and nothing else in the API exposes it, so the region is allocated only
      when the role's opcode is compiled in:

      - "host-io" through EACPI_GET_SHARED_MEMORY, which needs
        CONFIG_ESPI_PERIPHERAL_ACPI_SHM_REGION.
      - "ec-host-cmd" through ECUSTOM_HOST_CMD_GET_PARAM_MEMORY, which needs
        CONFIG_ESPI_PERIPHERAL_CUSTOM_OPCODE.

      This is SoC data memory, not Host memory, and this block has no decoder for
      it: the Host I/O BAR and Memory BAR decode the four byte command/data
      window, not the region. An application that wants the Host to reach the
      region fetches its address with the role's opcode and installs it in an EMI
      window with mchp_xec_espi_pc_emi_region_set(), which is the decoupled form
      of the wiring the V2 driver compiles into its EMI0 setup.
```

## dts/bindings/espi/microchip,xec-espi-pc-acpi-pm1.yaml
```yaml
# Copyright (c) 2026 Microchip Technology Inc.
# SPDX-License-Identifier: Apache-2.0

description: |
  Microchip XEC eSPI peripheral channel ACPI PM1 block.

  Implements the ACPI fixed hardware PM1 status, enable and control registers
  in Host I/O space. Generates no Serial IRQ of its own; the SCI and SMI
  virtual wires are driven through the glue logic device.

compatible: "microchip,xec-espi-pc-acpi-pm1"

include: ["microchip,xec-espi-pc-base.yaml"]

properties:
  reg:
    required: true
```

## dts/bindings/espi/microchip,xec-espi-pc-bar-cfg.yaml
```yaml
# Copyright (c) 2026 Microchip Technology Inc.
# SPDX-License-Identifier: Apache-2.0

description: |
  Microchip XEC eSPI peripheral channel host decoder configuration only.

  For logical devices whose Host facing decoders and Serial IRQs must be
  programmed by the eSPI controller but which have no driver of their own,
  either because the hardware block is owned by another Zephyr subsystem (the
  host UART, owned by drivers/serial) or because it is an additional decoder
  belonging to another logical device (the Port80 alias).

  The eSPI controller driver programs the io-bars, mem-bars and sirqs of every
  okay child node with an ldn property, so no driver needs to bind here.

compatible: "microchip,xec-espi-pc-bar-cfg"

include: ["microchip,xec-espi-pc-base.yaml"]
```

## dts/bindings/espi/microchip,xec-espi-pc-emi.yaml
```yaml
# Copyright (c) 2026 Microchip Technology Inc.
# SPDX-License-Identifier: Apache-2.0

description: |
  Microchip XEC eSPI peripheral channel Embedded Memory Interface (EMI).

  Each EMI instance implements one Host I/O decoder, one Memory BAR, and two
  Serial IRQs: Host event (HEV) and EC to Host (E2H). It also gives the Host
  windowed access to two regions of SoC data memory, described by emi-mems.

compatible: "microchip,xec-espi-pc-emi"

include: ["microchip,xec-espi-pc-base.yaml"]

properties:
  emi-mems:
    type: array
    description: |
      Each EMI host device supports Host access to two SoC data memory
      regions. Each region requires three configuration parameters: base
      address in the SoC data memory, read limit, and write limit. If
      bits[14:2] of the address written by the Host to the EC address register
      is less than the limit value the access is allowed. Bit[15] of the EC
      address selects which of the two memory regions is accessed.

  "emi-mem-cells":
    type: int
    const: 3

emi-mem-cells:
  - base
  - rdlimit
  - wrlimit
```

## dts/bindings/espi/microchip,xec-espi-pc-glue.yaml
```yaml
# Copyright (c) 2026 Microchip Technology Inc.
# SPDX-License-Identifier: Apache-2.0

description: |
  Microchip XEC eSPI peripheral channel glue (VCC power good generation) logic.

  Derives the VCC_PWRGD2 power good signal the Host chipset sees, and detects
  entry into the S0ix connected standby state so power good can be taken from a
  second, lower current, regulator chain while the system is idle. S0ix is
  derived from the SLP_S0# and CPU_C10 inputs, either of which may be a pin or,
  for C10, the HOST_C10 eSPI virtual wire. The block reports edges on the
  derived power good and S0ix signals to the EC as an interrupt.

  The properties below describe how the board wires those inputs. The driver
  programs them once at init and again after every reset that clears them,
  writing the input polarity and source selections before the detection source
  field so VCC_PWRGD2 cannot glitch while it is being configured. Glitches on
  VCC_PWRGD2 must not reach the chipset.

  The S0ix detection enable bit is a runtime register, so a board may give this
  node an io-bars pair to let the Host reach it. Hardware clears that bit on
  every PLTRST, which is why it is separate from the properties here and is
  re-armed by the driver through
  mchp_xec_espi_pc_glue_s0ix_detect_enable().

compatible: "microchip,xec-espi-pc-glue"

include: ["microchip,xec-espi-pc-base.yaml"]

properties:
  reg:
    required: true

  pwrgd-source:
    type: string
    default: "vcc-pwrgd"
    description: |
      Which power good input VCC_PWRGD2 follows while the system is in S0ix, or
      whenever fw-pwrgd-select is set. Outside those cases hardware always uses
      the VCC_PWRGD pin and this property has no effect. Defaults to the
      hardware default of the VCC_PWRGD pin.
    enum:
      - "vcc-pwrgd"
      - "pwrgd-s0ix"
      - "vcc-pwrgd-and-pwrgd-s0ix"

  s0ix-detect-source:
    type: string
    default: "none"
    description: |
      Which inputs, after the polarity and source selections below, hardware
      combines into the S0ix state. Defaults to the hardware default of none,
      which presents S0ix as a constant zero so VCC_PWRGD2 always follows the
      VCC_PWRGD pin.
    enum:
      - "none"
      - "slp-s0"
      - "c10"
      - "slp-s0-and-c10"

  c10-source:
    type: string
    default: "pin"
    description: |
      Where the C10 input comes from: the CPU_C10 pin, or the HOST_C10 eSPI
      virtual wire. Defaults to the hardware default of the pin.
    enum:
      - "pin"
      - "vwire"

  c10-inverted:
    type: boolean
    description: |
      The selected C10 source is low active. Leave out for a high active
      source, which is the hardware default.

  slp-s0-inverted:
    type: boolean
    description: |
      The SLP_S0# pin input is high active. Leave out for the low active source
      the signal name implies, which is the hardware default.

  fw-pwrgd-select:
    type: boolean
    description: |
      Take the S0ix state out of the VCC_PWRGD2 input selection, leaving
      firmware in direct control of it through pwrgd-source. The S0ix state is
      still reported to firmware as a signal monitor bit.
```

## dts/bindings/espi/microchip,xec-espi-pc-kbc.yaml
```yaml
# Copyright (c) 2026 Microchip Technology Inc.
# SPDX-License-Identifier: Apache-2.0

description: |
  Microchip XEC eSPI peripheral channel 8042 keyboard controller (KBC).

  The KBC implements two Host I/O decoders: the data register and the
  command/status register. It generates two Serial IRQs, KIRQ (keyboard, Host
  IRQ1) and MIRQ (mouse, Host IRQ12).

compatible: "microchip,xec-espi-pc-kbc"

include: ["microchip,xec-espi-pc-base.yaml"]

properties:
  reg:
    required: true
```

## dts/bindings/espi/microchip,xec-espi-pc-mbox.yaml
```yaml
# Copyright (c) 2026 Microchip Technology Inc.
# SPDX-License-Identifier: Apache-2.0

description: |
  Microchip XEC eSPI peripheral channel mailbox.

  Implements a 32 byte mailbox shared between the Host and the EC, reached
  through one Host I/O decoder and one Memory BAR. Generates two Serial IRQs,
  a general purpose one and an SMI.

compatible: "microchip,xec-espi-pc-mbox"

include: ["microchip,xec-espi-pc-base.yaml"]
```

## dts/bindings/espi/microchip,xec-espi-pc-p80bd.yaml
```yaml
# Copyright (c) 2026 Microchip Technology Inc.
# SPDX-License-Identifier: Apache-2.0

description: |
  Microchip XEC eSPI peripheral channel Port80 BIOS debug port.

  Captures Host writes to the BIOS POST code I/O port into a FIFO readable by
  the EC. The hardware implements a second, alias, I/O decoder which is
  described by its own node using microchip,xec-espi-pc-bar-cfg because it
  needs BAR configuration only and has no registers of its own.

compatible: "microchip,xec-espi-pc-p80bd"

include: ["microchip,xec-espi-pc-base.yaml"]
```

## dts/bindings/espi/microchip,xec-espi-pc-port92.yaml
```yaml
# Copyright (c) 2026 Microchip Technology Inc.
# SPDX-License-Identifier: Apache-2.0

description: |
  Microchip XEC eSPI peripheral channel Fast Port92h logic.

  Implements the legacy Port 92h fast A20 gate and fast CPU reset in Host I/O
  space. Generates no Serial IRQ.

compatible: "microchip,xec-espi-pc-port92"

include: ["microchip,xec-espi-pc-base.yaml"]

properties:
  reg:
    required: true
```

## dts/bindings/espi/microchip,xec-espi-v3.yaml
```yaml
# Copyright (c) 2026 Microchip Technology Inc.
# SPDX-License-Identifier: Apache-2.0

description: |
  Microchip XEC eSPI V3 controller.

  Unlike the V2 driver, the V3 driver does not implement the peripheral
  (logical) channel devices itself. Each peripheral is a separate Zephyr driver
  bound to its own child node. This driver retains ownership of the I/O BAR,
  Memory BAR and Serial IRQ registers, programming them from each okay child
  node's io-bars, mem-bars and sirqs properties, and notifies registered
  peripheral drivers when that hardware becomes usable or is held in reset.

compatible: "microchip,xec-espi-v3"

include: [espi-controller.yaml, pinctrl-device.yaml]

properties:
  reg:
    description: mmio register space
    required: true

  reg-names:
    required: true
    description: Name of each register space

  girqs:
    type: array
    required: true
    description: |
      Array of encoded interrupt information

  pcr-scr:
    type: int
    required: true
    description: |
      Encoded PCR sleep, clock required, reset register index and bit position.

  girq-wake:
    type: int
    required: true
    description: |
      Encoded PLL wake GIRQ and bit position for eSPI. This wake-only GIRQ must
      be enabled if the Host sends eSPI traffic when the SoC is in deep sleep.
      The wake GIRQ turns on the ring oscillator and and SoC eSPI hardware captures
      and examines the eSPI packet. If the HW can service the packet without SoC
      firmware intervention it does so and turns off the ring oscillator. If firmware
      is required the PLL is enabled and the respective eSPI interrupt to the SoC
      processor is asserted.

  pinctrl-0:
    required: true

  pinctrl-names:
    required: true

  host-memmap-addr-high:
    type: int
    description: |
      Contains bits [47:32] of the Host address range where all memory mapped
      host (logical) devices are located in Host memory address space.

  sram-bar-addr-high:
    type: int
    description: |
      Contains Host address bits [47:32] where both SRAM BAR's are mapped
      to Host memory address space.
```
