## drivers/i2c/Kconfig.mchp_xec
```kconfig
# Microchip XEC I2C configuration options

# Copyright (c) 2019 Intel Corporation
# SPDX-License-Identifier: Apache-2.0

config I2C_XEC
	bool "XEC Microchip I2C driver"
	default y
	depends on DT_HAS_MICROCHIP_XEC_I2C_ENABLED
	select PINCTRL
	help
	  Enable the Microchip XEC I2C driver.

config I2C_XEC_V2
	bool "XEC Microchip I2C driver"
	default y
	depends on DT_HAS_MICROCHIP_XEC_I2C_V2_ENABLED
	select PINCTRL
	help
	  Enable the Microchip XEC I2C V2 driver.

config I2C_MCHP_XEC_NL
	bool "XEC Microchip I2C-NL driver"
	default y
	depends on DT_HAS_MICROCHIP_XEC_I2C_NL_ENABLED
	select DMA
	select PINCTRL
	select I2C_TRANSFER_TIMEOUT_SUPPORTED
	help
	  Enable the Microchip XEC I2C network layer plus
	  DMA driver. Messages are split into transactions
	  at each STOP. The I2C-NL HW FSM limits each START
	  to STOP transaction to one or two messages: One I2C
	  write or read. Two I2C writes (write data split
	  across two msg buffers), two I2C reads (read data
	  split across two msg buffers), or a two message
	  I2C combined write-read.

config I2C_MCHP_XEC_NL_PORT_SETTLE_US
	int "XEC I2C-NL port switch settle time in microseconds"
	default 100
	range 0 10000
	depends on I2C_MCHP_XEC_NL
	help
	  Time the driver waits after enabling the controller on a newly
	  selected port, or after a controller reset, so the controller can
	  sample the port's SCL and SDA before a transaction starts. The
	  wait is done only in thread context.

config I2C_MCHP_XEC_NL_STATE_CAPTURE
	bool "XEC I2C-NL state capture enable"
	depends on I2C_MCHP_XEC_NL
	help
	  Enable the I2C-NL driver to capture state into
	  a driver buffer, and to keep event counters alongside it. The buffer is
	  reset at the start of every host transfer and so holds only the most
	  recent one; the counters are never reset and so still read correctly
	  after a long run. Both are read from the driver data of a controller
	  instance.

config I2C_MCHP_XEC_NL_STATE_CAPTURE_SIZE
	int "XEC I2C-NL state capture buffer size"
	default 256
	range 16 4096
	depends on I2C_MCHP_XEC_NL_STATE_CAPTURE
	help
	  State capture buffer size in bytes. The buffer is allocated in
	  driver data for every enabled I2C-NL controller instance, so the
	  RAM cost is this value times the number of instances. Capture
	  stops when the buffer is full; size it for the longest
	  transaction to be traced.

config I2C_MCHP_XEC_NL_STATE_CAPTURE_INIT_ON_XFR
	bool "XEC I2C-NL state capture init on transfer start"
	default y
	depends on I2C_MCHP_XEC_NL_STATE_CAPTURE
	help
	  The default state capture feature will clear the capture
	  index and zero out the capture buffer at in the transfer
	  API calls. Target role is not affected.

# Each symbol below gates one bug fix, so a build machine can turn an individual fix
# off and measure the behaviour it changed without hand editing the driver, and so the
# configuration under test is recorded in the build's .config rather than being
# invisible. They exist for that measurement only and are removed once it is done.
# Every one of them defaults to the fixed behaviour: change one only for a deliberate
# A/B test.

config I2C_MCHP_XEC_NL_FIX_HOST_CMPL_MASK
	bool "XEC I2C-NL host setup leaves the shared bus status alone"
	default y
	depends on I2C_MCHP_XEC_NL
	help
	  Clear only the host owned completion status before a host transfer while a
	  target is registered, leaving the LAB, BER and time-out sources that report
	  the bus rather than one state machine and that the target state machine reads.
	  Set to n to clear the whole host mask from thread context, as the driver did
	  before, which can discard the status of a target transaction in flight.

config I2C_MCHP_XEC_NL_FIX_TGT_TDONE_STUCK
	bool "XEC I2C-NL target recovers from a done with the machine still running"
	default y
	depends on I2C_MCHP_XEC_NL && I2C_TARGET_BUFFER_MODE
	help
	  Handle a target done interrupt that arrives with the target command register
	  still showing run and proceed, by ending the transaction and arming the target
	  again. Set to n to ignore it, as the driver did before, which strands the
	  target with no interrupt left to recover on. Setting this to n also removes the
	  state capture marker that records the branch, so the state is no longer visible
	  in a trace.

config I2C_MCHP_XEC_NL_TGT_AAT
	bool
	depends on I2C_MCHP_XEC_NL && I2C_TARGET_BUFFER_MODE
	help
	  Arm the addressed-as-target match, Configuration register bit 28, when a
	  target is armed, and handle it in the target ISR. The match is reported at
	  the end of the seventh clock of an address the hardware can match, which
	  marks the start of a target transaction, and it is armed once per
	  transaction, so cnt_tgt_aat counts the transactions the hardware matched an
	  address for.

	  Selected by whatever needs the match. Not a choice on its own: on its own it
	  only counts.

config I2C_MCHP_XEC_NL_TGT_AAT_HANDOFF
	bool "XEC I2C-NL target network layer hand-off at the start of a transaction"
	depends on I2C_MCHP_XEC_NL && I2C_TARGET_BUFFER_MODE
	select I2C_MCHP_XEC_NL_TGT_AAT
	help
	  Arm a target with the address match alone and start the network layer from
	  the ISR when the match arrives, instead of arming the network layer up front
	  and waiting for it to report.

	  Arming programs the own addresses, arms the match, writes 0 to the target
	  command register and leaves the target DMA channel stopped, so the byte mode
	  state machine is what receives the address byte. The ISR leaves that byte in
	  the Data register, enables the idle and target done interrupts, programs the
	  target DMA and writes the target command register, and the network layer
	  takes the transaction from there.

	  What that relies on is the byte reaching memory by the path it would have
	  taken had the network layer been running all along. Byte mode leaves a
	  received byte in the Data register and holds SCL low until it is serviced,
	  so the transaction waits for the ISR rather than running ahead of it, and
	  the two clock window for reading the match status does not apply: the byte
	  stays put and so does the status. Starting the network layer is then what
	  moves that byte to the target receive buffer register, which is what
	  triggers the DMA channel to read it, and that is also what clears the match
	  status. The channel is programmed before the target command register for
	  that reason, so it is listening before anything can arrive.

	  Measured on hardware, it does not make that trip. An 11 byte buffer ACKed
	  11 data bytes and NACKed the 12th, where a receive count spent on the
	  address would have stopped at 10, and the data began at buffer offset 0.
	  Byte mode matched the address and the network layer never saw it, so it is
	  neither a buffer byte nor a count. The receive offset is 0, and the driver
	  names the target from the address shadow register when the transaction is
	  reported, nothing in the buffer being able to name it. Not at the match:
	  the hardware does not copy the address into that register until after the
	  eighth clock, and an ISR that is not held up reads it before it means
	  anything, while by the time a transaction is reported it has been valid for
	  the whole of it.

	  That makes target-buffer-size mean something different here. Armed the
	  other way it covers the address byte and one fewer data bytes than its
	  value; armed this way every byte of it is a data byte. A buffer sized for
	  the other arrangement therefore accepts one more data byte than it was
	  meant to, not one fewer, so nothing overflows.

	  The point of it is that the match is part of the byte mode state machine and
	  reports into the byte mode Status register, while the enable for it lives in
	  the Configuration register alongside the network layer enables. With the
	  network layer already running, the match is not reliably reported: an
	  external 15 byte write to a target with an 11 byte buffer produced one
	  interrupt and no match at all, completion register 0x20000000, idle and
	  nothing else, although the bus showed the address ACKed, 11 bytes ACKed, the
	  12th NACKed and a STOP. cnt_tgt_aat_miss counts the same thing over a run
	  and reached 16 percent of transactions.

	  Experimental, and off by default. It changes which state machine owns the
	  start of every target transaction, on a controller whose state machines
	  interact in ways the data sheet does not describe.

	  It also changes what the idle interrupt can be used for. A target armed the
	  old way keeps the target command register running, which rules idle out;
	  armed this way the register reads 0 until a match arrives, so idle is
	  available and is enabled for the length of a transaction. Bus idle with the
	  transaction unreported ends it, which is the recovery the watchdog does,
	  without waiting for a timer. cnt_tgt_idle counts those.

	  Starting the target command register while the hardware is still ACKing the
	  address is safe, which is the one thing this rests on. It needs the ISR to
	  finish inside the eighth and ninth clocks, which it does not at the speeds a
	  bus normally runs: the hand-off landed after the ACK by 28 us at 100 kHz and
	  by 1.3 us at 400 kHz. Slowing the bus is what wins the ISR that race, and at
	  31.25 kHz, where those two clocks last about 65 us, it did. The waveform
	  showed no gap at all between the address byte and the first data byte, so
	  the network layer was running before the hardware had finished with the
	  address, and five writes across a target buffer boundary came out the same
	  there as at 1 MHz, down to every counter and every state capture marker.

config I2C_MCHP_XEC_NL_TGT_WDOG
	bool "XEC I2C-NL target watchdog"
	depends on I2C_MCHP_XEC_NL && I2C_TARGET_BUFFER_MODE
	select I2C_MCHP_XEC_NL_TGT_AAT
	help
	  Recover a target transaction the hardware never reports done. The target
	  state machine can be left running with no completion interrupt pending, for
	  instance after it loses arbitration while transmitting, and it NACKs its own
	  address until something releases it.

	  Nothing in the hardware rescues it. Neither STOP detect enable reports
	  anything this driver can act on, the idle interrupt is ruled out while a
	  target is armed, and the hardware time-outs were built for the original
	  8-bit write and read counts, so using them caps a transfer at 254 bytes of
	  data and a target receive buffer at 255.

	  Addressed-as-target, Configuration register bit 28, is reported at the end
	  of the seventh clock of an address the hardware can match, which marks the
	  start of a target transaction. Arming a target arms the match, the match
	  starts a one-shot timer, and reporting the transaction done stops it. Expiry
	  therefore means the transaction neither finished nor reported, and the
	  target is armed again, which stops its DMA, flushes its buffers, clears its
	  status and rewrites its command register. The controller is reset as well
	  only when its status shows a bus error: a lost arbitration is cleared by the
	  network layer servicing the next byte and says only that the loss happened
	  in the byte where service stopped, and NBB stays 0 until the external
	  controller issues a STOP, so neither means the controller needs resetting.
	  cnt_tgt_wdog_reset counts the ones that did.

	  The match is armed once per transaction, so cnt_tgt_aat counts transactions
	  the hardware matched an address for. Against cnt_tgt_done, which counts the
	  ones it reported done, the difference is the number that stalled.

	  The status clears itself when the network layer moves the address byte out
	  of the Data register, which is also the window for reading it: about two
	  clock periods, ample at 100 kHz and tight at 1 MHz. Missing it costs that
	  transaction its watchdog and nothing else.

	  Re-arming alone clears a stalled state machine, which is measured: across
	  runs totalling several hundred expiries none needed the controller reset,
	  the expiry count did not run away, and the transaction counts stayed
	  consistent with the address matches. A run of 745 target transactions under
	  injected bus faults expired 17 times, reset none of them, and reported every
	  one of its 91 errors to the application exactly once.

	  It is not made redundant by the idle interrupt that comes with
	  I2C_MCHP_XEC_NL_TGT_AAT_HANDOFF. The two cover different stalls. Idle needs
	  both lines high for a detection window, and a bus carrying back to back
	  traffic and repeated recovery does not always give it one: every expiry in a
	  run of 800 transactions logged the idle enable still set with its status
	  clear and NBB reading 0, so the bus was still busy after the whole 50 ms and
	  no amount of waiting on idle would have ended those transactions.

	  Which of the two ends a stall is a property of the bus at the time rather
	  than of the stall. One run of this test ended 10 through the watchdog and
	  none through idle, and the next ended 1 through the watchdog and 4 through
	  idle.

	  Off by default all the same: it ends a target transaction the hardware may
	  yet have finished.

config I2C_MCHP_XEC_NL_TGT_WDOG_MS
	int "XEC I2C-NL target transaction timeout in milliseconds"
	default 50
	range 1 60000
	depends on I2C_MCHP_XEC_NL_TGT_WDOG
	help
	  How long a single target transaction may take before it is treated as
	  stalled. Size it above the longest an external host will run: a write
	  filling a 259 byte target buffer takes about 23 ms at 100 kHz, which the
	  default clears by about two to one.

config I2C_MCHP_XEC_NL_ISR_CAPTURE
	bool "XEC I2C-NL capture ISR status on each interrupt"
	default n
	depends on I2C_MCHP_XEC_NL
	help
	  Capture I2C controller status, hcmd, tcmd, extlen, cmpl, and cfg registers
	  into a buffer on each interrupt.

config I2C_MCHP_XEC_NL_ISR_CAPTURE_NUM_ENTRIES
	int "XEC I2C-NL number of entries for capture ISR status on each interrupt"
	default 256
	depends on I2C_MCHP_XEC_NL_ISR_CAPTURE
	help
	  Number of interrupt state capture entries. Defaults to 256.
```
