## dts/bindings/i2c/microchip,xec-i2c-ctrl.yaml
```yaml
# Copyright (c) 2025 Microchip Technology Inc.
# SPDX-License-Identifier: Apache-2.0

description: Microchip I2C Controller byte-mode driver

compatible: "microchip,xec-i2c-ctrl"

include:
  - "base.yaml"
  - "pinctrl-device.yaml"
  - "microchip,dmec-ecia-girq.yaml"

properties:
  reg:
    required: true

  interrupts:
    required: true

  pinctrl-0:
    required: true

  pinctrl-names:
    required: true

  port-sel:
    type: int
    required: true
    description: |
      SoC I2C port pins the controller is connected to at driver
      initialization time. Note pinctrl-0 must contain the pins
      for the selected port. If CONFIG_I2C_PORT_SELECT is enable
      pinctrl-0 should contain pins for all the ports that will
      be used.

  pcrs:
    type: array
    required: true
    description: |
      I2C controller PCR sleep register index and bit position.
      Please refer to the SoC data sheet.

child-binding:
  description: I2C frequency timings

  properties:
    freq-timings:
      type: array
      description: |
        Array of tuples expressing non-default I2C controller timings.
        Each tuple contains 6 values, the desired I2C bus frequency
        followed by 5 controller timing register values. The driver
        supports standard I2C frequencies 100 KHz, 400 KHz, and 1 MHz.

freq-timing-cells:
  - i2c_freq
  - bus-timing
  - data-timing
  - start-hold-time
  - idle-scale
  - timeout-scale
```

## dts/bindings/i2c/microchip,xec-i2c-mux.yaml
```yaml
# Copyright (c) 2025 Microchip Technology Inc.
# SPDX-License-Identifier: Apache-2.0

description: |
  Microchip XEC I2C internal port multiplexer.

  The XEC SMB controller can route its SCL/SDA signals to one of 16
  physical bus ports via the PORT_SEL field in the Configuration Register.
  This binding represents the internal mux, with each child node
  corresponding to one bus port.

  Each child node is a standard I2C bus controller. Devices behind a
  specific port are defined as children of that port node.

  Example:

    i2c0_mux: i2c-mux {
        compatible = "microchip,xec-i2c-mux";
        i2c-parent = <&i2c0>;

        mux_port0: i2c@0 {
            reg = <0>;
            #address-cells = <1>;
            #size-cells = <0>;
            clock-frequency = <400000>;

            eeprom@50 {
                compatible = "atmel,at24";
                reg = <0x50>;
            };
        };

        mux_port5: i2c@5 {
            reg = <5>;
            #address-cells = <1>;
            #size-cells = <0>;
            clock-frequency = <100000>;
        };
    };

compatible: "microchip,xec-i2c-mux"

include: [base.yaml]

properties:
  i2c-parent:
    type: phandle
    required: true
    description: |
      Reference to the parent XEC I2C controller device that owns
      the PORT_SEL hardware mux.

  "#address-cells":
    type: int
    required: true
    const: 1

  "#size-cells":
    type: int
    required: true
    const: 0

child-binding:
  description: |
    XEC I2C mux port channel. The reg property specifies the PORT_SEL
    value (0-15) for this channel.
  bus: i2c

  properties:
    reg:
      type: array
      required: true
      description: |
        PORT_SEL value (0-15) identifying which physical bus port
        this channel routes to.

    clock-frequency:
      type: int
      description: |
        Optional per-channel I2C clock frequency in Hz. When present,
        the controller is reconfigured to this speed when switching to
        this port. When absent, the parent controller's current speed
        is used.

    sda-gpios:
      type: phandle-array
      description: |
        SDA pin GPIO for this port. Required on MEC172x (I2C v3.7)
        where pin state must be read via the GPIO driver. Not needed
        on MEC174x/175x/165xB (I2C v3.8) where the hardware can read
        pin state directly.

    scl-gpios:
      type: phandle-array
      description: |
        SCL pin GPIO for this port. Required on MEC172x (I2C v3.7).
        See sda-gpios description.

    "#address-cells":
      type: int
      required: true
      const: 1

    "#size-cells":
      type: int
      required: true
      const: 0
```

## dts/bindings/i2c/microchip,xec-i2c-v2.yaml
```yaml
# Copyright (c) 2019 Intel Corporation
# SPDX-License-Identifier: Apache-2.0

description: Microchip I2C/SMB V2 controller

compatible: "microchip,xec-i2c-v2"

include:
  - "i2c-controller.yaml"
  - "pinctrl-device.yaml"
  - "microchip,dmec-ecia-girq.yaml"

properties:
  reg:
    required: true

  port-sel:
    type: int
    description: soc block mapping to pin
    required: true

  pcr:
    type: int
    required: true
    description: |
      Encoded PCR index and bit position used for peripheral sleep enable
      and reset.

  pinctrl-0:
    required: true

  pinctrl-names:
    required: true
```

## dts/bindings/i2c/microchip,xec-i2c-v3-mux.yaml
```yaml
# Copyright (c) 2025 Microchip Technology Inc.
# SPDX-License-Identifier: Apache-2.0

description: |
  Microchip XEC I2C V3 port MUX.

  Each instance of this node represents one physical I2C bus reached
  through a specific port of a shared microchip,xec-i2c-v3 controller.
  The MUX driver owns the pinctrl state for its SCL/SDA pins and, on
  each transfer, asks the controller to switch to its port and bitrate
  before forwarding the operation. The controller serializes concurrent
  MUX access with its own mutex.

  Child nodes of the MUX are the I2C devices on that physical bus.

compatible: "microchip,xec-i2c-v3-mux"

include:
  - "i2c-controller.yaml"
  - "pinctrl-device.yaml"

properties:
  controller:
    type: phandle
    required: true
    description: Phandle to the microchip,xec-i2c-v3 controller node.

  port-sel:
    type: int
    required: true
    description: Port (0..15) to select on the controller for this bus.

  pinctrl-0:
    required: true

  pinctrl-names:
    required: true
```

## dts/bindings/i2c/microchip,xec-i2c-v3-nl-port.yaml
```yaml
# Copyright (c) 2026, Microchip Technology Inc.
# SPDX-License-Identifier: Apache-2.0

description: |
  Microchip XEC I2Cv3-NL virtual I2C Port routing mapping
  onto a physical multi-port hardware controller.

compatible: "microchip,xec-i2c-v3-nl-port"

# This property forces Zephyr to treat this virtual port node as an I2C master bus
include: i2c-controller.yaml

properties:
  controller:
    type: phandle
    required: true
    description: Phandle pointing to the underlying hardware I2C controller block.

  port:
    type: int
    required: true
    description: The physical channel/port index (e.g., 0 through 15) on the controller.

  default-port:
    type: boolean
    description: Optional flag signifying this is the boot/default physical channel routing.
```

## dts/bindings/i2c/microchip,xec-i2c-v3-port.yaml
```yaml
# Copyright (c) 2026 Microchip Technology Inc.
# SPDX-License-Identifier: Apache-2.0

description: |
  Microchip XEC I2C/SMB v3 port.

  A port represents one SCL/SDA pin pair that a microchip,xec-i2c-v3 controller
  can drive. Zephyr I2C applications bind to port nodes, not to the controller.
  Multiple ports may reference the same controller via the "controller" phandle;
  only one port is active at a time, and switching ports triggers a controller
  reset + pin-state resync.

  Each port carries its own clock-frequency and pinctrl state, so two ports on
  the same controller may run at different speeds.

compatible: "microchip,xec-i2c-v3-port"

include: ["i2c-controller.yaml", "pinctrl-device.yaml"]

properties:
  reg:
    required: true

  controller:
    type: phandle
    required: true
    description: Phandle to the microchip,xec-i2c-v3 controller this port drives.

  port:
    type: int
    required: true
    description: |
      Encoded controller/port selector. Bits [7:4] are the controller index and
      bits [3:0] are the port index for that controller. Build the value with
      MCHP_XEC_I2C_CTRL_PORT(ctrl, port) from
      <zephyr/dt-bindings/i2c/mchp-xec-i2c.h>.

  clock-frequency:
    required: true

  pinctrl-0:
    required: true

  pinctrl-names:
    required: true
```

## dts/bindings/i2c/microchip,xec-i2c-v3.yaml
```yaml
# Copyright (c) 2026, Microchip Technology Inc.
# SPDX-License-Identifier: Apache-2.0

description: Microchip XEC I2Cv3 byte mode I2C driver I2C

compatible: "microchip,xec-i2c-v3"

include: base.yaml

properties:
  reg:
    required: true
    description: MMIO Base address register mapping.

  interrupts:
    required: true
    description: Hardware interrupt vector assignment.

  girqs:
    type: int
    required: true
    description: |
      Hardware GIRQ encoded interrupt routing. Each peripheral
      interrupt line is routed to a GIRQ bit in the XEC ECIA.
      The GIRQ result bits which are bitwise AND of GIRQ enable
      and status are routed to the peripheral's NVIC input.
      The value is the encoded GIRQ number and bit position
      for this peripheral instance.

  pcr-scr:
    type: int
    required: true
    description: |
      Each peripheral instance has sleep enable, clock required, and
      reset bits in the PCR block. The value is the encoded PCR register
      index and bit position for the peripheral instance.
```

## dts/bindings/i3c/microchip,mchp-i3c.yaml
```yaml
# Copyright (C) 2020 Samsung Electronics Co., Ltd.
# Copyright (C) 2023 Meta Platforms
# Copyright (c) 2026 Microchip Inc.
# SPDX-License-Identifier: Apache-2.0

description: >
    This is a binding for the Microchip I3C interface

compatible: "microchip,mchp-i3c"

include:
  - name: i3c-controller.yaml
  - name: pinctrl-device.yaml
  - name: microchip,dmec-ecia-girq.yaml

properties:
  reg:
    required: true

  interrupts:
    required: true

  pcr-scr:
    type: int
    required: true
    description: |
      I3C Power Clock Reset(PCR) peripheral index and bit position

  port-sel:
    type: int
    description: soc block mapping to pin
    required: true

  pinctrl-0:
    type: phandles
    required: true

  pinctrl-names:
    type: string-array
    required: true

  input-clock-frequency:
    type: int
    required: true
    description: The controller input clock frequency
```

## dts/bindings/input/microchip,mec5-input-kscan.yaml
```yaml
# Copyright (c) 2024, Microchip Technology Inc.
# SPDX-License-Identifier: Apache-2.0

description: Microchip MEC5 keyboard scan matrix controller

compatible: "microchip,mec5-input-kscan"

include: [kbd-matrix-common.yaml, pinctrl-device.yaml]

properties:
  "#address-cells":
    required: true
    const: 1

  "#size-cells":
    type: int
    const: 0

  reg:
    required: true

  interrupts:
    required: true

  row-size:
    required: true

  col-size:
    required: true
```

## dts/bindings/interrupt-controller/microchip,xec-ecia-girq.yaml
```yaml
description: Microchip XEC series External Interrupt Aggregator GIRQ V2

compatible: "microchip,xec-ecia-girq"

include: base.yaml

properties:
    reg:
      required: true

    interrupts:
      required: true

    label:
      required: true

    source-bitmap:
      type: int
      required: true
      description: |
        Bit map of interrupt sources connected to this GIRQ. Maximum is 31
        sources (bit[31] is not used).

    girq-id:
       type: int
       required: true
       description: GIRQ ID number [0, 18]

    direct-enable:
      type: boolean
      required: false
      description: |
        If this GIRQ is direct capable use direct mode routing.
```

## dts/bindings/interrupt-controller/microchip,xec-ecia-v2.yaml
```yaml
description: Microchip XEC series EC Interrupt Aggregator GIRQ

compatible: "microchip,xec-ecia-v2"

include: ["base.yaml", "interrupt-controller.yaml"]

properties:
  reg:
    required: true

  interrupts:
    required: true

  direct-capable-bitmap:
    type: int
    description: |
      GIRQ allows its source to be routed directly to the ARM NVIC.
      If this properity is not present the GIRQ HW implementation
      cannot connect its interrupt sources individually to the NVIC.
      Instead all sources are wire-OR'd together producing one input
      to the NVIC. The ISR must scan all GIRQ result bits (OR of source
      and enable) and handle each active result bit.
```

## dts/bindings/interrupt-controller/microchip,xec-ecia.yaml
```yaml
description: Microchip XEC series External Interrupt Aggregator V2 Controller

compatible: "microchip,xec-ecia"

include: base.yaml

properties:
    reg:
      required: true

    label:
      required: true

    clocks:
      required: true

    directmap:
      type: int
      required: true
      description: |
        Bit map of GIRQ's capable of direct interrupt connections. This value
        is a constant and SoC specific.
```

## dts/bindings/introspect_i3c/microchip,introspect.yaml
```yaml
# Copyright (c) 2019 STMicroelectronics
# SPDX-License-Identifier: Apache-2.0

description: |
    STMicroelectronics LPS22HH pressure and temperature sensor connected to I3C
    bus

compatible: "microchip,introspect"

include: ["i3c-device.yaml"]
```

## dts/bindings/led/microchip,mec5-bbled.yaml
```yaml
# Copyright (c) 2024, Microchip Technology Inc.
# SPDX-License-Identifier: Apache-2.0

description: Microchip MEC5 BBLED

include: [base.yaml, pinctrl-device.yaml]

compatible: "microchip,mec5-bbled"

properties:
  reg:
    required: true

  interrupts:
    required: true
```

## dts/bindings/mbox/microchip,xec-mailbox.yaml
```yaml
#
# Copyright (c) 2025 Microchip Technology Inc.
#
# SPDX-License-Identifier: Apache-2.0
#

description: |
  Microchip XEC mailbox on eSPI peripheral channel.
  A 32-byte mailbox for communication between a Host system using
  eSPI bus connection to the XEC.

compatible: "microchip,xec-mailbox"

include: ["base.yaml", "mailbox-controller.yaml", "microchip,xec-peripheral.yaml"]

on-bus: espi

properties:
  reg:
    required: true

  interrupts:
    required: true

  girqs:
    required: true

  signal-mode-value:
    type: int
    required: true
    description: |
      Mailbox HW requires writing a value to the EC-to-Host register
      to trigger generation of a Serial-IRQ to the Host.

  "#mbox-cells":
    const: 1

mbox-cells:
  - channel
```
