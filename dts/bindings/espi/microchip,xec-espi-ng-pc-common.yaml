## dts/bindings/espi/microchip,xec-espi-ng-pc-common.yaml
```yaml
# Copyright (c) 2025 Microchip Technology Inc.
# SPDX-License-Identifier: Apache-2.0

description: |
  Microchip XEC eSPI next gen Peripheral Channel device common properties

include: ["base.yaml", "microchip,dmec-ecia-girq.yaml"]

on-bus: espi

properties:
  reg:
    required: true

  interrupts:
    required: true

  interrupt-names:
    required: true

  hostinfos:
    type: phandles
    required: true
    description:
      Handles to one or more nodes from the mchp-xec-espi-ng-pc-host-dev table.
```

## dts/bindings/espi/microchip,xec-espi-ng-pc-device.yaml
```yaml
# Copyright (c) 2025 Microchip Technology Inc.
# SPDX-License-Identifier: Apache-2.0

description: Microchip XEC eSPI next gen Host Logical Devices

compatible: "microchip,xec-espi-ng-pc-device"

include: [base.yaml]

child-binding:
  description: |
    Child node containing eSPI Peripheral Channel device Host properties
  properties:
    ldn:
      type: int
      required: true
      description: Host device logical device number.

    host-io-config-index:
      type: int
      required: true
      description: |
        Hardware host configuration index of the I/O BAR.
        The index is an 8-bit unsigned value. Refer to eSPI I/O
        base address register tables in the data sheet. A value of 0
        indicates logical device does not implement an I/O BAR.

    host-mem-config-index:
      type: int
      required: true
      description: |
        Hardware host configuration index of the memory BAR.
        The index is an 8-bit unsigned value. Refer to eSPI memory
        base base address register table in the data sheet. A value of 0
        indicates the logical device does not implement a memory BAR.

    host-address:
      type: int
      required: true
      description: |
        Host address the logical device appears at. On x86 systems this
        address may be I/O or memory space. Address values are interpreted
        as: 0 = disabled, [1, 0xffff] I/O space, [0x10000, UINT32_MAX]
        memory space.

    sirq-config-indexes:
      type: array
      description: |
        Array of chip specific configuration register index values for
        Serial-IRQ slot value. These values are constant for the chip.
        Refer to the eSPI Serial-IRQ assignement table in the data sheet.
        This array should have two entries. If a peripheral does not implement
        Serial-IRQs the value(s) should be 0.

    sirqs:
      type: array
      description: |
        Host Serial IRQ numbers assigned to the Serial-IRQ slots the device
        implements. A value of 255 indicates the slot is disabled.

        Example: KBC implements two Serial IRQ slots for keyboard and mouse
                 host interrupts. We map them to Serial-IRQ slots 1 and 12.
          sirqs = <1 12>;
        Example: UART0 implements one Serial IRQ slot at hardware index 9.
          sirqs = <3>;

    sirq-names:
      type: string-array
      description: |
        Names for the provided Serial IRQs. The number of names needs to match the
        number of sirqs.

    "#sirq-cells":
      type: int
      const: 1
```

## dts/bindings/espi/microchip,xec-espi-ng-sram-bar.yaml
```yaml
# Copyright (c) 2025 Microchip Technology Inc.
# SPDX-License-Identifier: Apache-2.0

description: Microchip XEC eSPI next gen SRAM BAR

compatible: "microchip,xec-espi-ng-sram-bar"

child-binding:
  description: |
    Child node containing eSPI SRAM BARs hardware. SRAM BAR allows
    mapping of a section of EC SRAM to the Host address space.
  properties:
    id:
      type: int
      required: true
      description: |
        Zero based SRAM BAR identification.

    host-mem-config-index:
      type: int
      required: true
      description: |
        Hardware host configuration index of the SRAM BAR.
        The index is an 8-bit unsigned value. Refer to eSPI SRAM base
        base address register table in the data sheet.

    host-address-lsw:
      type: int
      required: true
      description: |
        Low 32-bits of the Host address the EC SRAM can be accessed at.

    region-size:
      type: string
      required: true
      description: |
        Region size is powers of 2 from 0 to 15 creating regions from 1
        byte to 32KB. Note: hardware enforces region base address to
        be aligned on the size.
      enum:
        - "1B"
        - "2B"
        - "4B"
        - "8B"
        - "16B"
        - "32B"
        - "64B"
        - "128B"
        - "256B"
        - "512B"
        - "1KB"
        - "2KB"
        - "4KB"
        - "8KB"
        - "16KB"
        - "32KB"

    access:
      type: string
      required: true
      description: |
        Host access mode: disabled, read-only, write-only, and read-write.
      enum:
        - "DISABLED"
        - "READ_ONLY"
        - "WRITE_ONLY"
        - "READ_WRITE"
```

## dts/bindings/espi/microchip,xec-espi-ng-vwg.yaml
```yaml
# Copyright (c) 2025 Microchip Technology Inc.
# SPDX-License-Identifier: Apache-2.0

description: Microchip XEC eSPI next gen Virtual Wire groups

compatible: "microchip,xec-espi-ng-vwg"

child-binding:
  description: |
    Child node containing the routing of an eSPI virtual wire to the SoC
    VW registers and ECIA GIRQ registers.
  properties:
    host-index:
      type: int
      required: true
      description: VWire group host index.

    direction:
      type: string
      required: true
      description: |
        VWire group direction: downstream is Host to Target and
        upstream is Target to Host.
      enum:
        - "downstream"
        - "upstream"

    vw-reg-idx:
      type: int
      required: true
      description: |
        A zero based index into the Microchip XEC VWire registers
        which will be configured for this host index. Hardware power
        on defaults implement the Host index mapping in Intel's eSPI
        specification.

    vw-mask:
      type: int
      required: true
      description: |
        Bits[3:0] are a bit mask of VWires implemented in this group.
        The mask value should reflect the eSPI specification and HW
        implementation.

    reset-source:
      type: string
      required: true
      description: |
        All VWire group registers are reset on power on and chip reset.
        This field allows one additional source of a VWire group. These
        additional sources are: eSPI reset, platform reset, and VCC power
        good.
      enum:
        - "reset_espi"
        - "reset_sys"
        - "reset_sio"
        - "pltrst"

    reset-state:
      type: int
      required: true
      description: |
        Integer where bits[3:0] contain the reset state of the four
        VWires in this group.

    irq-selects:
      type: array
      description: |
        An array of 4 integers specifying the interrupt detection
        mode for each of the four VWires in the group. For unimplemented
        VWires use the NONE specifier. Note: XEC hardware
        implements interrupt detection only for Host-to-Target VWires.

    source-names:
      type: string-array
      description: |
        Names from Zephyr eSPI driver enum espi_vwire_signal.
        If present these names allow the appliation to use the eSPI
        driver VWire send and receive APIs. The application can also
        extend driver support to use some of the generic VWires the
        XEC hardware supports.  NOTE 1: if the Zephyr enum names are
        modified the driver will break! NOTE 2: all four names must
        be present. Use "NONE" for reserved source bits in a group.
      enum:
        - "slp_s3"
        - "slp_s4"
        - "slp_s5"
        - "oob_rst_warn"
        - "pltrst"
        - "sus_stat"
        - "nmiout"
        - "smiout"
        - "host_rst_warn"
        - "slp_a"
        - "sus_pwrdn_ack"
        - "sus_warn"
        - "slp_wlan"
        - "slp_lan"
        - "host_c10"
        - "dnx_warn"
        - "pme"
        - "wake"
        - "oob_rst_ack"
        - "target_boot_sts"
        - "err_non_fatal"
        - "err_fatal"
        - "target_boot_done"
        - "host_rst_ack"
        - "rst_cpu_init"
        - "smi"
        - "sci"
        - "dnx_ack"
        - "sus_ack"
        - "target_gpio_0"
        - "target_gpio_1"
        - "target_gpio_2"
        - "target_gpio_3"
        - "target_gpio_4"
        - "target_gpio_5"
        - "target_gpio_6"
        - "target_gpio_7"
        - "target_gpio_8"
        - "target_gpio_9"
        - "target_gpio_10"
        - "target_gpio_11"
        - "target_gpio_12"
        - "target_gpio_13"
        - "target_gpio_14"
        - "target_gpio_15"
        - "target_gpio_16"
        - "target_gpio_17"
        - "target_gpio_18"
        - "target_gpio_19"
        - "vw_max"
```

## dts/bindings/espi/microchip,xec-espi-ng.yaml
```yaml
# Copyright (c) 2025 Microchip Technology Inc.
# SPDX-License-Identifier: Apache-2.0

description: Microchip XEC ESPI controller next gen driver

compatible: "microchip,xec-espi-ng"

include: ["espi-controller.yaml", "pinctrl-device.yaml", "microchip,dmec-ecia-girq.yaml"]

properties:
  reg:
    description: controller memory mapped register spaces
    required: true

  reg-names:
    required: true
    description: array of register space names

  pinctrl-0:
    required: true

  pinctrl-names:
    required: true

  espi-alert-od-capable:
    type: boolean
    description: |
      Platform supports ESPI_ALERT# signal as opendrain in addition
      to push-pull. If this property is present it allows the Host
      eSPI Controller to select push-pull versus open-drain for
      this signal.

  espi-max-supp-freq-mhz:
    type: string
    default: "50"
    description: |
      Maximum supported frequency in MHz this eSPI target controller reports
      to the eSPI Host Controller.
    enum:
      - "20"
      - "25"
      - "33"
      - "50"
      - "66"

  espi-io-mode:
    type: string
    default: "IO124"
    description: |
      I/O mode(s) supported by this eSPI target controller exposed to
      the eSPI Host Controller via capability registers. The target may
      report single, single/dual, single/quad, or single/dual/quad.
    enum:
      - "IO1"
      - "IO12"
      - "IO14"
      - "IO124"

  config-io-addr:
    type: int
    required: true
    description: |
      Host I/O base address for the eSPI legacy I/O configuration port.

  ec-sirq:
    type: int
    description: |
      Serial IRQ slot number for eSPI driver generated software SIRQ.
      Default is 255 (disabled).

  host-memmap-addr-high:
    type: int
    required: true
    description: |
      Contains bits [47:32] of the Host address range where all memory mapped
      host (logical) devices are mapped.

  sram-bar-addr-high:
    type: int
    required: true
    description: |
      Contains Host address bits [47:32] where both SRAM BAR's are mapped.
```

## dts/bindings/espi/microchip,xec-espi-saf.yaml
```yaml
# Copyright (c) 2019 Intel Corporation
# SPDX-License-Identifier: Apache-2.0

description: Microchip ESPI SAF controller

compatible: "microchip,xec-espi-saf"

include: espi-controller.yaml

properties:
    reg:
      description: mmio register space
      required: true

    prmap:
      type: array
      description: protection region mapping
      required: false

    io_girq:
      type: int
      description: soc group irq index for eSPI I/O
      required: false
```

## dts/bindings/gpio/microchip,mec5-gpio.yaml
```yaml
# Copyright (c) 2024, Microchip Technology Inc.
# SPDX-License-Identifier: Apache-2.0

description: Microchip MEC5 GPIO

compatible: "microchip,mec5-gpio"

include:
  - "base.yaml"
  - "gpio-controller.yaml"
  - "microchip,dmec-ecia-girq.yaml"

properties:
  reg:
    required: true

  "#gpio-cells":
    const: 2

gpio-cells:
  - pin
  - flags
```

## dts/bindings/gpio/microchip,xec-gpio-ng.yaml
```yaml
# Copyright (c) 2024, Microchip Technology Inc.
# SPDX-License-Identifier: Apache-2.0

description: Microchip XEC next gen GPIO shared driver

compatible: "microchip,xec-gpio-ng"

include: ["gpio-controller.yaml", "base.yaml", "microchip,dmec-ecia-girq.yaml"]

properties:
  reg:
    required: true

  "#gpio-cells":
    const: 2

gpio-cells:
  - pin
  - flags
```

## dts/bindings/i2c/microchip,mec5-i2c-nl.yaml
```yaml
# Copyright (c) 2024 Microchip Technology Inc.
# SPDX-License-Identifier: Apache-2.0

description: Microchip MEC5 HAL based I2C/SMB with Network Layer controller

compatible: "microchip,mec5-i2c-nl"

include: [i2c-controller.yaml, pinctrl-device.yaml]

properties:
  reg:
    required: true

  pinctrl-0:
    required: true

  pinctrl-names:
    required: true

  port_sel:
    type: int
    description: Port mux number matching pinctrl-0 pins.
    required: true

  scl-gpios:
    type: phandle-array
    required: true
    description: I2C clock line gpio info

  sda-gpios:
    type: phandle-array
    required: true
    description: I2C data line gpio handle

  init-pin-wait:
    type: int
    default: 100
    description: |
      Amount of time in microseconds allowing the controller to sample
      pins during driver initialization. If not present default is 100.

  config-pin-wait:
    type: int
    default: 35000
    description: |
      Amount of time in microseconds allowing the controller to sample
      pins after controller is enabled during configuration. If not
      present the default is 35000 (the SMBus bus timeout).

  cm-dma-chan:
    type: int
    required: true
    description: DMA channel used by I2C-NL for Controller mode transfers.

  cm-dma-req-id:
    type: int
    required: true
    description: |
      I2C Controller mode hardware flow control ID required by DMA channel.

  tm-dma-chan:
    type: int
    required: true
    description: |
      DMA channel used by I2C-NL for Target mode transfers.

  tm-dma-req-id:
    type: int
    required: true
    description: |
      I2C Target mode hardware flow control ID required by DMA channel.

  cm-tx-buffer-size:
    type: int
    default: 64
    description: |
      Controller mode driver buffer size in bytes. CM buffer used to
      build transmit data packet for initial I2C start. The driver
      will buffer as much of the transmit data into this buffer. Remaining
      data will be handling by TX DMA reload callback.

  tm-tx-buffer-size:
    type: int
    default: 64
    description: |
      Target mode driver transmit buffer size in bytes. TM mode requires
      a driver buffer to supply data requested by an external I2C controller
      read. Application fills this buffer via target mode callbacks.


  tm-rx-buffer-size:
    type: int
    default: 64
    description: |
      Target mode driver receive buffer size in bytes. TM mode requires
      a driver buffer to receive data transmitted by an external I2C controller
      write.
```

## dts/bindings/i2c/microchip,mec5-i2c.yaml
```yaml
# Copyright (c) 2024 Microchip Technology Inc.
# SPDX-License-Identifier: Apache-2.0

description: Microchip MEC5 I2C-SMB controller

compatible: "microchip,mec5-i2c"

include: [i2c-controller.yaml, pinctrl-device.yaml]

properties:
  reg:
    required: true

  port_sel:
    type: int
    description: soc block mapping to pin
    required: true

  pinctrl-0:
    required: true

  pinctrl-names:
    required: true
```
