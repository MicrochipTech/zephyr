## dts/bindings/ps2/microchip,xec-ps2.yaml
```yaml
# Copyright (c) 2019, Intel Corporation
# SPDX-License-Identifier: Apache-2.0

description: Microchip XEC PS/2 controller

compatible: "microchip,xec-ps2"

include: ps2.yaml

properties:
    reg:
      required: true

    interrupts:
      required: true

    girqs:
      type: array
      required: true
      description: array of GIRQ numbers and GIRQ bit position

    "#girq-cells":
      type: int
      const: 2

girq-cells:
    - girq_id
    - girq_bit
```

## dts/bindings/pwm/microchip,xec-pwmbbled.yaml
```yaml
# Copyright (c) 2019, Intel Corporation
# SPDX-License-Identifier: Apache-2.0

description: Microchip XEC PWM using BBLED hardware

include: [pwm-controller.yaml, base.yaml, pinctrl-device.yaml]

compatible: "microchip,xec-pwmbbled"

properties:
  reg:
    required: true

  interrupts:
    required: true

  girqs:
    type: array
    required: true
    description: Array of pairs of GIRQ number and bit position

  pcrs:
    type: array
    required: true
    description: BBLED PCR register index and bit position

  clock-select:
    type: string
    required: true
    description: |
      Clock source selection: 32 KHz is available in deep sleep.
      - PWM_BBLED_CLK_AHB: Clock source is the PLL based AHB clock
      - PWM_BBLED_CLK_SLOW: Clock source is the PLL based PCR slow clock
      - PWM_BBLED_CLK_32K: Clock source is the 32KHz domain
    enum:
      - "PWM_BBLED_CLK_32K"
      - "PWM_BBLED_CLK_SLOW"
      - "PWM_BBLED_CLK_48M"

  pinctrl-0:
    required: true

  pinctrl-names:
    required: true

  "#pwm-cells":
    const: 2

  enable-low-power-32k:
    type: boolean
    description: |
      Used to gates off 32K clock and turn off LEDs during sleep.
      This applicable only to 32K clock, because in 48MHz clock
      will be always turned off in low power by PCR.

pwm-cells:
  - channel
  - period
```

## dts/bindings/rng/microchip,mec5-trng.yaml
```yaml
# Copyright (c) 2024, Microchip Technology Inc.
# SPDX-License-Identifier: Apache-2.0

description: Microchip NDRNG using Boot-ROM API

compatible: "microchip,mec5-trng"

include: base.yaml

properties:
  reg:
    required: true

  interrupts:
    required: true
```

## dts/bindings/serial/microchip,xec-uart.yaml
```yaml
description: Microchip XEC UART

compatible: "microchip,xec-uart"

include: [uart-controller.yaml, pinctrl-device.yaml]

properties:
    reg:
      required: true

    interrupts:
      required: true

    ldn:
      type: int
      required: true
      description: logical device number

    pinctrl-0:
      required: true

    pinctrl-names:
      required: true

    girqs:
      type: array
      required: true
      description: UART GIRQ and bit position in EC interrupt aggregator

    pcrs:
      type: array
      required: true
      description: UART Power Clock Reset(PCR) register index and bit position

    "#girq-cells":
      type: int
      const: 2

    "#pcr-cells":
      type: int
      const: 2

girq-cells:
    - girq_num
    - bitpos

pcr-cells:
    - reg_idx
    - bitpos
```

## dts/bindings/spi/microchip,xec-gpspi.yaml
```yaml
# Copyright (c) 2022, Microchip Technology Inc.
# SPDX-License-Identifier: Apache-2.0

description: Microchip XEC GP-SPI controller

compatible: "microchip,xec-gpspi"

include: [spi-controller.yaml, pinctrl-device.yaml]

properties:
    reg:
      required: true

    girqs:
      type: array
      required: true
      description: |
        An array of integers encoding each interrupt signal connection.
        This information includes the aggregated GIRQ number, GIRQ bit
        position, aggregated GIRQ NVIC connection, and direct NVIC
        connection of the GIRQ bit.

    pcrs:
      type: array
      required: true
      description: |
        A two entry integer array containing the QMSPI PCR sleep register
        index and bit position.

    pinctrl-0:
      required: true

    pinctrl-names:
      required: true

    dmas:
      description: |
        Optional TX & RX dma specifiers.  Each specifier will have a phandle
        reference to the dmac controller, the channel number, and peripheral
        trigger source.

        For example dmas for TX, RX on GPSPI
           dmas = <&dmac 0 12>, <&dmac 1 13>;

    dma-names:
      description: |
        Required if the dmas property exists.  This should be "tx" and "rx"
        to match the dmas property.

        For example
           dma-names = "tx", "rx";
```

## dts/bindings/timer/microchip,xec-btimer.yaml
```yaml
# Copyright (c) 2025 Microchip Technology Inc.
# SPDX-License-Identifier: Apache-2.0

description: Microchip XEC series basic timer properties

compatible: "microchip,xec-btimer"

include: ["base.yaml", "microchip,dmec-ecia-girq.yaml"]

properties:
  reg:
    required: true

  interrupts:
    required: true

  clock-frequency:
    type: int
    required: true
    const: 48000000
    description: |
      XEC basic timers input frequency is 48 MHz. Counter rate is
      scaled down using a prescaler.

  prescaler:
    type: int
    required: true
    description: |
      XEC basic timers implement a 16-bit prescaler used to derive
      the counter frequency.
      Count frequency = clock_freq / (prescaler + 1)

  max-value:
    type: int
    required: true
    description: |
      XEC basic timers are a mix of 16 and 32 bit counters.
      We specify the maximum counter value here.
```

## dts/bindings/timer/microchip,xec-cct-ktimer.yaml
```yaml
# Copyright (c) 2026 Microchip Technology Inc.
# SPDX-License-Identifier: Apache-2.0

description: |
  Microchip XEC capture compare timer used as Zephyr's kernel timer

compatible: "microchip,xec-cct-ktimer"

include: ["base.yaml", "microchip,dmec-ecia-girq.yaml"]

properties:
  reg:
    required: true

  interrupts:
    required: true

  interrupt-names:
    required: true

  pcr-scr:
    type: int
    required: true
    description: |
      Encoded PCR register index and bit position for sleep enable,
      clock required, and peripheral reset.

  input-clock:
    type: int
    required: true
    const: 48000000
    description: Capture compare timer input frequency
```

## dts/bindings/watchdog/microchip,mec5-watchdog.yaml
```yaml
# Copyright (c) 2019, Intel Corporation
# SPDX-License-Identifier: Apache-2.0

description: Microchip MEC5 HAL based watchdog timer

include: base.yaml

compatible: "microchip,mec5-watchdog"

properties:
  reg:
    required: true

  interrupts:
    required: true
```

## dts/bindings/watchdog/microchip,xec-watchdog.yaml
```yaml
# Copyright (c) 2019, Intel Corporation
# SPDX-License-Identifier: Apache-2.0

description: Microchip XEC watchdog timer

include: base.yaml

compatible: "microchip,xec-watchdog"

properties:
    reg:
      required: true

    label:
      required: true

    interrupts:
      required: true

    girqs:
      type: array
      required: true
      description: array of GIRQ numbers and GIRQ bit position

girq-cells:
    - girq_id
    - girq_bit
```

## samples/boards/mchp_mec5/vci_google/dts/bindings/microchip,ec-hibernate-vci.yaml
```yaml
# Copyright (c) 2024
# SPDX-License-Identifier: Apache-2.0

description: Microchip EC Hibernate VCI pins

compatible: "microchip,ec-hibernate-vci"

child-binding:
  description: VCI child node
  properties:
    gpios:
      required: true
      type: phandle-array
      description: Reference to a VCI instance.

    vci-pos:
      required: true
      type: int
      description: Bit position in VCI registers
    
    vci-polarity:
      required: true
      type: string
      description: VCI input polarity (0=active low)
      enum:
        - "Active_Low"
        - "Active_High"

    vci-latch-enable:
      type: boolean
      description: If present enable latching of VCI input
```

## samples/boards/mchp_mec5/vci_google/sample.yaml
```yaml
tests:
  boards.mchp_mec.vci_google:
    build_only: true
    platform_allow:
      - mec_assy6906_mech1723nsz
      - mec_assy6906_mech1723nlj
      - mec_assy6941_mec1743qlj
      - mec_assy6941_mec1743qsz
      - mec_assy6941_mec1753qlj
      - mec_assy6941_mec1753qsz
    tags: drivers i2c
```

## samples/boards/mec172xevb_assy6906/pin_test/testcase.yaml
```yaml
tests:
  boards.mec172xevb_assy6906.pin_test:
    platform_allow: mec172xevb_assy6906
    tags: drivers gpio pinctrl
```

## samples/boards/mec172xevb_assy6906/rom_api/sample.yaml
```yaml
sample:
  description: MEC172x EVB ROM API sample application
  name: rom_api
common:
  harness: console
tests:
  boards.mec172xevb_assy6906.qspi:
    platform_allow: mec172xevb_assy6906
    tags: drivers crypto
```
