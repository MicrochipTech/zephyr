## dts/bindings/memory-controllers/microchip,mec5-bbram.yaml
```yaml
# Copyright (c) 2024 Microchip Technologies Inc.
# SPDX-License-Identifier: Apache-2.0

description: Microchip MEC5 family Battery Backed RAM node

compatible: "microchip,mec5-bbram"

include: base.yaml

properties:
  reg:
    required: true
```

## dts/bindings/misc/microchip,xec-peripheral.yaml
```yaml
# Copyright (c) 2025 Microchip Technologies Inc.
# SPDX-License-Identifier: Apache-2.0

description: Microchip XEC peripheral device common properites

include: base.yaml

properties:
  girqs:
    type: array
    description: |
      XEC peripherals with interrupt capability route their interrupt
      signal(s) through the EC Interrupt Aggregator (ECIA). The peripheral
      interrupt signal(s) and corresponding enables in the ECIA GIRQ are
      combined to produce a result signal. Most result signals are connected
      directly to the Cortex-M NVIC. Each peripheral with interrupts needs
      the ECIA GIRQ number(s) and bit position(s).
```

## dts/bindings/mspi/microchip,mec-qmspi-controller.yaml
```yaml
# Copyright (c) 2026 Microchip Technology Inc. and its subsidiaries.
# SPDX-License-Identifier: Apache-2.0

description: Microchip MEC QMSPI MSPI controller

compatible: "microchip,mec-qmspi-controller"

include: [mspi-controller.yaml, pinctrl-device.yaml]

properties:
  reg:
    required: true

  interrupts:
    required: true

  pinctrl-0:
    required: true

  pinctrl-names:
    required: true

  clock-frequency:
    type: int
    required: true
    description: |
      QMSPI input clock frequency in Hz. For MEC175x this is 96000000.

  pcr:
    type: array
    required: true
    description: |
      PCR sleep control register encoding for power gating this peripheral.

  girqs:
    type: array
    required: true
    description: |
      GIRQ and bit-position encoding for this peripheral interrupt source.

  chip-select-count:
    type: int
    default: 1
    description: |
      Number of hardware chip selects available (1 or 2).
```

## dts/bindings/mspi/microchip,mspi-xec-qmspi.yaml
```yaml
# Copyright (c) 2026, Microchip Technology Inc.
# SPDX-License-Identifier: Apache-2.0

description: Microchip XEC QMSPI MSPI controller

compatible: "microchip,mspi-xec-qmspi"

include: [mspi-controller.yaml, pinctrl-device.yaml]

properties:
  reg:
    required: true

  interrupts:
    required: true

  software-multiperipheral:
    required: true

  girqs:
    type: array
    required: true
    description:
      Array of encoded GIRQ number and bit position.

  pcr:
    type: int
    required: true
    description:
      Encoded PCR register index and bit position for
      sleep enable, clock required, and block reset.
```

## dts/bindings/mspi/microchip,xec-mspi-controller.yaml
```yaml
# Copyright (c) 2026, Microchip Technology Inc.
# SPDX-License-Identifier: Apache-2.0

description: Microchip XEC MSPI driver using QMSPI controller

compatible: "microchip,xec-mspi-controller"

include: [mspi-controller.yaml, pinctrl-device.yaml]

properties:
  reg:
    required: true

  interrupts:
    required: true

  pinctrl-0:
    required: true

  pinctrl-names:
    required: true

  girqs:
    type: array
    required: true
    description: |
      Array of encoded GIRQ number and bit position for each interrupt
      the peripheral implements.

  pcr:
    type: int
    required: true
    description: |
      Encoded index and bit position in PCR sleep enable, clock required,
      and reset enable registers.

  cpp-mode:
    type: int
    description: |
      The controller transmit and receive clock phase modes.
      The values are the standard SPI signalling modes 0 through 3.
      If the property is not present the driver defaults to mode 0.

  dcsda:
    type: int
    description: |
      Delay in units of 10 ns from nCS de-assertion to nCS asserion.
      If property is not presetn use hardware default of 6 (60 ns)

  ctrl-taps:
    type: array
    description: |
      An array of integers representing the control tap point for
      each of the two chip selects. Each value is in [0, 255].
      The hardware default is 0. The property is only needed to
      tune the signals to an external flash at 96 MHz.

  tx-fifo-depth:
    type: int
    default: 8
    description: Controller TX FIFO size in bytes.

  rx-fifo-depth:
    type: int
    default: 8
    description: Controller RX FIFO size in bytes.
```

## dts/bindings/mspi/microchip,xec-mspi-ldma.yaml
```yaml
# Copyright (c) 2025, Microchip Technology Inc.
# SPDX-License-Identifier: Apache-2.0

description: Microchip XEC mulit-bit SPI using QMSPI-LDMA

compatible: "microchip,xec-mspi-ldma"

include: ["mspi-controller.yaml", "pinctrl-device.yaml", "microchip,dmec-ecia-girq.yaml"]

properties:
  op-mode:
    default: "MSPI_OP_MODE_CONTROLLER"

  reg:
    required: true

  interrupts:
    required: true

  pinctrl-0:
    required: true

  pinctrl-names:
    required: true

  pcr:
    type: int
    required: true
    description: |
      Integer encoding the PCR register index and bit position
      of this I2C controller.

  dcsda:
    type: int
    description: |
      Delay in units of 10 ns from CS# de-assertion to CS# assertion.
      If not present use hardware default value of 6.

  ctrl-taps:
    type: array
    description: |
      An array of integers representing the control tap points for
      each of the two chip selects. Each value is in [0, 255]. 0 is HW default.
      This property may only be required for 96 MHz operation and is
      board layout dependent. Refer to the data sheet for control tap description.

  clock-taps:
    type: array
    description: |
      An array of integers representing the clock tap points for
      each of the two chip selects. Each value is in [0, 255]. 0 is HW default.
      This property may only be required for 96 MHz operation and is
      board layout dependent. Refer to data sheet for details.
```

## dts/bindings/mspi/microchip,xec-qspi-mspi.yaml
```yaml
# Copyright (c) 2026, Microchip Technology Inc.
# SPDX-License-Identifier: Apache-2.0

description: Microchip XEC mulit-bit SPI using QSPI-LDMA

compatible: "microchip,xec-qspi-mspi"

include: ["mspi-controller.yaml", "pinctrl-device.yaml", "microchip,dmec-ecia-girq.yaml"]

properties:
  op-mode:
    default: "MSPI_OP_MODE_CONTROLLER"

  reg:
    required: true

  interrupts:
    required: true

  pinctrl-0:
    required: true

  pinctrl-names:
    required: true

  pcr-scr:
    type: int
    required: true
    description: |
      Integer encoding the PCR register index and bit position
      of this I2C controller.

  num-hw-ce:
    type: int
    required: true
    description: |
      Current QSPI controller hardware implements direct control of two
      chip enables. Software must select the chip enable and QSPI controls
      the assert/de-assertion based on timing parameters in the CS timing
      register. This property lets the application build the driver with
      support for 0, 1, or 2 HW controlled chip selects. The driver also
      supports GPIO pins as chip selects. Use the mspi-hardware-ce-num
      property in the flash child device node to indicate the flash device
      is connected to.

  dcsda:
    type: int
    description: |
      Delay in units of 10 ns from CS# de-assertion to CS# assertion.
      If not present use hardware default value of 6.

  ctrl-taps:
    type: array
    description: |
      An array of integers representing the control tap points for
      each of the two chip selects. Each value is in [0, 255]. 0 is HW default.
      This property may only be required for 96 MHz operation and is
      board layout dependent. Refer to the data sheet for control tap description.

  clock-taps:
    type: array
    description: |
      An array of integers representing the clock tap points for
      each of the two chip selects. Each value is in [0, 255]. 0 is HW default.
      This property may only be required for 96 MHz operation and is
      board layout dependent. Refer to data sheet for details.
```

## dts/bindings/mtd/microchip,mec5-eeprom.yaml
```yaml
# Copyright (c) 2024 Microchip Technology Inc.
# SPDX-License-Identifier: Apache-2.0

description: Microchip MEC5 HAL based on-chip EEPROM

compatible: "microchip,mec5-eeprom"

include: [eeprom-base.yaml, pinctrl-device.yaml]

properties:
  reg:
    required: true

  interrupts:
    required: true

  page-size:
    type: int
    default: 32
    description: |
      Internal EEPROM page size in bytes. Reads may cross page boundaries.
      Writes can be up to a page size but cannot cross a page boundary.

  page-read-time-ms:
    type: int
    default: 1
    description: |
      Page read time in microseconds.

  write-time-ms:
    type: int
    default: 5
    description: |
      Write (erase-program) timing of any size(1 byte to page size)
      in milliseconds.

  lock-password:
    type: int
    description: |
      Optional 31-bit password used to lock/unlock the EEPROM.
      If property is present the driver will write this value
      to the EEPROM controller lock register during driver
      initialization.

  lock-jtag-active:
    type: boolean
    description: |
      Lock the EEPROM controller if JTAG/SWD debug interface is active.
      This overrides the normal lock/unlock feature.
```

## dts/bindings/peci/microchip,xec-peci.yaml
```yaml
# Copyright (c) 2020, Intel Corporation
# SPDX-License-Identifier: Apache-2.0

description: Microchip XEC PECI controller

compatible: "microchip,xec-peci"

include: peci.yaml

properties:
    reg:
      required: true

    interrupts:
      required: true

    girqs:
      type: array
      required: true
      description: array of GIRQ numbers and GIRQ bit position

    "#girq-cells":
      type: int
      const: 2

girq-cells:
    - girq_id
    - girq_bit
```

## dts/bindings/pinctrl/microchip,xec-pinctrl-conf.yaml
```yaml
# Copyright (c) 2020 Linaro Limited
# Copyright (c) 2021 Microchip Technology Inc.
# SPDX-License-Identifier: Apache-2.0

description: |
    Microchip XEC Pin controller Node
    Based on pincfg-node.yaml binding.

    Note: `bias-disable` and `drive-push-pull` are default pin configurations.
           They will be applied in case no `bias-foo` or `driver-bar` properties
           are set.

compatible: "microchip,xec-pinctrl-conf"

include:
    - name: base.yaml
    - name: pincfg-node.yaml
      child-binding:
        property-allowlist:
          - bias-disable
          - bias-pull-down
          - bias-pull-up
          - drive-push-pull
          - drive-open-drain

properties:
    reg:
      required: true

child-binding:
    description: |
        This binding gives a base representation of the Microchip XEC pins
        configration

    properties:
        pinctrls:
            type: phandle-array
            required: true
            description: Pin alternate function selection

        slew-rate:
          required: false
          type: string
          default: "low-speed"
          enum:
          - "low-speed"           # Default value.
          - "high-speed"
          description: Pin speed. Default to low-speed.
```

## dts/bindings/pinctrl/microchip,xec-pinctrl.yaml
```yaml
# Copyright (c) 2020 Linaro Limited
# Copyright (c) 2021 Microchip Technology Inc.
# SPDX-License-Identifier: Apache-2.0

description: |
    Microchip XEC Pin controller Node
    Based on pincfg-node.yaml binding.
    The MCHP XEC pin controller is a singleton node responsible for controlling
    pin function selection and pin properties. For example, you can use this
    node to select peripheral pin functions. For example, I2C

    The node has the 'pinctrl' node label set in your SoC's devicetree,
    so you can modify it like this:

      &pinctrl {
              /* your modifications go here */
      };

    All device pin configurations should be placed in child nodes of the
    'pinctrl' node, as shown in this example:

    A group can also specify shared pin properties common to all the specified
    pins, such as the 'bias-pull-up' property in group 2. Here is a list of
    supported standard pin properties:

    - bias-disable: Disable pull-up/down (default behavior, not required).
    - bias-pull-down: Enable pull-down resistor.
    - bias-pull-up: Enable pull-up resistor.
    - drive-push-pull: Output driver is push-pull (default, not required).
    - drive-open-drain: Output driver is open-drain.
    - output-high: Set output state high when pin configured.
    - output-low: Set output state low when pin configured.

    Custom pin properties for drive strength and slew rate are available:
    - drive-strength
    - slew-rate

    Driver strength and slew rate hardware defaults vary by SoC and pin.
    The "hw-default" setting tell the pinctrl code to not touch the slew
    rate or drive strength settings for the respective pin.

    An example for MEC172x family, include the chip level pinctrl
    DTSI file in the board level DTS:

      #include <microchip/mec172x/mec172xnsz-pinctrl.dtsi>

      We want to use the shared SPI port of the MEC172x QMSPI controller
      and want the chip select 0 to be open-drain.

      To change a pin's pinctrl default properties add a reference to the
      pin in the board's DTS file and set the properties.

      &spi0 {
        pinctrl-0 = < &pinctrl_qint_cs0
                      &pinctrl_qint_clk
                      &pinctrl_qint_io0
                      &pinctrl_qint_io1
                      &pinctrl_qint_wpn >;
        pinctrl-names = "default";
     }

     &pinctrl_qint_cs0 {
        drive-open-drain;
     };

compatible: "microchip,xec-pinctrl"

include:
    - name: base.yaml
    - name: pincfg-node.yaml
      child-binding:
        property-allowlist:
          - bias-disable
          - bias-pull-down
          - bias-pull-up
          - drive-push-pull
          - drive-open-drain
          - output-high
          - output-low

properties:
    reg:
      required: true

child-binding:
    description: |
        This binding gives a base representation of the Microchip XEC pins
        configration

    properties:
        pinmux:
            type: int
            required: true
            description: Pinmux selection

        slew-rate:
          required: false
          type: string
          default: "hw-default"
          enum:
          - "hw-default"        # Default value
          - "low-speed"
          - "high-speed"
          description: Pin speed.

        drive-strength:
          required: false
          type: string
          default: "hw-default"
          enum:
            - "hw-default"      # Default value
            - "2mA"
            - "4mA"
            - "8mA"
            - "12mA"
          description: Pin output drive strength.
```

## dts/bindings/ps2/microchip,mec5-ps2.yaml
```yaml
# Copyright (c) 2024, Microchip Technology Inc.
# SPDX-License-Identifier: Apache-2.0

description: Microchip PS/2 target interface for MEC5 HAL based SoCs

compatible: "microchip,mec5-ps2"

include: [ps2.yaml, pinctrl-device.yaml]

properties:
  reg:
    required: true

  interrupts:
    required: true

  port:
    type: int
    description:
      Represents the clock and data pin pair connected to the PS/2
      target interface. Data sheet port A is 0 and port B is 1. Only
      one PS/2 pin pair may be connected to the target interface. Also,
      not all PS/2 target interface support more than one port.

  wakerx-gpios:
    type: phandle-array
    description: PS2 DATA GPIO configured as wake source
```
