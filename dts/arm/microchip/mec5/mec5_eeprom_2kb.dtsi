/*
 * Copyright (c) 2024 Microchip Technology Inc.
 *
 * SPDX-License-Identifier: Apache-2.0
 */

/* MEC5 EEPROM controller with internal 2 kilobyte EEPROM */
eeprom: eeprom@40002c00 {
	compatible = "microchip,mec5-eeprom";
	reg = <0x40002c00 0x400>;
	interrupts = <155 2>;
	size = <2048>;
	page-size = <32>;
	status = "disabled";
};
