/*
 * Copyright (c) 2023 Microchip Technology Inc.
 *
 * SPDX-License-Identifier: Apache-2.0
 */

#include <zephyr/dt-bindings/pinctrl/mchp-xec-pinctrl.h>

&pinctrl {
	/* ADC */
	/omit-if-no-ref/ pin_adc00: adc00_gpio200 {
		pinmux = <MCHP_XEC_PINMUX(0200, MCHP_AF1)>;
	};

	/omit-if-no-ref/ pin_adc01: adc01_gpio201 {
		pinmux = <MCHP_XEC_PINMUX(0201, MCHP_AF1)>;
	};

	/omit-if-no-ref/ pin_adc02: adc02_gpio202 {
		pinmux = <MCHP_XEC_PINMUX(0202, MCHP_AF1)>;
	};

	/omit-if-no-ref/ pin_adc03: adc03_gpio203 {
		pinmux = <MCHP_XEC_PINMUX(0203, MCHP_AF1)>;
	};

	/omit-if-no-ref/ pin_adc04: adc04_gpio204 {
		pinmux = <MCHP_XEC_PINMUX(0204, MCHP_AF1)>;
	};

	/omit-if-no-ref/ pin_adc05: adc05_gpio205 {
		pinmux = <MCHP_XEC_PINMUX(0205, MCHP_AF1)>;
	};

	/omit-if-no-ref/ pin_adc06: adc06_gpio206 {
		pinmux = <MCHP_XEC_PINMUX(0206, MCHP_AF1)>;
	};

	/omit-if-no-ref/ pin_adc07: adc07_gpio207 {
		pinmux = <MCHP_XEC_PINMUX(0207, MCHP_AF1)>;
	};

	/omit-if-no-ref/ pin_vref2_adc: vref2_adc_gpio067 {
		pinmux = <MCHP_XEC_PINMUX(067, MCHP_AF1)>;
	};

	/* ESPI */
	/omit-if-no-ref/ pin_espi_reset_n: espi_reset_n_gpio061 {
		pinmux = <MCHP_XEC_PINMUX(061, MCHP_AF1)>;
	};

	/omit-if-no-ref/ pin_espi_alert_n: espi_alert_n_gpio063 {
		pinmux = <MCHP_XEC_PINMUX(063, MCHP_AF1)>;
	};

	/omit-if-no-ref/ pin_espi_clk: espi_clk_gpio065 {
		pinmux = <MCHP_XEC_PINMUX(065, MCHP_AF1)>;
	};

	/omit-if-no-ref/ pin_espi_cs_n: espi_cs_n_gpio066 {
		pinmux = <MCHP_XEC_PINMUX(066, MCHP_AF1)>;
	};

	/omit-if-no-ref/ pin_espi_io0: espi_io0_gpio070 {
		pinmux = <MCHP_XEC_PINMUX(070, MCHP_AF1)>;
	};

	/omit-if-no-ref/ pin_espi_io1: espi_io1_gpio071 {
		pinmux = <MCHP_XEC_PINMUX(071, MCHP_AF1)>;
	};

	/omit-if-no-ref/ pin_espi_io2: espi_io2_gpio072 {
		pinmux = <MCHP_XEC_PINMUX(072, MCHP_AF1)>;
	};

	/omit-if-no-ref/ pin_espi_io3: espi_io3_gpio073 {
		pinmux = <MCHP_XEC_PINMUX(073, MCHP_AF1)>;
	};

	/* GPIO Pass Through */
	/omit-if-no-ref/ pin_gptp_in0: gptp_in0_gpio224 {
		pinmux = <MCHP_XEC_PINMUX(0224, MCHP_AF1)>;
	};

	/omit-if-no-ref/ pin_gptp_in1: gptp_in1_gpio016 {
		pinmux = <MCHP_XEC_PINMUX(016, MCHP_AF1)>;
	};

	/omit-if-no-ref/ pin_gptp_in2: gptp_in2_gpio014 {
		pinmux = <MCHP_XEC_PINMUX(014, MCHP_AF3)>;
	};

	/omit-if-no-ref/ pin_gptp_out0: gptp_out0_gpio032 {
		pinmux = <MCHP_XEC_PINMUX(032, MCHP_AF2)>;
	};

	/omit-if-no-ref/ pin_gptp_out1: gptp_out1_gpio031 {
		pinmux = <MCHP_XEC_PINMUX(031, MCHP_AF2)>;
	};

	/omit-if-no-ref/ pin_gptp_out2: gptp_out2_gpio040 {
		pinmux = <MCHP_XEC_PINMUX(040, MCHP_AF1)>;
	};

	/* Host Interface */
	/omit-if-no-ref/ pin_nec_sci: nec_sci_gpio114 {
		pinmux = <MCHP_XEC_PINMUX(0114, MCHP_AF2)>;
	};

	/omit-if-no-ref/ pin_nec_sci_alt: nec_sci_alt_gpio061 {
		pinmux = <MCHP_XEC_PINMUX(061, MCHP_AF3)>;
	};

	/omit-if-no-ref/ pin_nec_sci_alt2: nec_sci_alt_gpio100 {
		pinmux = <MCHP_XEC_PINMUX(0100, MCHP_AF1)>;
	};

	/omit-if-no-ref/ pin_nemi_int: nemi_int_gpio025 {
		pinmux = <MCHP_XEC_PINMUX(025, MCHP_AF1)>;
	};

	/omit-if-no-ref/ pin_nemi_int_alt: nemi_int_alt_gpio244 {
		pinmux = <MCHP_XEC_PINMUX(0224, MCHP_AF2)>;
	};

	/omit-if-no-ref/ pin_nsmi: nsmi_gpio107 {
		pinmux = <MCHP_XEC_PINMUX(0107, MCHP_AF1)>;
	};

	/omit-if-no-ref/ pin_nsmi: nsmi_alt_gpio011 {
		pinmux = <MCHP_XEC_PINMUX(011, MCHP_AF1)>;
	};

	/* I2C ports */
	/omit-if-no-ref/ pin_i2c00_scl: i2c00_scl_gpio004 {
		pinmux = <MCHP_XEC_PINMUX(04, MCHP_AF1)>;
	};

	/omit-if-no-ref/ pin_i2c00_sda: i2c00_sda_gpio003 {
		pinmux = <MCHP_XEC_PINMUX(03, MCHP_AF1)>;
	};

	/omit-if-no-ref/ pin_i2c01_scl: i2c01_scl_gpio131 {
		pinmux = <MCHP_XEC_PINMUX(0131, MCHP_AF1)>;
	};

	/omit-if-no-ref/ pin_i2c01_sda: i2c01_sda_gpio130 {
		pinmux = <MCHP_XEC_PINMUX(0130, MCHP_AF1)>;
	};

	/omit-if-no-ref/ pin_i2c01_scl_alt: i2c01_scl_alt_gpio073 {
		pinmux = <MCHP_XEC_PINMUX(073, MCHP_AF2)>;
	};

	/omit-if-no-ref/ pin_i2c01_sda_alt: i2c01_sda_alt_gpio072 {
		pinmux = <MCHP_XEC_PINMUX(072, MCHP_AF2)>;
	};

	/omit-if-no-ref/ pin_i2c02_scl: i2c02_scl_gpio155 {
		pinmux = <MCHP_XEC_PINMUX(0155, MCHP_AF1)>;
	};

	/omit-if-no-ref/ pin_i2c02_sda: i2c02_sda_gpio154 {
		pinmux = <MCHP_XEC_PINMUX(0154, MCHP_AF1)>;
	};

	/omit-if-no-ref/ pin_i2c03_scl: i2c03_scl_gpio010 {
		pinmux = <MCHP_XEC_PINMUX(010, MCHP_AF1)>;
	};

	/omit-if-no-ref/ pin_i2c03_sda: i2c03_sda_gpio007 {
		pinmux = <MCHP_XEC_PINMUX(07, MCHP_AF1)>;
	};

	/omit-if-no-ref/ pin_i2c04_scl: i2c04_scl_gpio144 {
		pinmux = <MCHP_XEC_PINMUX(0144, MCHP_AF1)>;
	};

	/omit-if-no-ref/ pin_i2c04_sda: i2c04_sda_gpio143 {
		pinmux = <MCHP_XEC_PINMUX(0143, MCHP_AF1)>;
	};

	/omit-if-no-ref/ pin_i2c05_scl: i2c05_scl_gpio142 {
		pinmux = <MCHP_XEC_PINMUX(0142, MCHP_AF1)>;
	};

	/omit-if-no-ref/ pin_i2c05_sda: i2c05_sda_gpio141 {
		pinmux = <MCHP_XEC_PINMUX(0141, MCHP_AF1)>;
	};

	/omit-if-no-ref/ pin_i2c06_scl: i2c06_scl_gpio140 {
		pinmux = <MCHP_XEC_PINMUX(0140, MCHP_AF1)>;
	};

	/omit-if-no-ref/ pin_i2c06_sda: i2c06_sda_gpio132 {
		pinmux = <MCHP_XEC_PINMUX(0132, MCHP_AF1)>;
	};

	/omit-if-no-ref/ pin_i2c07_scl: i2c07_scl_gpio013 {
		pinmux = <MCHP_XEC_PINMUX(013, MCHP_AF1)>;
	};

	/omit-if-no-ref/ pin_i2c07_sda: i2c07_sda_gpio012 {
		pinmux = <MCHP_XEC_PINMUX(012, MCHP_AF1)>;
	};

	/omit-if-no-ref/ pin_i2c07_scl_alt: i2c07_scl_alt_gpio024 {
		pinmux = <MCHP_XEC_PINMUX(024, MCHP_AF3)>;
	};

	/omit-if-no-ref/ pin_i2c07_sda_alt: i2c07_sda_alt_gpio152 {
		pinmux = <MCHP_XEC_PINMUX(0152, MCHP_AF3)>;
	};

	/omit-if-no-ref/ pin_i2c09_scl: i2c09_scl_gpio146 {
		pinmux = <MCHP_XEC_PINMUX(0146, MCHP_AF1)>;
	};

	/omit-if-no-ref/ pin_i2c09_sda: i2c09_sda_gpio145 {
		pinmux = <MCHP_XEC_PINMUX(0145, MCHP_AF1)>;
	};

	/omit-if-no-ref/ pin_i2c10_scl: i2c10_scl_gpio107 {
		pinmux = <MCHP_XEC_PINMUX(0107, MCHP_AF3)>;
	};

	/omit-if-no-ref/ pin_i2c10_sda: i2c10_sda_gpio030 {
		pinmux = <MCHP_XEC_PINMUX(030, MCHP_AF3)>;
	};

	/omit-if-no-ref/ pin_i2c11_scl: i2c11_scl_gpio062 {
		pinmux = <MCHP_XEC_PINMUX(062, MCHP_AF2)>;
	};

	/omit-if-no-ref/ pin_i2c11_sda: i2c11_sda_gpio000 {
		pinmux = <MCHP_XEC_PINMUX(00, MCHP_AF3)>;
	};

	/omit-if-no-ref/ pin_i2c12_scl: i2c12_scl_gpio027 {
		pinmux = <MCHP_XEC_PINMUX(027, MCHP_AF3)>;
	};

	/omit-if-no-ref/ pin_i2c12_sda: i2c12_sda_gpio026 {
		pinmux = <MCHP_XEC_PINMUX(026, MCHP_AF3)>;
	};

	/omit-if-no-ref/ pin_i2c13_scl: i2c13_scl_gpio065 {
		pinmux = <MCHP_XEC_PINMUX(065, MCHP_AF2)>;
	};

	/omit-if-no-ref/ pin_i2c13_sda: i2c13_sda_gpio066 {
		pinmux = <MCHP_XEC_PINMUX(066, MCHP_AF2)>;
	};

	/omit-if-no-ref/ pin_i2c14_scl: i2c14_scl_gpio071 {
		pinmux = <MCHP_XEC_PINMUX(071, MCHP_AF2)>;
	};

	/omit-if-no-ref/ pin_i2c14_sda: i2c14_sda_gpio070 {
		pinmux = <MCHP_XEC_PINMUX(070, MCHP_AF2)>;
	};

	/omit-if-no-ref/ pin_i2c15_scl: i2c15_scl_gpio150 {
		pinmux = <MCHP_XEC_PINMUX(0150, MCHP_AF1)>;
	};

	/omit-if-no-ref/ pin_i2c15_sda: i2c15_sda_gpio147 {
		pinmux = <MCHP_XEC_PINMUX(0147, MCHP_AF1)>;
	};

	/* Input Capture Compare Timer */
	/omit-if-no-ref/ pin_ict0_tach0: ict0_tach0_gpio050 {
		pinmux = <MCHP_XEC_PINMUX(050, MCHP_AF1)>;
	};

	/omit-if-no-ref/ pin_ict1_tach1: ict1_tach1_gpio051 {
		pinmux = <MCHP_XEC_PINMUX(051, MCHP_AF1)>;
	};

	/omit-if-no-ref/ pin_ict2_tach2: ict2_tach2_gpio052 {
		pinmux = <MCHP_XEC_PINMUX(052, MCHP_AF1)>;
	};

	/omit-if-no-ref/ pin_ict3: ict3_gpio016 {
		pinmux = <MCHP_XEC_PINMUX(016, MCHP_AF3)>;
	};

	/omit-if-no-ref/ pin_ict4: ict4_gpio151 {
		pinmux = <MCHP_XEC_PINMUX(0151, MCHP_AF1)>;
	};

	/omit-if-no-ref/ pin_ict5: ict5_gpio140 {
		pinmux = <MCHP_XEC_PINMUX(0140, MCHP_AF2)>;
	};

	/omit-if-no-ref/ pin_ict5_alt: ict5_alt_gpio065 {
		pinmux = <MCHP_XEC_PINMUX(065, MCHP_AF3)>;
	};

	/omit-if-no-ref/ pin_ict6: ict6_gpio100 {
		pinmux = <MCHP_XEC_PINMUX(0100, MCHP_AF2)>;
	};

	/omit-if-no-ref/ pin_ict7: ict7_gpio011 {
		pinmux = <MCHP_XEC_PINMUX(011, MCHP_AF3)>;
	};

	/omit-if-no-ref/ pin_ict8: ict8_gpio063 {
		pinmux = <MCHP_XEC_PINMUX(063, MCHP_AF3)>;
	};

	/omit-if-no-ref/ pin_ict9: ict9_gpio113 {
		pinmux = <MCHP_XEC_PINMUX(0113, MCHP_AF2)>;
	};

	/omit-if-no-ref/ pin_ict10: ict10_gpio015 {
		pinmux = <MCHP_XEC_PINMUX(015, MCHP_AF2)>;
	};

	/omit-if-no-ref/ pin_ict11: ict11_gpio046 {
		pinmux = <MCHP_XEC_PINMUX(046, MCHP_AF3)>;
	};

	/omit-if-no-ref/ pin_ict12: ict12_gpio124 {
		pinmux = <MCHP_XEC_PINMUX(0124, MCHP_AF3)>;
	};

	/omit-if-no-ref/ pin_ict13: ict13_gpio047 {
		pinmux = <MCHP_XEC_PINMUX(047, MCHP_AF3)>;
	};

	/omit-if-no-ref/ pin_ict14: ict14_gpio045 {
		pinmux = <MCHP_XEC_PINMUX(045, MCHP_AF3)>;
	};

	/omit-if-no-ref/ pin_ict15: ict15_gpio035 {
		pinmux = <MCHP_XEC_PINMUX(035, MCHP_AF3)>;
	};

	/omit-if-no-ref/ pin_ctout0: ctout0_gpio165 {
		pinmux = <MCHP_XEC_PINMUX(0165, MCHP_AF3)>;
	};

	/omit-if-no-ref/ pin_ctout1: ctout1_gpio035 {
		pinmux = <MCHP_XEC_PINMUX(035, MCHP_AF2)>;
	};

	/omit-if-no-ref/ pin_ctout1_alt: ctout1_alt_gpio246 {
		pinmux = <MCHP_XEC_PINMUX(0246, MCHP_AF2)>;
	};

	/* Keyboard/Port92h Controller */
	/omit-if-no-ref/ pin_a20m: a20m_gpio127 {
		pinmux = <MCHP_XEC_PINMUX(0127, MCHP_AF1)>;
	};

	/omit-if-no-ref/ pin_kbrst: kbrst_gpio060 {
		pinmux = <MCHP_XEC_PINMUX(060, MCHP_AF1)>;
	};

	/* Keyscan */
	/omit-if-no-ref/ pin_ksi0: ksi0_gpio017 {
		pinmux = <MCHP_XEC_PINMUX(017, MCHP_AF1)>;
	};

	/omit-if-no-ref/ pin_ksi1: ksi1_gpio020 {
		pinmux = <MCHP_XEC_PINMUX(020, MCHP_AF1)>;
	};

	/omit-if-no-ref/ pin_ksi2: ksi2_gpio021 {
		pinmux = <MCHP_XEC_PINMUX(021, MCHP_AF1)>;
	};

	/omit-if-no-ref/ pin_ksi3: ksi3_gpio026 {
		pinmux = <MCHP_XEC_PINMUX(026, MCHP_AF1)>;
	};

	/omit-if-no-ref/ pin_ksi4: ksi4_gpio027 {
		pinmux = <MCHP_XEC_PINMUX(027, MCHP_AF1)>;
	};

	/omit-if-no-ref/ pin_ksi5: ksi5_gpio030 {
		pinmux = <MCHP_XEC_PINMUX(030, MCHP_AF1)>;
	};

	/omit-if-no-ref/ pin_ksi6: ksi6_gpio031 {
		pinmux = <MCHP_XEC_PINMUX(031, MCHP_AF1)>;
	};

	/omit-if-no-ref/ pin_ksi7: ksi7_gpio032 {
		pinmux = <MCHP_XEC_PINMUX(032, MCHP_AF1)>;
	};

	/omit-if-no-ref/ pin_kso00: kso00_gpio040 {
		pinmux = <MCHP_XEC_PINMUX(040, MCHP_AF2)>;
	};

	/omit-if-no-ref/ pin_kso01: kso01_gpio045 {
		pinmux = <MCHP_XEC_PINMUX(045, MCHP_AF1)>;
	};

	/omit-if-no-ref/ pin_kso02: kso02_gpio046 {
		pinmux = <MCHP_XEC_PINMUX(046, MCHP_AF1)>;
	};

	/omit-if-no-ref/ pin_kso03: kso03_gpio047 {
		pinmux = <MCHP_XEC_PINMUX(047, MCHP_AF1)>;
	};

	/omit-if-no-ref/ pin_kso04: kso04_gpio107 {
		pinmux = <MCHP_XEC_PINMUX(0107, MCHP_AF2)>;
	};

	/omit-if-no-ref/ pin_kso05: kso05_gpio112 {
		pinmux = <MCHP_XEC_PINMUX(0112, MCHP_AF1)>;
	};

	/omit-if-no-ref/ pin_kso06: kso06_gpio113 {
		pinmux = <MCHP_XEC_PINMUX(0113, MCHP_AF1)>;
	};

	/omit-if-no-ref/ pin_kso07: kso07_gpio120 {
		pinmux = <MCHP_XEC_PINMUX(0120, MCHP_AF1)>;
	};

	/omit-if-no-ref/ pin_kso08: kso08_gpio121 {
		pinmux = <MCHP_XEC_PINMUX(0121, MCHP_AF2)>;
	};

	/omit-if-no-ref/ pin_kso09: kso09_gpio122 {
		pinmux = <MCHP_XEC_PINMUX(0122, MCHP_AF2)>;
	};

	/omit-if-no-ref/ pin_kso10: kso10_gpio123 {
		pinmux = <MCHP_XEC_PINMUX(0123, MCHP_AF2)>;
	};

	/omit-if-no-ref/ pin_kso11: kso11_gpio124 {
		pinmux = <MCHP_XEC_PINMUX(0124, MCHP_AF2)>;
	};

	/omit-if-no-ref/ pin_kso12: kso12_gpio125 {
		pinmux = <MCHP_XEC_PINMUX(0125, MCHP_AF2)>;
	};

	/omit-if-no-ref/ pin_kso13: kso13_gpio126 {
		pinmux = <MCHP_XEC_PINMUX(0126, MCHP_AF2)>;
	};

	/omit-if-no-ref/ pin_kso14: kso14_gpio152 {
		pinmux = <MCHP_XEC_PINMUX(0152, MCHP_AF1)>;
	};

	/omit-if-no-ref/ pin_kso15: kso15_gpio151 {
		pinmux = <MCHP_XEC_PINMUX(0151, MCHP_AF2)>;
	};

	/omit-if-no-ref/ pin_kso16: kso16_gpio132 {
		pinmux = <MCHP_XEC_PINMUX(0132, MCHP_AF2)>;
	};

	/omit-if-no-ref/ pin_kso17: kso17_gpio140 {
		pinmux = <MCHP_XEC_PINMUX(0140, MCHP_AF3)>;
	};

	/* LED */
	/omit-if-no-ref/ pin_led0: led0_gpio156 {
		pinmux = <MCHP_XEC_PINMUX(0156, MCHP_AF1)>;
	};

	/omit-if-no-ref/ pin_led1: led1_gpio157 {
		pinmux = <MCHP_XEC_PINMUX(0157, MCHP_AF1)>;
	};

	/omit-if-no-ref/ pin_led2: led2_gpio153 {
		pinmux = <MCHP_XEC_PINMUX(0153, MCHP_AF1)>;
	};

	/* Quad SPI Ports */
	/omit-if-no-ref/ pin_shd_cs0_n: shd_cs0_n_gpio055 {
		pinmux = <MCHP_XEC_PINMUX(055, MCHP_AF2)>;
	};

	/omit-if-no-ref/ pin_shd_cs1_n: shd_cs1_n_gpio002 {
		pinmux = <MCHP_XEC_PINMUX(02, MCHP_AF2)>;
	};

	/omit-if-no-ref/ pin_shd_clk: shd_clk_gpio056 {
		pinmux = <MCHP_XEC_PINMUX(056, MCHP_AF2)>;
	};

	/omit-if-no-ref/ pin_shd_io0: shd_io0_gpio223 {
		pinmux = <MCHP_XEC_PINMUX(0223, MCHP_AF1)>;
	};

	/omit-if-no-ref/ pin_shd_io1: shd_io1_gpio224 {
		pinmux = <MCHP_XEC_PINMUX(0224, MCHP_AF2)>;
	};

	/omit-if-no-ref/ pin_shd_io2: shd_io2_gpio227 {
		pinmux = <MCHP_XEC_PINMUX(0227, MCHP_AF1)>;
	};

	/omit-if-no-ref/ pin_shd_io3: shd_io3_gpio016 {
		pinmux = <MCHP_XEC_PINMUX(016, MCHP_AF2)>;
	};

	/omit-if-no-ref/ pin_pvt_cs_n: pvt_cs_n_gpio124 {
		pinmux = <MCHP_XEC_PINMUX(0124, MCHP_AF1)>;
	};

	/omit-if-no-ref/ pin_pvt_clk: pvt_clk_gpio125 {
		pinmux = <MCHP_XEC_PINMUX(0125, MCHP_AF1)>;
	};

	/omit-if-no-ref/ pin_pvt_io0: pvt_io0_gpio121 {
		pinmux = <MCHP_XEC_PINMUX(0121, MCHP_AF1)>;
	};

	/omit-if-no-ref/ pin_pvt_io1: pvt_io1_gpio122 {
		pinmux = <MCHP_XEC_PINMUX(0122, MCHP_AF1)>;
	};

	/omit-if-no-ref/ pin_pvt_io2: pvt_io2_gpio123 {
		pinmux = <MCHP_XEC_PINMUX(0123, MCHP_AF1)>;
	};

	/omit-if-no-ref/ pin_pvt_io3: pvt_io3_gpio126 {
		pinmux = <MCHP_XEC_PINMUX(0126, MCHP_AF1)>;
	};

	/* MEC152x QMSPI Port 2 can be external pins named gpspi_xxx or
	 * for the MEC1727 variant internal pins named int_spi_xxx.
	 * The MEC1527 variant includes a SST25PF040 512 KB SPI flash
	 * in the package connected to the int_spi_xxx pins.
	 */
	/omit-if-no-ref/ pin_gpspi_cs_n: gpspi_cs_n_gpio024 {
		pinmux = <MCHP_XEC_PINMUX(024, MCHP_AF1)>;
	};

	/omit-if-no-ref/ pin_gpspi_clk: gpspi_clk_gpio023 {
		pinmux = <MCHP_XEC_PINMUX(023, MCHP_AF2)>;
	};

	/omit-if-no-ref/ pin_gpspi_clk_alt: gpspi_clk_alt_gpio057 {
		pinmux = <MCHP_XEC_PINMUX(057, MCHP_AF3)>;
	};

	/omit-if-no-ref/ pin_gpspi_io0: gpspi_io0_gpio245 {
		pinmux = <MCHP_XEC_PINMUX(0245, MCHP_AF2)>;
	};

	/omit-if-no-ref/ pin_gpspi_io1: gpspi_io1_gpio243 {
		pinmux = <MCHP_XEC_PINMUX(0243, MCHP_AF2)>;
	};

	/omit-if-no-ref/ pin_gpspi_io2: gpspi_io2_gpio034 {
		pinmux = <MCHP_XEC_PINMUX(076, MCHP_AF2)>;
	};

	/omit-if-no-ref/ pin_gpspi_io3: gpspi_io3_gpio022 {
		pinmux = <MCHP_XEC_PINMUX(022, MCHP_AF1)>;
	};

	/omit-if-no-ref/ pin_int_spi_cs_n: int_spi_cs_n_gpio116 {
		pinmux = <MCHP_XEC_PINMUX(0116, MCHP_AF1)>;
	};

	/omit-if-no-ref/ pin_int_spi_clk: int_spi_clk_gpio117 {
		pinmux = <MCHP_XEC_PINMUX(0117, MCHP_AF1)>;
	};

	/omit-if-no-ref/ pin_int_spi_io0: int_spi_io0_gpio074 {
		pinmux = <MCHP_XEC_PINMUX(074, MCHP_AF1)>;
	};

	/omit-if-no-ref/ pin_int_spi_io1: int_spi_io1_gpio075 {
		pinmux = <MCHP_XEC_PINMUX(075, MCHP_AF1)>;
	};

	/omit-if-no-ref/ pin_int_spi_wp_n: int_spi_wp_n_gpio076 {
		pinmux = <MCHP_XEC_PINMUX(076, MCHP_GPIO)>;
	};

	/* MEC152x variants with an EEPROM in the package use the same
	 * pins as the internal SPI. The pins are connected to the PSPI
	 * controller, named EEPROM controller in the data sheet.
	 */
	/omit-if-no-ref/ pin_pspi_cs_n: pspi_cs_n_gpio116 {
		pinmux = <MCHP_XEC_PINMUX(0116, MCHP_AF2)>;
	};

	/omit-if-no-ref/ pin_pspi_clk: pspi_clk_gpio117 {
		pinmux = <MCHP_XEC_PINMUX(0117, MCHP_AF2)>;
	};

	/omit-if-no-ref/ pin_pspi_mosi: pspi_mosi_gpio074 {
		pinmux = <MCHP_XEC_PINMUX(074, MCHP_AF2)>;
	};

	/omit-if-no-ref/ pin_pspi_miso: pspi_miso_gpio075 {
		pinmux = <MCHP_XEC_PINMUX(075, MCHP_AF2)>;
	};

	/* PECI */
	/omit-if-no-ref/ pin_peci_dat: peci_dat_gpio042 {
		pinmux = <MCHP_XEC_PINMUX(042, MCHP_AF1)>;
	};

	/omit-if-no-ref/ pin_vref_vtt: vref_vtt_gpio044 {
		pinmux = <MCHP_XEC_PINMUX(044, MCHP_AF1)>;
	};

	/* Power and Clock Signals */
	/omit-if-no-ref/ pin_vcc_pwrgd: vcc_pwrgd_gpio057 {
		pinmux = <MCHP_XEC_PINMUX(057, MCHP_AF1)>;
	};

	/omit-if-no-ref/ pin_pwrok: pwrok_gpio106 {
		pinmux = <MCHP_XEC_PINMUX(0106, MCHP_AF1)>;
	};

	/omit-if-no-ref/ pin_pwrgd_s0ix: pwrgd_s0ix_gpio022 {
		pinmux = <MCHP_XEC_PINMUX(022, MCHP_AF2)>;
	};

	/omit-if-no-ref/ pin_slp_s0_n: slp_s0_n_gpio030 {
		pinmux = <MCHP_XEC_PINMUX(030, MCHP_AF3)>;
	};

	/omit-if-no-ref/ pin_cpu_c10: cpu_c10_gpio175 {
		pinmux = <MCHP_XEC_PINMUX(0175, MCHP_AF2)>;
	};

	/omit-if-no-ref/ pin_clk_32khz_in: clk_32khz_in_gpio165 {
		pinmux = <MCHP_XEC_PINMUX(0165, MCHP_AF1)>;
	};

	/omit-if-no-ref/ pin_clk_32khz_out: clk_32khz_out_gpio221 {
		pinmux = <MCHP_XEC_PINMUX(0221, MCHP_AF1)>;
	};

	/omit-if-no-ref/ pin_tst_clk_out: tst_clk_out_gpio060 {
		pinmux = <MCHP_XEC_PINMUX(060, MCHP_AF2)>;
	};

	/omit-if-no-ref/ pin_pci_reset_n: pci_reset_n_gpio064 {
		pinmux = <MCHP_XEC_PINMUX(064, MCHP_AF1)>;
	};

	/* PROCHOT */
	/omit-if-no-ref/ pin_prochot_in_n: prochot_in_n_gpio222 {
		pinmux = <MCHP_XEC_PINMUX(0222, MCHP_AF1)>;
	};

	/* PS2 */
	/omit-if-no-ref/ pin_ps2_clk0a: ps2_clk0a_gpio114 {
		pinmux = <MCHP_XEC_PINMUX(0114, MCHP_AF1)>;
	};

	/omit-if-no-ref/ pin_ps2_dat0a: ps2_dat0a_gpio115 {
		pinmux = <MCHP_XEC_PINMUX(0115, MCHP_AF1)>;
	};

	/omit-if-no-ref/ pin_ps2_clk0b: ps2_clk0b_gpio007 {
		pinmux = <MCHP_XEC_PINMUX(07, MCHP_AF2)>;
	};

	/omit-if-no-ref/ pin_ps2_dat0b: ps2_dat0b_gpio010 {
		pinmux = <MCHP_XEC_PINMUX(010, MCHP_AF2)>;
	};

	/omit-if-no-ref/ pin_ps2_clk1b: ps2_clk1b_gpio154 {
		pinmux = <MCHP_XEC_PINMUX(0154, MCHP_AF2)>;
	};

	/omit-if-no-ref/ pin_ps2_dat1b: ps2_dat1b_gpio155 {
		pinmux = <MCHP_XEC_PINMUX(0155, MCHP_AF2)>;
	};

	/* PWM */
	/omit-if-no-ref/ pin_pwm0: pwm0_gpio053 {
		pinmux = <MCHP_XEC_PINMUX(053, MCHP_AF1)>;
	};

	/omit-if-no-ref/ pin_pwm0_alt: pwm0_alt_gpio241 {
		pinmux = <MCHP_XEC_PINMUX(0241, MCHP_AF1)>;
	};

	/omit-if-no-ref/ pin_pwm1: pwm1_gpio054 {
		pinmux = <MCHP_XEC_PINMUX(054, MCHP_AF1)>;
	};

	/omit-if-no-ref/ pin_pwm1_alt: pwm1_alt_gpio254 {
		pinmux = <MCHP_XEC_PINMUX(0254, MCHP_AF1)>;
	};

	/omit-if-no-ref/ pin_pwm2: pwm2_gpio055 {
		pinmux = <MCHP_XEC_PINMUX(055, MCHP_AF1)>;
	};

	/omit-if-no-ref/ pin_pwm2_alt: pwm2_alt_gpio045 {
		pinmux = <MCHP_XEC_PINMUX(045, MCHP_AF2)>;
	};

	/omit-if-no-ref/ pin_pwm3: pwm3_gpio056 {
		pinmux = <MCHP_XEC_PINMUX(056, MCHP_AF1)>;
	};

	/omit-if-no-ref/ pin_pwm3_alt: pwm3_alt_gpio047 {
		pinmux = <MCHP_XEC_PINMUX(047, MCHP_AF2)>;
	};

	/omit-if-no-ref/ pin_pwm4: pwm4_gpio011 {
		pinmux = <MCHP_XEC_PINMUX(011, MCHP_AF2)>;
	};

	/omit-if-no-ref/ pin_pwm5: pwm5_gpio002 {
		pinmux = <MCHP_XEC_PINMUX(02, MCHP_AF1)>;
	};

	/omit-if-no-ref/ pin_pwm6: pwm6_gpio014 {
		pinmux = <MCHP_XEC_PINMUX(014, MCHP_AF1)>;
	};

	/omit-if-no-ref/ pin_pwm6_alt: pwm6_alt_gpio063 {
		pinmux = <MCHP_XEC_PINMUX(063, MCHP_AF2)>;
	};

	/omit-if-no-ref/ pin_pwm7: pwm7_gpio015 {
		pinmux = <MCHP_XEC_PINMUX(015, MCHP_AF1)>;
	};

	/omit-if-no-ref/ pin_pwm7_alt: pwm7_alt_gpio061 {
		pinmux = <MCHP_XEC_PINMUX(061, MCHP_AF2)>;
	};

	/omit-if-no-ref/ pin_pwm8: pwm8_gpio035 {
		pinmux = <MCHP_XEC_PINMUX(035, MCHP_AF1)>;
	};

	/omit-if-no-ref/ pin_pwm8_alt: pwm8_alt_gpio175 {
		pinmux = <MCHP_XEC_PINMUX(0175, MCHP_AF3)>;
	};

	/* SB TSI */
	/omit-if-no-ref/ pin_sb_tsi_dat: sb_tsi_dat_gpio042 {
		pinmux = <MCHP_XEC_PINMUX(042, MCHP_AF2)>;
	};

	/omit-if-no-ref/ pin_sb_tsi_clk: sb_tsi_clk_gpio043 {
		pinmux = <MCHP_XEC_PINMUX(043, MCHP_AF1)>;
	};

	/* SPI Target */
	/omit-if-no-ref/ pin_spi_targ_cs_n_gpio131: spi_targ_cs_n_gpio131 {
		pinmux = <MCHP_XEC_PINMUX(0131, MCHP_AF2)>;
	};

	/omit-if-no-ref/ pin_spi_targ_sclk_gpio054: spi_targ_sclk_gpio054 {
		pinmux = <MCHP_XEC_PINMUX(054, MCHP_AF2)>;
	};

	/omit-if-no-ref/ pin_spi_targ_io0_gpio130: spi_targ_io0_gpio130 {
		pinmux = <MCHP_XEC_PINMUX(0130, MCHP_AF2)>;
	};

	/omit-if-no-ref/ pin_spi_targ_io1_gpio014: spi_targ_io1_gpio014 {
		pinmux = <MCHP_XEC_PINMUX(014, MCHP_AF2)>;
	};

	/omit-if-no-ref/ pin_spi_targ_io2_gpio012: spi_targ_io2_gpio012 {
		pinmux = <MCHP_XEC_PINMUX(012, MCHP_AF2)>;
	};

	/omit-if-no-ref/ pin_spi_targ_io3_gpio013: spi_targ_io3_gpio013 {
		pinmux = <MCHP_XEC_PINMUX(013, MCHP_AF2)>;
	};

	/omit-if-no-ref/ pin_spi_tarrg_hint_gpio053: spi_targ_hint_gpio053 {
		pinmux = <MCHP_XEC_PINMUX(053, MCHP_AF2)>;
	};

	/* TACH */
	/omit-if-no-ref/ pin_tach0: tach0_gpio050 {
		pinmux = <MCHP_XEC_PINMUX(050, MCHP_AF1)>;
	};

	/omit-if-no-ref/ pin_tach1: tach1_gpio051 {
		pinmux = <MCHP_XEC_PINMUX(051, MCHP_AF1)>;
	};

	/omit-if-no-ref/ pin_tach2: tach2_gpio052 {
		pinmux = <MCHP_XEC_PINMUX(052, MCHP_AF1)>;
	};

	/omit-if-no-ref/ pin_tach3: tach3_gpio033 {
		pinmux = <MCHP_XEC_PINMUX(033, MCHP_AF1)>;
	};

	/* TFDP (Trace FIFO Debug Port) */
	/omit-if-no-ref/ pin_tfdp_clk: tfdp_clk_gpio104 {
		pinmux = <MCHP_XEC_PINMUX(0104, MCHP_AF2)>;
	};

	/omit-if-no-ref/ pin_tfdp_dat: tfdp_dat_gpio105 {
		pinmux = <MCHP_XEC_PINMUX(0105, MCHP_AF2)>;
	};

	/* UART 0 */
	/omit-if-no-ref/ pin_uart0_tx: uart0_tx_gpio104 {
		pinmux = <MCHP_XEC_PINMUX(0104, MCHP_AF1)>;
	};

	/omit-if-no-ref/ pin_uart0_rx: uart0_rx_gpio105 {
		pinmux = <MCHP_XEC_PINMUX(0105, MCHP_AF1)>;
	};

	/omit-if-no-ref/ pin_uart0_cts_n: uart0_cts_n_gpio143 {
		pinmux = <MCHP_XEC_PINMUX(0143, MCHP_AF2)>;
	};

	/omit-if-no-ref/ pin_uart0_dcd_n: uart0_dcd_n_gpio017 {
		pinmux = <MCHP_XEC_PINMUX(017, MCHP_AF2)>;
	};

	/omit-if-no-ref/ pin_uart0_dsr_n: uart0_dsr_n_gpio027 {
		pinmux = <MCHP_XEC_PINMUX(027, MCHP_AF2)>;
	};

	/omit-if-no-ref/ pin_uart0_dtr_n: uart0_dtr_n_gpio026 {
		pinmux = <MCHP_XEC_PINMUX(026, MCHP_AF2)>;
	};

	/omit-if-no-ref/ pin_uart0_ri_n: uart0_ri_n_gpio032 {
		pinmux = <MCHP_XEC_PINMUX(032, MCHP_AF3)>;
	};

	/omit-if-no-ref/ pin_uart0_rts_n: uart0_rts_n_gpio144 {
		pinmux = <MCHP_XEC_PINMUX(0144, MCHP_AF2)>;
	};

	/omit-if-no-ref/ pin_uart_clk: uart_clk_gpio025 {
		pinmux = <MCHP_XEC_PINMUX(025, MCHP_AF2)>;
	};

	/omit-if-no-ref/ pin_uart_clk_alt: uart_clk_alt_gpio244 {
		pinmux = <MCHP_XEC_PINMUX(0244, MCHP_AF1)>;
	};

	/* UART 1 */
	/omit-if-no-ref/ pin_uart1_tx: uart1_tx_gpio170 {
		pinmux = <MCHP_XEC_PINMUX(0170, MCHP_AF1)>;
	};

	/omit-if-no-ref/ pin_uart1_rx: uart1_rx_gpio171 {
		pinmux = <MCHP_XEC_PINMUX(0171, MCHP_AF1)>;
	};

	/omit-if-no-ref/ pin_uart1_rx_alt: uart1_rx_alt_gpio255 {
		pinmux = <MCHP_XEC_PINMUX(0255, MCHP_AF1)>;
	};

	/omit-if-no-ref/ pin_uart1_cts_n: uart1_cts_n_gpio040 {
		pinmux = <MCHP_XEC_PINMUX(040, MCHP_AF3)>;
	};

	/omit-if-no-ref/ pin_uart1_dcd_n: uart1_dcd_n_gpio060 {
		pinmux = <MCHP_XEC_PINMUX(060, MCHP_AF3)>;
	};

	/omit-if-no-ref/ pin_uart1_dsr_n: uart1_dsr_n_gpio255 {
		pinmux = <MCHP_XEC_PINMUX(0255, MCHP_AF2)>;
	};

	/omit-if-no-ref/ pin_uart1_dtr_n: uart1_dtr_n_gpio120 {
		pinmux = <MCHP_XEC_PINMUX(0120, MCHP_AF2)>;
	};

	/omit-if-no-ref/ pin_uart1_ri_n: uart1_ri_n_gpio025 {
		pinmux = <MCHP_XEC_PINMUX(025, MCHP_AF3)>;
	};

	/omit-if-no-ref/ pin_uart1_rts_n: uart1_rts_n_gpio127 {
		pinmux = <MCHP_XEC_PINMUX(0127, MCHP_AF2)>;
	};

	/* UART 2 */
	/omit-if-no-ref/ pin_uart2_tx: uart2_tx_gpio146 {
		pinmux = <MCHP_XEC_PINMUX(0146, MCHP_AF2)>;
	};

	/omit-if-no-ref/ pin_uart2_rx: uart2_rx_gpio145 {
		pinmux = <MCHP_XEC_PINMUX(0145, MCHP_AF2)>;
	};

	/omit-if-no-ref/ pin_uart2_cts_n: uart2_cts_n_gpio142 {
		pinmux = <MCHP_XEC_PINMUX(0142, MCHP_AF2)>;
	};

	/omit-if-no-ref/ pin_uart2_dcd_n: uart2_dcd_n_gpio004 {
		pinmux = <MCHP_XEC_PINMUX(004, MCHP_AF3)>;
	};

	/omit-if-no-ref/ pin_uart2_dsr_n: uart2_dsr_n_gpio147 {
		pinmux = <MCHP_XEC_PINMUX(0147, MCHP_AF2)>;
	};

	/omit-if-no-ref/ pin_uart2_dtr_n: uart2_dtr_n_gpio150 {
		pinmux = <MCHP_XEC_PINMUX(0150, MCHP_AF2)>;
	};

	/omit-if-no-ref/ pin_uart2_ri_n: uart2_ri_n_gpio003 {
		pinmux = <MCHP_XEC_PINMUX(003, MCHP_AF3)>;
	};

	/omit-if-no-ref/ pin_uart2_rts_n: uart2_rts_n_gpio141 {
		pinmux = <MCHP_XEC_PINMUX(0150, MCHP_AF2)>;
	};

	/* VCI */
	/omit-if-no-ref/ pin_vci_ovrd_in: vci_ovrd_in_gpio172 {
		pinmux = <MCHP_XEC_PINMUX(0172, MCHP_AF1)>;
	};

	/omit-if-no-ref/ pin_vci_in0_n: vci_in0_n_gpio253 {
		pinmux = <MCHP_XEC_PINMUX(0253, MCHP_AF1)>;
	};

	/omit-if-no-ref/ pin_vci_in1_n: vci_in1_n_gpio162 {
		pinmux = <MCHP_XEC_PINMUX(0162, MCHP_AF1)>;
	};

	/omit-if-no-ref/ pin_vci_in2_n: vci_in2_n_gpio161 {
		pinmux = <MCHP_XEC_PINMUX(0161, MCHP_AF1)>;
	};

	/omit-if-no-ref/ pin_vci_in3_n: vci_in3_n_gpio000 {
		pinmux = <MCHP_XEC_PINMUX(000, MCHP_AF1)>;
	};

	/omit-if-no-ref/ pin_vci_out: vci_out_gpio250 {
		pinmux = <MCHP_XEC_PINMUX(0250, MCHP_AF1)>;
	};

	/omit-if-no-ref/ pin_sys_shdn_n: sys_shdn_n_gpio221 {
		pinmux = <MCHP_XEC_PINMUX(0221, MCHP_AF3)>;
	};

	/* Week Timer BGPO Pins */
	/omit-if-no-ref/ pin_bgpo0: bgpo0_gpio253 {
		pinmux = <MCHP_XEC_PINMUX(0253, MCHP_AF1)>;
	};

	/omit-if-no-ref/ pin_bgpo1: bgpo1_gpio101 {
		pinmux = <MCHP_XEC_PINMUX(0101, MCHP_AF1)>;
	};

	/omit-if-no-ref/ pin_bgpo2: bgpo2_gpio102 {
		pinmux = <MCHP_XEC_PINMUX(0102, MCHP_AF1)>;
	};

	/* Analog Voltage Comparator */
	/omit-if-no-ref/ pin_cmp_vin0: cmp_vin0_gpio242 {
		pinmux = <MCHP_XEC_PINMUX(0242, MCHP_AF3)>;
	};

	/omit-if-no-ref/ pin_cmp_vout0: cmp_vout0_gpio241 {
		pinmux = <MCHP_XEC_PINMUX(0241, MCHP_AF3)>;
	};

	/omit-if-no-ref/ pin_cmp_vref0: cmp_vref0_gpio246 {
		pinmux = <MCHP_XEC_PINMUX(0226, MCHP_AF3)>;
	};

	/omit-if-no-ref/ pin_cmp_vin1: cmp_vin1_gpio244 {
		pinmux = <MCHP_XEC_PINMUX(0244, MCHP_AF3)>;
	};

	/omit-if-no-ref/ pin_cmp_vout1: cmp_vout1_gpio175 {
		pinmux = <MCHP_XEC_PINMUX(0175, MCHP_AF1)>;
	};

	/omit-if-no-ref/ pin_cmp_vref1: cmp_vref1_gpio254 {
		pinmux = <MCHP_XEC_PINMUX(0106, MCHP_AF3)>;
	};

	/* HDMI-CEC */
	/omit-if-no-ref/ pin_cec_out: cec_out_gpio170 {
		pinmux = <MCHP_XEC_PINMUX(0170, MCHP_AF2)>;
	};

	/omit-if-no-ref/ pin_cec_in: cec_in_gpio171 {
		pinmux = <MCHP_XEC_PINMUX(0171, MCHP_AF2)>;
	};

	/* SGPIO */
	/omit-if-no-ref/ pin_sgpio0_clock: sgpio0_clock_gpio024 {
		pinmux = <MCHP_XEC_PINMUX(024, MCHP_AF2)>;
	};

	/omit-if-no-ref/ pin_sgpio0_datain: sgpio0_datain_gpio031 {
		pinmux = <MCHP_XEC_PINMUX(031, MCHP_AF3)>;
	};

	/omit-if-no-ref/ pin_sgpio0_dataout: sgpio0_dataout_gpio106 {
		pinmux = <MCHP_XEC_PINMUX(0106, MCHP_AF3)>;
	};

	/omit-if-no-ref/ pin_sgpio0_load: sgpio0_load_gpio152 {
		pinmux = <MCHP_XEC_PINMUX(0152, MCHP_AF2)>;
	};

	/omit-if-no-ref/ pin_sgpio1_clock: sgpio1_clock_gpio161 {
		pinmux = <MCHP_XEC_PINMUX(0161, MCHP_AF2)>;
	};

	/omit-if-no-ref/ pin_sgpio1_datain: sgpio1_datain_gpio064 {
		pinmux = <MCHP_XEC_PINMUX(064, MCHP_AF2)>;
	};

	/omit-if-no-ref/ pin_sgpio1_dataout: sgpio1_dataout_gpio156 {
		pinmux = <MCHP_XEC_PINMUX(0156, MCHP_AF2)>;
	};

	/omit-if-no-ref/ pin_sgpio1_load: sgpio1_load_gpio246 {
		pinmux = <MCHP_XEC_PINMUX(0246, MCHP_AF1)>;
	};

	/omit-if-no-ref/ pin_sgpio2_clock: sgpio2_clock_gpio162 {
		pinmux = <MCHP_XEC_PINMUX(0162, MCHP_AF2)>;
	};

	/omit-if-no-ref/ pin_sgpio2_datain: sgpio2_datain_gpio021 {
		pinmux = <MCHP_XEC_PINMUX(021, MCHP_AF2)>;
	};

	/omit-if-no-ref/ pin_sgpio2_dataout: sgpio2_dataout_gpio020 {
		pinmux = <MCHP_XEC_PINMUX(020, MCHP_AF2)>;
	};

	/omit-if-no-ref/ pin_sgpio2_load: sgpio2_load_gpio033 {
		pinmux = <MCHP_XEC_PINMUX(033, MCHP_AF2)>;
	};

	/omit-if-no-ref/ pin_sgpio3_clock: sgpio3_clock_gpio163 {
		pinmux = <MCHP_XEC_PINMUX(0163, MCHP_AF2)>;
	};

	/omit-if-no-ref/ pin_gpio163: gpio163_gpio163 {
		pinmux = <MCHP_XEC_PINMUX(0163, MCHP_AF0)>;
	};

	/omit-if-no-ref/ pin_sgpio3_datain: sgpio3_datain_gpio242 {
		pinmux = <MCHP_XEC_PINMUX(0242, MCHP_AF2)>;
	};

	/omit-if-no-ref/ pin_sgpio3_dataout: sgpio3_dataout_gpio241 {
		pinmux = <MCHP_XEC_PINMUX(0241, MCHP_AF2)>;
	};

	/omit-if-no-ref/ pin_sgpio3_load: sgpio3_load_gpio254 {
		pinmux = <MCHP_XEC_PINMUX(0254, MCHP_AF2)>;
	};
};

/* Add Sleep Pin Control */
&pinctrl {
	/omit-if-no-ref/ pin_peci_dat_sleep: peci_dat_gpio042_sleep {
		pinmux = <MCHP_XEC_PINMUX(042, MCHP_AF1)>;
		low-power-enable;
	};

	/omit-if-no-ref/ pin_vref_vtt_sleep: vref_vtt_gpio044_sleep {
		pinmux = <MCHP_XEC_PINMUX(044, MCHP_AF1)>;
		low-power-enable;
	};

	/* PS2 */
	/omit-if-no-ref/ pin_ps2_clk0b_sleep: ps2_clk0b_gpio007_sleep {
		pinmux = <MCHP_XEC_PINMUX(007, MCHP_AF2)>;
		low-power-enable;
	};

	/omit-if-no-ref/ pin_ps2_dat0b_sleep: ps2_dat0b_gpio010_sleep {
		pinmux = <MCHP_XEC_PINMUX(010, MCHP_AF2)>;
		low-power-enable;
	};

	/omit-if-no-ref/ pin_ps2_clk1b_sleep: ps2_clk1b_gpio154_sleep {
		pinmux = <MCHP_XEC_PINMUX(0154, MCHP_AF2)>;
		low-power-enable;
	};

	/omit-if-no-ref/ pin_ps2_dat1b_sleep: ps2_dat1b_gpio155_sleep {
		pinmux = <MCHP_XEC_PINMUX(0155, MCHP_AF2)>;
		low-power-enable;
	};

	/* PWM */
	/omit-if-no-ref/ pin_pwm0_sleep: pwm0_gpio053_sleep {
		pinmux = <MCHP_XEC_PINMUX(053, MCHP_AF1)>;
		low-power-enable;
	};

	/omit-if-no-ref/ pin_pwm0_alt_sleep: pwm0_alt_gpio241_sleep {
		pinmux = <MCHP_XEC_PINMUX(0241, MCHP_AF1)>;
		low-power-enable;
	};

	/omit-if-no-ref/ pin_pwm1_sleep: pwm1_gpio054_sleep {
		pinmux = <MCHP_XEC_PINMUX(054, MCHP_AF1)>;
		low-power-enable;
	};

	/omit-if-no-ref/ pin_pwm1_alt_sleep: pwm1_alt_gpio254_sleep {
		pinmux = <MCHP_XEC_PINMUX(0254, MCHP_AF1)>;
		low-power-enable;
	};

	/omit-if-no-ref/ pin_pwm2_sleep: pwm2_gpio055_sleep {
		pinmux = <MCHP_XEC_PINMUX(055, MCHP_AF1)>;
		low-power-enable;
	};

	/omit-if-no-ref/ pin_pwm2_alt_sleep: pwm2_alt_gpio045_sleep {
		pinmux = <MCHP_XEC_PINMUX(045, MCHP_AF2)>;
		low-power-enable;
	};

	/omit-if-no-ref/ pin_pwm3_sleep: pwm3_gpio056_sleep {
		pinmux = <MCHP_XEC_PINMUX(056, MCHP_AF1)>;
		low-power-enable;
	};

	/omit-if-no-ref/ pin_pwm3_alt_sleep: pwm3_alt_gpio047_sleep {
		pinmux = <MCHP_XEC_PINMUX(047, MCHP_AF2)>;
		low-power-enable;
	};

	/omit-if-no-ref/ pin_pwm4_sleep: pwm4_gpio011_sleep {
		pinmux = <MCHP_XEC_PINMUX(011, MCHP_AF2)>;
		low-power-enable;
	};

	/omit-if-no-ref/ pin_pwm5_sleep: pwm5_gpio002_sleep {
		pinmux = <MCHP_XEC_PINMUX(02, MCHP_AF1)>;
		low-power-enable;
	};

	/omit-if-no-ref/ pin_pwm6_sleep: pwm6_gpio014_sleep {
		pinmux = <MCHP_XEC_PINMUX(014, MCHP_AF1)>;
		low-power-enable;
	};

	/omit-if-no-ref/ pin_pwm6_alt_sleep: pwm6_alt_gpio063_sleep {
		pinmux = <MCHP_XEC_PINMUX(063, MCHP_AF2)>;
		low-power-enable;
	};

	/omit-if-no-ref/ pin_pwm7_sleep: pwm7_gpio015_sleep {
		pinmux = <MCHP_XEC_PINMUX(015, MCHP_AF1)>;
		low-power-enable;
	};

	/omit-if-no-ref/ pin_pwm7_alt_sleep: pwm7_alt_gpio061_sleep {
		pinmux = <MCHP_XEC_PINMUX(061, MCHP_AF2)>;
		low-power-enable;
	};

	/omit-if-no-ref/ pin_pwm8_sleep: pwm8_gpio035_sleep {
		pinmux = <MCHP_XEC_PINMUX(035, MCHP_AF1)>;
		low-power-enable;
	};

	/omit-if-no-ref/ pin_pwm8_alt_sleep: pwm8_alt_gpio175_sleep {
		pinmux = <MCHP_XEC_PINMUX(0175, MCHP_AF3)>;
		low-power-enable;
	};

	/* Keyscan */
	/omit-if-no-ref/ pin_ksi0_sleep: ksi0_gpio017_sleep {
		pinmux = <MCHP_XEC_PINMUX(017, MCHP_AF1)>;
		low-power-enable;
	};

	/omit-if-no-ref/ pin_ksi1_sleep: ksi1_gpio020_sleep {
		pinmux = <MCHP_XEC_PINMUX(020, MCHP_AF1)>;
		low-power-enable;
	};

	/omit-if-no-ref/ pin_ksi2_sleep: ksi2_gpio021_sleep {
		pinmux = <MCHP_XEC_PINMUX(021, MCHP_AF1)>;
		low-power-enable;
	};

	/omit-if-no-ref/ pin_ksi3_sleep: ksi3_gpio026_sleep {
		pinmux = <MCHP_XEC_PINMUX(026, MCHP_AF1)>;
		low-power-enable;
	};

	/omit-if-no-ref/ pin_ksi4_sleep: ksi4_gpio027_sleep {
		pinmux = <MCHP_XEC_PINMUX(027, MCHP_AF1)>;
		low-power-enable;
	};

	/omit-if-no-ref/ pin_ksi5_sleep: ksi5_gpio030_sleep {
		pinmux = <MCHP_XEC_PINMUX(030, MCHP_AF1)>;
		low-power-enable;
	};

	/omit-if-no-ref/ pin_ksi6_sleep: ksi6_gpio031_sleep {
		pinmux = <MCHP_XEC_PINMUX(031, MCHP_AF1)>;
		low-power-enable;
	};

	/omit-if-no-ref/ pin_ksi7_sleep: ksi7_gpio032_sleep {
		pinmux = <MCHP_XEC_PINMUX(032, MCHP_AF1)>;
		low-power-enable;
	};

	/omit-if-no-ref/ pin_kso00_sleep: kso00_gpio040_sleep {
		pinmux = <MCHP_XEC_PINMUX(040, MCHP_AF2)>;
		low-power-enable;
	};

	/omit-if-no-ref/ pin_kso01_sleep: kso01_gpio045_sleep {
		pinmux = <MCHP_XEC_PINMUX(045, MCHP_AF1)>;
		low-power-enable;
	};

	/omit-if-no-ref/ pin_kso02_sleep: kso02_gpio046_sleep {
		pinmux = <MCHP_XEC_PINMUX(046, MCHP_AF1)>;
		low-power-enable;
	};

	/omit-if-no-ref/ pin_kso03_sleep: kso03_gpio047_sleep {
		pinmux = <MCHP_XEC_PINMUX(047, MCHP_AF1)>;
		low-power-enable;
	};

	/omit-if-no-ref/ pin_kso04_sleep: kso04_gpio107_sleep {
		pinmux = <MCHP_XEC_PINMUX(0107, MCHP_AF2)>;
		low-power-enable;
	};

	/omit-if-no-ref/ pin_kso05_sleep: kso05_gpio112_sleep {
		pinmux = <MCHP_XEC_PINMUX(0112, MCHP_AF1)>;
		low-power-enable;
	};

	/omit-if-no-ref/ pin_kso06_sleep: kso06_gpio113_sleep {
		pinmux = <MCHP_XEC_PINMUX(0113, MCHP_AF1)>;
		low-power-enable;
	};

	/omit-if-no-ref/ pin_kso07_sleep: kso07_gpio120_sleep {
		pinmux = <MCHP_XEC_PINMUX(0120, MCHP_AF1)>;
		low-power-enable;
	};

	/omit-if-no-ref/ pin_kso08_sleep: kso08_gpio121_sleep {
		pinmux = <MCHP_XEC_PINMUX(0121, MCHP_AF2)>;
		low-power-enable;
	};

	/omit-if-no-ref/ pin_kso09_sleep: kso09_gpio122_sleep {
		pinmux = <MCHP_XEC_PINMUX(0122, MCHP_AF2)>;
		low-power-enable;
	};

	/omit-if-no-ref/ pin_kso10_sleep: kso10_gpio123_sleep {
		pinmux = <MCHP_XEC_PINMUX(0123, MCHP_AF2)>;
		low-power-enable;
	};

	/omit-if-no-ref/ pin_kso11_sleep: kso11_gpio124_sleep {
		pinmux = <MCHP_XEC_PINMUX(0124, MCHP_AF2)>;
		low-power-enable;
	};

	/omit-if-no-ref/ pin_kso12_sleep: kso12_gpio125_sleep {
		pinmux = <MCHP_XEC_PINMUX(0125, MCHP_AF2)>;
		low-power-enable;
	};

	/omit-if-no-ref/ pin_kso13_sleep: kso13_gpio126_sleep {
		pinmux = <MCHP_XEC_PINMUX(0126, MCHP_AF2)>;
		low-power-enable;
	};

	/omit-if-no-ref/ pin_kso14_sleep: kso14_gpio152_sleep {
		pinmux = <MCHP_XEC_PINMUX(0152, MCHP_AF1)>;
		low-power-enable;
	};

	/omit-if-no-ref/ pin_kso15_sleep: kso15_gpio151_sleep {
		pinmux = <MCHP_XEC_PINMUX(0151, MCHP_AF2)>;
		low-power-enable;
	};

	/omit-if-no-ref/ pin_kso16_sleep: kso16_gpio132_sleep {
		pinmux = <MCHP_XEC_PINMUX(0132, MCHP_AF2)>;
		low-power-enable;
	};

	/omit-if-no-ref/ pin_kso17_sleep: kso17_gpio140_sleep {
		pinmux = <MCHP_XEC_PINMUX(0140, MCHP_AF3)>;
		low-power-enable;
	};

	/* EEPROM */
	/omit-if-no-ref/ pin_pspi_cs_n_sleep: pspi_cs_n_gpio116_sleep {
		pinmux = <MCHP_XEC_PINMUX(0116, MCHP_AF2)>;
		low-power-enable;
	};

	/omit-if-no-ref/ pin_pspi_clk_sleep: pspi_clk_gpio117_sleep {
		pinmux = <MCHP_XEC_PINMUX(0117, MCHP_AF2)>;
		low-power-enable;
	};

	/omit-if-no-ref/ pin_pspi_mosi_sleep: pspi_mosi_gpio074_sleep {
		pinmux = <MCHP_XEC_PINMUX(074, MCHP_AF2)>;
		low-power-enable;
	};

	/omit-if-no-ref/ pin_pspi_miso_sleep: pspi_miso_gpio075_sleep {
		pinmux = <MCHP_XEC_PINMUX(075, MCHP_AF2)>;
		low-power-enable;
	};

	/* BBLED */
	/omit-if-no-ref/ pin_led0_sleep: led0_gpio156_sleep {
		pinmux = <MCHP_XEC_PINMUX(0156, MCHP_AF1)>;
		low-power-enable;
	};

	/omit-if-no-ref/ pin_led1_sleep: led1_gpio157_sleep {
		pinmux = <MCHP_XEC_PINMUX(0157, MCHP_AF1)>;
		low-power-enable;
	};

	/omit-if-no-ref/ pin_led2_sleep: led2_gpio153_sleep {
		pinmux = <MCHP_XEC_PINMUX(0153, MCHP_AF1)>;
		low-power-enable;
	};
};
