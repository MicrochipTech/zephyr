/*
 * Copyright (c) 2024 Microchip Technology Inc.
 *
 * SPDX-License-Identifier: Apache-2.0
 */
#include <zephyr/dt-bindings/interrupt-controller/mchp-xec-ecia.h>

/* MEC5 central DMA controller with 16 channels */
dmac: dmac@40002400 {
	compatible = "microchip,xec-dmac";
	reg = <0x40002400 0xc00>;

	dma-channels = <16>;
	dma-requests = <16>;
	dma-channel-mask = <0xffff>;
	#dma-cells = <2>;

	interrupts = <24 2>, <25 2>, <26 2>, <27 2>,
		     <28 2>, <29 2>, <30 2>, <31 2>,
		     <32 2>, <33 2>, <34 2>, <35 2>,
		     <36 2>, <37 2>, <38 2>, <39 2>;

	girqs = < MCHP_XEC_ECIA_GIRQ_ENC(14, 0)
		  MCHP_XEC_ECIA_GIRQ_ENC(14, 1)
		  MCHP_XEC_ECIA_GIRQ_ENC(14, 2)
		  MCHP_XEC_ECIA_GIRQ_ENC(14, 3)
		  MCHP_XEC_ECIA_GIRQ_ENC(14, 4)
		  MCHP_XEC_ECIA_GIRQ_ENC(14, 5)
		  MCHP_XEC_ECIA_GIRQ_ENC(14, 6)
		  MCHP_XEC_ECIA_GIRQ_ENC(14, 7)
		  MCHP_XEC_ECIA_GIRQ_ENC(14, 8)
		  MCHP_XEC_ECIA_GIRQ_ENC(14, 9)
		  MCHP_XEC_ECIA_GIRQ_ENC(14, 10)
		  MCHP_XEC_ECIA_GIRQ_ENC(14, 11)
		  MCHP_XEC_ECIA_GIRQ_ENC(14, 12)
		  MCHP_XEC_ECIA_GIRQ_ENC(14, 13)
		  MCHP_XEC_ECIA_GIRQ_ENC(14, 14)
		  MCHP_XEC_ECIA_GIRQ_ENC(14, 15) >;

	status = "disabled";
};
