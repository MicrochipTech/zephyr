/*
 * Copyright (c) 2025 Microchip Technology Inc.
 * SPDX-License-Identifier: Apache-2.0
 */

#include <zephyr/dt-bindings/espi/mchp_mec5_espi.h>

/ {
	mchp-mec5-espi-sram-bars {
		compatible = "microchip,mec5-espi-sram-bar";
		espi_sram_bar0: espi_sram_bar0 {
			id = <0>;
			host-mem-config-index = <0xac>;
			host-address-lsw = <0>;
			region-size = "256B";
			access = "DISABLED";
			status = "disabled";
		};
		espi_sram_bar1: espi_sram_bar1 {
			id = <1>;
			host-mem-config-index = <0xb6>;
			host-address-lsw = <0>;
			region-size = "256B";
			access = "DISABLED";
			status = "disabled";
		};
	};
};
