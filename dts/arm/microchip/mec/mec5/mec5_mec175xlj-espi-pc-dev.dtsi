/*
 * Copyright (c) 2025 Microchip Technology Inc.
 * SPDX-License-Identifier: Apache-2.0
 */

#include <zephyr/dt-bindings/espi/mchp_mec5_espi.h>

/ {
	mchp-mec5-espi-pc-host-dev {
		compatible = "microchip,mec5-espi-pc-device";

		#include "mec5-espi-pc-dev-common.dtsi"

		espi_uart2: espi_uart2 {
			ldn = <0xb>;
			host-address = <0x3e8>;
			sirqs = <19 0xff>;
			sirq-names = "uart_irq";
			status = "disabled";
		};
		espi_uart3: espi_uart3 {
			ldn = <0xc>;
			host-address = <0x2e8>;
			sirqs = <20 0xff>;
			sirq-names = "uart_irq";
			status = "disabled";
		};
	};
};
