## boards/arm/mec15xxevb_assy6853/mec15xxevb_assy6853_defconfig
```kconfig
#
# Copyright (c) 2019, Intel Corporation
#
# SPDX-License-Identifier: Apache-2.0
#

CONFIG_ARM=y
CONFIG_SOC_MEC1501_HSZ=y
CONFIG_SOC_SERIES_MEC1501X=y
CONFIG_BOARD_MEC15XXEVB_ASSY6853=y
CONFIG_CORTEX_M_SYSTICK=n
CONFIG_SYS_CLOCK_HW_CYCLES_PER_SEC=24000000
CONFIG_SYS_CLOCK_TICKS_PER_SEC=1000

CONFIG_CONSOLE=y
CONFIG_UART_CONSOLE=y
CONFIG_SERIAL=y
CONFIG_PINMUX=y
CONFIG_GPIO=y

CONFIG_I2C=y
CONFIG_I2C_INIT_PRIORITY=60
```

## boards/arm/mec172xevb_assy6906/Kconfig.board
```kconfig
# Copyright (c) 2021, Microchip Technology Inc.
# SPDX-License-Identifier: Apache-2.0

if SOC_MEC172X_NSZ || SOC_MEC172X_NLJ || SOC_MEC520X_MLJ

#config BOARD_MEC172XEVB_ASSY6906
#	bool "Microchip MEC172X EVB ASSY 6906 Development board"
#	depends on SOC_MEC172X_NSZ || SOC_MEC172X_NLJ || SOC_MEC520X_MLJ

config BOARD_MEC172XEVB_ASSY6906_MEC172X_NSZ
	bool "MEC172x EVB Assy6906 with MEC172X NSZ"

config BOARD_MEC172XEVB_ASSY6906_MEC172X_NLJ
	bool "MEC172x EVB Assy6906 with MEC172X NLJ"

config BOARD_MEC172XEVB_ASSY6906_MEC520X_MLJ
	bool "MEC172x EVB Assy6906 with MEC520X MLJ"

endif # SOC_MEC172X_NSZ || SOC_MEC172X_NLJ || SOC_MEC520X_MLJ
```

## boards/arm/mec172xevb_assy6906/mec172xevb_assy6906_defconfig
```kconfig
#
# Copyright (c) 2021, Microchip Technology Inc.
#
# SPDX-License-Identifier: Apache-2.0
#

CONFIG_SOC_MEC172X_NSZ=y
CONFIG_SOC_SERIES_MEC172X=y
CONFIG_BOARD_MEC172XEVB_ASSY6906=y
CONFIG_RTOS_TIMER=y

CONFIG_BBRAM=y
CONFIG_BBRAM_XEC=y
CONFIG_CLOCK_CONTROL=y
CONFIG_COUNTER=y
CONFIG_COUNTER_XEC=y
CONFIG_GPIO=y
CONFIG_PINCTRL=y
CONFIG_SERIAL=y
CONFIG_CONSOLE=y
CONFIG_UART_CONSOLE=y
CONFIG_ADC=y
CONFIG_I2C=y
CONFIG_KSCAN=y
CONFIG_KSCAN_XEC=y
CONFIG_ESPI=y
CONFIG_PS2=y
CONFIG_PWM=y
CONFIG_PWM_XEC=y
CONFIG_SPI=y
CONFIG_SPI_ASYNC=y
CONFIG_WATCHDOG=y
CONFIG_WDT_DISABLE_AT_BOOT=y
```

## boards/microchip/mec172xevb_assy6906/board.yml
```yaml
boards:
  - name: mec172xevb_assy6906
    full_name: MEC172xEVB ASSY6906 (default pkg SZ)
    vendor: microchip
    socs:
      - name: mec172x_nsz
  - name: mec172xevb_assy6906_sz
    full_name: MEC172xEVB ASSY6906 (Pkg SZ)
    vendor: microchip
    socs:
      - name: mec172x_nsz
  - name: mec172xevb_assy6906_lj
    full_name: MEC172xEVB ASSY6906 (Pkg LJ)
    vendor: microchip
    socs:
      - name: mec172x_nlj
```

## boards/microchip/mec176x_profpga/Kconfig.mec176x_profpga
```kconfig
# (c) 2026 Microchip Technology Inc. and its subsidiaries.
# SPDX-License-Identifier: Apache-2.0

config BOARD_MEC176X_PROFPGA
	select SOC_MEC1767_XYZ
	select TRUSTED_EXECUTION_NONSECURE if BOARD_MEC176X_PROFPGA_MEC1767_XYZ_NS
```

## boards/microchip/mec176x_profpga/board.yml
```yaml
board:
  name: mec176x_profpga
  full_name: Mount Rainier MEC1767 proFPGA
  vendor: microchip
  socs:
    - name: mec1767_xyz
      variants:
        - name: ns
```

## boards/microchip/mec176x_profpga/mec176x_profpga_defconfig
```kconfig
# (c) 2026 Microchip Technology Inc. and its subsidiaries.
# SPDX-License-Identifier: Apache-2.0

CONFIG_CONSOLE=y

# XEC UART driver + pin muxing (binds via DT). Kept enabled so the UART is brought
# up and ready; first bring-up is polled-only (no ECIA/GIRQ15 interrupt path yet).
CONFIG_SERIAL=y
CONFIG_PINCTRL=y
CONFIG_UART_INTERRUPT_DRIVEN=n

# TEMPORARY: console over SEGGER RTT (live, over the JTAG probe) because the UART
# pins (GPIO104/105) are NOT yet routed to pads on the current FPGA bitstream.
# When the pads are routed, REVERT to the UART console: set CONFIG_UART_CONSOLE=y
# and drop the three RTT lines below.
CONFIG_UART_CONSOLE=n
CONFIG_USE_SEGGER_RTT=y
CONFIG_RTT_CONSOLE=y
```

## boards/microchip/mec176x_profpga/mec176x_profpga_ns_defconfig
```kconfig
# (c) 2026 Microchip Technology Inc. and its subsidiaries.
# SPDX-License-Identifier: Apache-2.0
#
# Non-Secure configuration for TF-M integration

# TrustZone configuration
CONFIG_ARM_TRUSTZONE_M=y

# TF-M configuration
CONFIG_TFM_BL2=n
# NOTE: TF-M model (SFN vs IPC) is an application choice - set it in the
# sample/app prj.conf (CONFIG_TFM_IPC / CONFIG_TFM_SFN), not here.
CONFIG_ARM_MPU=y
CONFIG_RUNTIME_NMI=y

# FPU configuration (required for TF-M with Cortex-M55)
CONFIG_FPU=y
CONFIG_FP_HARDABI=y

# Console
CONFIG_CONSOLE=y

# Serial - XEC UART driver + pin muxing
CONFIG_SERIAL=y
CONFIG_PINCTRL=y
CONFIG_UART_INTERRUPT_DRIVEN=n

# TEMPORARY: console over SEGGER RTT (UART pins not routed in current FPGA bitstream)
CONFIG_UART_CONSOLE=n
CONFIG_USE_SEGGER_RTT=y
CONFIG_RTT_CONSOLE=y
```

## boards/microchip/mec_assy6906/board.yml
```yaml
board:
  name: mec_assy6906
  full_name: MECH172xEVB ASSY6906
  vendor: microchip
  socs:
  - name: mech1723_nlj
  - name: mech1723_nsz
```

## drivers/adc/Kconfig.xec
```kconfig
# Microchip XEC ADC configuration

# Copyright (c) 2019 Intel Corporation
# Copyright (c) 2021 Microchip Technology Inc.
# SPDX-License-Identifier: Apache-2.0

config ADC_XEC
	bool "Microchip XEC series ADC driver"
	depends on SOC_FAMILY_MEC
	default y
	help
	  Enable ADC driver for Microchip XEC MCU series.
```

## drivers/bbram/Kconfig.mec5
```kconfig
# Copyright (c) 2021 Google Inc
# Copyright (c) 2024 Microchip Technology Inc.
# SPDX-License-Identifier: Apache-2.0

config BBRAM_MCHP_MEC5
	bool "Microchip MEC5 Battery-backed RAM drivers"
	default y
	depends on DT_HAS_MICROCHIP_MEC5_BBRAM_ENABLED
	help
	  This option enables the BBRAM driver for Microchip MEC5 family of
	  processors.
```

## drivers/counter/Kconfig.xec
```kconfig
# XEC counter configuration options

# Copyright (c) 2019 Intel Corporation
# SPDX-License-Identifier: Apache-2.0

config COUNTER_XEC
	bool "Microchip XEC series counter driver"
	default y
	depends on DT_HAS_MICROCHIP_XEC_TIMER_ENABLED
	help
	  Enable counter driver for Microchip XEC MCU series. Such driver
	  will expose the basic timer devices present on the MCU.

config COUNTER_XEC_BTIMER
	bool "Microchip XEC series counter driver using basic timer pairs"
	default y
	depends on DT_HAS_MICROCHIP_XEC_COUNTER_BTMR_ENABLED
	help
	  Enable a counter driver using pairs of Microchip XEC basic timers.
```

## drivers/dma/Kconfig.mec5
```kconfig
# Microchip MEC5 DMAC configuration options
# Copyright (c) 2024 Microchip Technology Inc.
# SPDX-License-Identifier: Apache-2.0

config DMA_MCHP_MEC5
	bool "Microchip MEC5 series DMAC driver"
	default y
	depends on DT_HAS_MICROCHIP_MEC5_DMAC_ENABLED
	help
	  DMA driver for Microchip MEC5 series MCUs.

if DMA_MCHP_MEC5

config DMA_MCHP_MEC5_AGGREGATED_IRQ
	bool "Use single aggregated interrupt not per channel"
	default n
	help
	  DMA driver will use a single interrupt (aggregated mode)
	  for all channels instead of an individual interrupt per
	  channel. Aggregated mode is smaller driver code size and
	  one interrupts. Non-aggregated allows each channel to have
	  an interrupt priority since each channel has an interrupt
	  signal to the interrupt controller.

endif # DMA_MCHP_MEC5
```

## drivers/eeprom/Kconfig.mec5
```kconfig
# Microchip MEC5 HAL based internal EEPROM

# Copyright (c) 2024 Microchip Technology Inc.
# SPDX-License-Identifier: Apache-2.0

config EEPROM_MEC5
	bool "MCHP MEC5 EEPROM driver"
	default y
	depends on DT_HAS_MICROCHIP_MEC5_EEPROM_ENABLED
	select PINCTRL
	help
	  Enable support for Microchip MEC5 EEPROM driver.
```

## drivers/entropy/Kconfig.mec5
```kconfig
# Microchip MEC5 HAL based TRNG configuration

# Copyright (c) 2024 Microchip Technology Inc.
# SPDX-License-Identifier: Apache-2.0

config ENTROPY_MCHP_MEC5_RNG
	bool "Microchip MEC5 Family True Random Number Generator (TRNG) Driver"
	default y
	depends on DT_HAS_MICROCHIP_MEC5_TRNG_ENABLED
	select ENTROPY_HAS_DRIVER
	help
	  Enable True Random Number Generator (TRNG) driver for Microchip MEC5 HAL
```

## drivers/espi/Kconfig.mchp_mec5
```kconfig
# Microchip MEC5 eSPI driver
# Copyright (c) 2025 Microchip Technology Inc

config ESPI_MCHP_MEC5
	bool "Microchip MEC5 family eSPI driver"
	default y
	depends on DT_HAS_MICROCHIP_MEC5_ESPI_ENABLED
	select PINCTRL
	help
	  Enable the eSPI driver for Microchip MEC5 family

if ESPI_MCHP_MEC5

config ESPI_OOB_CHANNEL
	default y

config ESPI_FLASH_CHANNEL
	default y

config ESPI_OOB_BUFFER_SIZE
	int "eSPI OOB channel buffer size in bytes"
	default 128
	depends on ESPI_OOB_CHANNEL
	help
	  Driver OOB transfer buffer size in bytes. Default is the
	  eSPI specification defined minimum of 128 bytes. The current
	  maximum OOB payload from the eSPI host is 73 bytes.

config ESPI_FLASH_BUFFER_SIZE
	int "eSPI flash channel buffer size in bytes"
	default 256
	depends on ESPI_FLASH_CHANNEL
	help
	  Driver flash channel transfer buffer size in bytes. The
	  default value is 256 bytes which is the eSPI specification
	  maximum.

endif # ESPI_MCHP_MEC5
```

## drivers/i2c/Kconfig.mec5
```kconfig
# Microchip MEC5 I2C configuration options

# Copyright (c) 2024 Microchip Technology Inc.
# SPDX-License-Identifier: Apache-2.0

config I2C_MCHP_MEC5
	bool "Microchip MEC5 family I2C driver"
	default y
	depends on DT_HAS_MICROCHIP_MEC5_I2C_ENABLED
	help
	  Enable the Microchip MEC5 family I2C driver.

config I2C_MCHP_MEC5_NL
	bool "Microchip MEC5 HAL I2C with Network Layer driver"
	default y
	depends on DT_HAS_MICROCHIP_MEC5_I2C_NL_ENABLED
	select EVENTS
	help
	  Enable the Microchip MEC5 I2C Network Layer driver.
```

## drivers/i2c/Kconfig.xec
```kconfig
# Microchip XEC I2C configuration options

# Copyright (c) 2019 Intel Corporation
# SPDX-License-Identifier: Apache-2.0

config I2C_XEC
	bool "XEC Microchip I2C driver"
	default y
	depends on DT_HAS_MICROCHIP_XEC_I2C_ENABLED
	select PINCTRL
	help
	  Enable the Microchip XEC I2C driver.

config I2C_XEC_V2
	bool "XEC Microchip I2C driver"
	default y
	depends on DT_HAS_MICROCHIP_XEC_I2C_V2_ENABLED
	select PINCTRL
	help
	  Enable the Microchip XEC I2C V2 driver.

config I2C_XEC_NL
	bool "Microchip XEC I2C network layer plus DMA driver"
	default y
	depends on DT_HAS_MICROCHIP_XEC_I2C_NL_ENABLED
	select PINCTRL
	select DMA
	help
	  Enable the Microchip I2C Network layer driver with DMA
```

## drivers/i3c/Kconfig.dw
```kconfig
# Copyright (c) 2023 Meta Platforms, Inc. and its affiliates.
# Copyright (c) 2026 Microchip Technology Inc.
#
# SPDX-License-Identifier: Apache-2.0

module = I3C_DW
module-str = i3c-dw
source "subsys/logging/Kconfig.template.log_config"

menuconfig I3C_DW
	bool "DW I3C support"
	select I3C_IBI_WORKQUEUE if I3C_USE_IBI && I3C_CONTROLLER
	depends on I3C
	depends on DT_HAS_SNPS_DESIGNWARE_I3C_ENABLED || DT_HAS_MICROCHIP_XEC_I3C_ENABLED
	imply CLOCK_CONTROL if DT_HAS_SNPS_DESIGNWARE_I3C_ENABLED
	default y
	help
	  Enable the Synopsys Designware I3C driver. Supports both the upstream
	  snps,designware-i3c compatible and the Microchip XEC SoC variant
	  microchip,xec-i3c which uses the same IP with XEC-specific clock,
	  interrupt, and port-select configuration.

if I3C_DW

config I3C_DW_RW_TIMEOUT_MS
	int "Set the Read/Write timeout in milliseconds"
	default 100

endif # I3C_DW
```

## drivers/i3c/Kconfig.mchp
```kconfig
# Copyright (c) 2023 Meta Platforms, Inc. and its affiliates.
# Copyright (c) 2026 Microchip Inc.
#
# SPDX-License-Identifier: Apache-2.0

module = I3C_MCHP
module-str = i3c-mchp
source "subsys/logging/Kconfig.template.log_config"

menuconfig I3C_MCHP
	bool "MCHP I3C support"
	select I3C_IBI_WORKQUEUE if I3C_USE_IBI && I3C_CONTROLLER
	depends on DT_HAS_MICROCHIP_MCHP_I3C_ENABLED
	default y
	help
	  Enable the MCHP I3C driver

if I3C_MCHP

config I3C_MCHP_RW_TIMEOUT_MS
	int "Set the Read/Write timeout in milliseconds"
	default 100

endif # I3C_MCHP
```

## drivers/i3c/Kconfig.mec5
```kconfig
# Microchip MEC5 I3C configuration options

# Copyright (c) 2024 Microchip Technology Inc.
# SPDX-License-Identifier: Apache-2.0

config I3C_MCHP_MEC5
	bool "Microchip MEC5 family I3C driver"
	depends on DT_HAS_MICROCHIP_MEC5_I3C_ENABLED
	select I3C_IBI_WORKQUEUE if I3C_USE_IBI
	default y
	help
	  Enable the Microchip MEC5 family I3C driver.
```

## drivers/input/Kconfig.mec5
```kconfig
# Microchip MEC5 Keyboard Scan Matrix configuration options

# Copyright (c) 2024 Microchip Technology Inc.
# SPDX-License-Identifier: Apache-2.0

config INPUT_KSCAN_MEC5
	bool "Microchip MEC5 HAL based keyboard matrix driver"
	default y
	depends on DT_HAS_MICROCHIP_MEC5_INPUT_KSCAN_ENABLED
	select INPUT_KBD_MATRIX
	select MULTITHREADING
	select PINCTRL
	help
	  Enable the Microchip MEC5 HAL based key scan matrix IO driver.
```

## drivers/introspect_i3c/Kconfig
```kconfig
# Introspect configuration options

# Copyright (c) 2024 Microchip Technologies Inc.
# SPDX-License-Identifier: Apache-2.0

menuconfig INTROSPECT
	bool "I3C Introspect driver"
	help
	  Include Introspect drivers in system config.

if INTROSPECT

source "drivers/introspect_i3c/Kconfig.xec"

module = INTROSPECT
module-str = introspect
#source "subsys/logging/Kconfig.template.log_config"

config INTROSPECT_INIT_PRIORITY
	int "PECI driver init priority"
	default 90
	help
	  PECI device driver initialization priority.
	  There isn't any critical component relying on this priority at
	  the moment.

#config PECI_INTERRUPT_DRIVEN
#	bool "PECI driver interrupt support"
#	help
#	  This is an option to be enabled by individual peci driver
#	  to indicate that the driver and hardware supports interrupts.

endif # INTROSPECT
```

## drivers/introspect_i3c/Kconfig.xec
```kconfig
# Introspect configuration options

# Copyright (c) 2024 Microchip Technologies Inc.
# SPDX-License-Identifier: Apache-2.0

config MICROCHIP_INTROSPECT
	bool "XEC Microchip Introspect driver"
	default y
	help
	  Enable the Microchip Introspect driver.
```

## drivers/led/Kconfig.mec5
```kconfig
# Microchip MEC5 HAL based internal BBLED

# Copyright (c) 2024 Microchip Technology Inc.
# SPDX-License-Identifier: Apache-2.0

config LED_MEC5
	bool "Microchip MEC5 BB-LED driver"
	default y
	depends on DT_HAS_MICROCHIP_MEC5_BBLED_ENABLED
	help
	  Enable support for Microchip MEC5 BBLED driver.
```
