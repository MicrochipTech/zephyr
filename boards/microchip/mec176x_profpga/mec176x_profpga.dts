/dts-v1/;

/*
 * (c) 2026 Microchip Technology Inc. and its subsidiaries.
 *
 * SPDX-License-Identifier: Apache-2.0
 *
 * Mount Rainier MEC1767 on the proFPGA prototyping platform. Plain secure
 * single-image boot (no TrustZone/TF-M); flashless RAM execution.
 */

#include <microchip/mec1767xyz.dtsi>
#include <microchip/mec176x-pinctrl.dtsi>

/ {
	model = "Microchip Mount Rainier MEC1767 proFPGA";
	compatible = "microchip,mec176x_profpga", "microchip,mec1767_xyz";

	chosen {
		zephyr,sram = &sram0;
		zephyr,flash = &flash0;
		zephyr,console = &uart0;
		zephyr,shell-uart = &uart0;
	};
};

&uart0 {
	current-speed = <115200>;
	pinctrl-0 = <&uart0_tx_gpio104 &uart0_rx_gpio105>;
	pinctrl-names = "default";
	status = "okay";
};
