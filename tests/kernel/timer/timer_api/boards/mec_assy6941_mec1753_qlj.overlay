/*
 * Copyright (c) 2026 Microchip Technology Inc.
 *
 * SPDX-License-Identifier: Apache-2.0
 *
 * Make the MEC1753-QLJ board use the capture-compare timer (CCT) as the Zephyr
 * kernel timer instead of the default RTOS timer.
 *
 */

&rtimer {
	status = "disabled";
};

&cctmr0 {
	compatible = "microchip,xec-cct-ktimer";
	status = "okay";
};
