## samples/boards/microchip/evb/i2c_mux/sample.yaml
```yaml
sample:
  name: Microchip EVB I2C Mux sample
tests:
  sample.drivers.i2c
    tags: i2c_mux
    platform_allow:
      - mec_assy6941/mec1653b_nsz
      - mec_assy6941/mec1753_qlj
```

## samples/drivers/i3c/common/dts/bindings/i3c/microchip,i3c-fake-target.yaml
```yaml
# Copyright (c) 2024 Microchip Technology Inc.
# SPDX-License-Identifier: Apache-2.0

description: |
    Driver for a fake I3C target on bus

compatible: "microchip,i3c-fake-target"

include: ["i3c-device.yaml"]
```

## samples/drivers/led_mec5/sample.yaml
```yaml
sample:
  description: Demonstration of the Microchip MEC5 LED driver
  name: MEC5 LED sample
tests:
  sample.drivers.led.led_mec5:
    build_only: true
    tags: LED
    platform_allow:
      - mec_assy6906_mech1723nsz
      - mec_assy6906_mech1723nlj
      - mec_assy6941_mec1743qlj
      - mec_assy6941_mec1743qsz
      - mec_assy6941_mec1753qlj
      - mec_assy6941_mec1753qsz
```

## samples/drivers/mspi/mspi_flash/boards/mec_assy6941_mec1753_qlj.conf
```kconfig
# Copyright (c) 2026 Microchip Technology Inc.
# SPDX-License-Identifier: Apache-2.0

CONFIG_LOG=y
CONFIG_MSPI_LOG_LEVEL_INF=y
CONFIG_HEAP_MEM_POOL_SIZE=8192
# Do not enable CONFIG_MSPI_DMA
# It will select CONFIG_DMA for Zephyr's DMA driver.
# Microchip XEC QMSPI HW has 6 local-DMA channels
# If you want the driver to use Local-DMA enable:
#CONFIG_MSPI_XEC_QMSPI_LDMA=y
```

## samples/drivers/mspi/mspi_flash/boards/mec_assy6941_mec1753_qsz.conf
```kconfig
CONFIG_LOG=y
CONFIG_LOG_MODE_IMMEDIATE=y
# CONFIG_LOG_BUFFER_SIZE=8192
# CONFIG_MSPI_LOG_LEVEL_DBG=y
CONFIG_HEAP_MEM_POOL_SIZE=8192

CONFIG_MSPI_DMA=y

# turn off compiler optimizations so we can step code and
# set breakpoints easily
# CONFIG_DEBUG=y
```

## soc/arm/microchip_mec/mec1501/Kconfig.defconfig.mec1501hsz
```kconfig
# Kconfig - Microchip MEC1501HSZ MCU
#
# Copyright (c) 2018 Intel Corporation
#
# SPDX-License-Identifier: Apache-2.0
#

if SOC_MEC1501_HSZ

config SOC
	string
	default "mec1501hsz"

if SERIAL

config UART_NS16550
	def_bool y

endif # SERIAL

if PINMUX

config PINMUX_XEC
	default y

endif # PINMUX

config GPIO
	default y

if ADC

config ADC_XEC
	default y

endif # ADC

if GPIO

config GPIO_XEC
	default y

endif # GPIO

if I2C

config I2C_XEC
	def_bool y

endif # I2C

if COUNTER

config COUNTER_XEC
	def_bool y

endif # COUNTER

if PS2

config PS2_XEC
	default y

endif # PS2

if PWM

config PWM_XEC
	def_bool y

endif # PWM

if SOC_POWER_MANAGEMENT

config SYS_POWER_MANAGEMENT
	default y

config SYS_POWER_SLEEP_STATES
	default y

config HAS_SYS_POWER_STATE_SLEEP_1
	default y

config SYS_POWER_DEEP_SLEEP_STATES
	default y

config HAS_SYS_POWER_STATE_DEEP_SLEEP_1
	default y

config DEVICE_POWER_MANAGEMENT
	default n

endif # SOC_POWER_MANAGEMENT

endif # SOC_MEC1501_HSZ
```

## soc/arm/microchip_mec/mec1501/Kconfig.defconfig.series
```kconfig
# Kconfig - Microchip MEC MCU series configuration options
#
# Copyright (c) 2018 Intel Corporation
#
# SPDX-License-Identifier: Apache-2.0
#

if SOC_SERIES_MEC1501X

config SOC_SERIES
	string
	default "mec1501"

config NUM_IRQS
	int
	# must be >= the highest interrupt number used
	# - include the UART interrupts
	# All NVIC external sources.
	default 174

if SYS_CLOCK_EXISTS
# If the kernel has timer support, enable both clock control and timer
config CLOCK_CONTROL
	default y

config MCHP_XEC_RTOS_TIMER
	default y

config MCHP_XEC_CC_TIMER
	default n

endif # SYS_CLOCK_EXISTS

if MCHP_XEC_RTOS_TIMER

config SYS_CLOCK_HW_CYCLES_PER_SEC
	int
	default 32768

config SYS_CLOCK_TICKS_PER_SEC
	int
	default 32768

config ARCH_HAS_CUSTOM_BUSY_WAIT
	default y

endif # MCHP_XEC_RTOS_TIMER

if MCHP_XEC_CC_TIMER

config SYS_CLOCK_HW_CYCLES_PER_SEC
	int
	default 48000000

config SYS_CLOCK_TICKS_PER_SEC
	int
	default 10000

config ARCH_HAS_CUSTOM_BUSY_WAIT
	default y

endif # MCHP_XEC_CC_TIMER

source "soc/arm/microchip_mec/mec1501/Kconfig.defconfig.mec1501*"
endif # SOC_SERIES_MEC1501X
```

## soc/arm/microchip_mec/mec172x/Kconfig.defconfig.mec520xmlj
```kconfig
# Microchip MEC520XMSZ MCU

# Copyright (c) 2022 Microchip Technology Inc.
# SPDX-License-Identifier: Apache-2.0

if SOC_MEC520X_MLJ

config SOC
	default "mec520xmlj"

config GPIO
	default y

endif # SOC_MEC520X_MLJ
```

## soc/microchip/mec/Kconfig.soc
```kconfig
# Microchip MEC172x, MEC1501 MCU line

# Copyright (c) 2018 Intel Corporation
# SPDX-License-Identifier: Apache-2.0

config SOC_FAMILY_MICROCHIP_MEC
	bool

config SOC_FAMILY
	default "microchip_mec" if SOC_FAMILY_MICROCHIP_MEC

config SOC_MICROCHIP_MEC_PKG_144_WFBGA
	bool
	help
	  "WFBGA 144 pin package"

config SOC_MICROCHIP_MEC_PKG_176_WFBGA
	bool
	help
	  "WFBGA 176 pin package"

config SOC_MICROCHIP_MEC_PKG
	string
	default "WFBGA-144" if SOC_MICROCHIP_MEC_PKG_144_WFBGA
	default "WFBGA-176" if SOC_MICROCHIP_MEC_PKG_176_WFBGA
	help
	  Microchip MEC SoC package name.

config SOC_MICROCHIP_MEC_PKG_HAS_EEPROM
	bool
	help
	  Microchip MEC SoC include an internal EEPROM

config SOC_MICROCHIP_MEC_PKG_HAS_SPI_FLASH
	bool
	help
	  Microchip MEC SoC include an internal SPI flash

rsource "*/Kconfig.soc"
```

## soc/microchip/mec/mec15xx/Kconfig
```kconfig
# Microchip MEC1501 MCU core series

# Copyright (c) 2018 Intel Corporation
# SPDX-License-Identifier: Apache-2.0

config SOC_SERIES_MEC15XX
	select ARM
	select CPU_CORTEX_M4
	select CPU_CORTEX_M_HAS_DWT
	select CPU_HAS_ARM_MPU
	select HAS_PM
	select SOC_PREP_HOOK

config SOC_MEC1501_HSZ
	select HAS_MEC_HAL

if SOC_SERIES_MEC15XX

config SOC_MEC1501_VTR3_1_8V
	bool "VTR3 power rail is tied to 1.8V"
	help
	  Set this is if VTR3 power sourcejumper in the board is changed.

config SOC_MEC1501_VCI_PINS_AS_GPIOS
	bool "Use VCI block pins as GPIOS"
	default y
	help
	  By default these pins are not GPIOs, but HW controlled.
	  Set this if VCI pin block HW logic is not required in the board
	  design.

# GPIO initialization depends on SOC initialization, which happen at
# CONFIG_KERNEL_INIT_PRIORITY_DEFAULT, so GPIO_INIT_PRIORITY needs to be
# higher than that.
if GPIO

config GPIO_INIT_PRIORITY
	default 41

endif # GPIO

endif # SOC_SERIES_MEC15XX
```

## soc/microchip/mec/mec172x/Kconfig
```kconfig
# Microchip MEC172X MCU core series

# Copyright (c) 2021 Microchip Technology Inc.
# SPDX-License-Identifier: Apache-2.0

config SOC_SERIES_MEC172X
	select ARM
	select CPU_CORTEX_M4
	select CPU_CORTEX_M_HAS_DWT
	select CPU_HAS_FPU
	select CPU_HAS_ARM_MPU
	select HAS_SWO
	select HAS_PM
	select SOC_PREP_HOOK

if SOC_SERIES_MEC172X

# GPIO initialization depends on ECIA initialization, which happen at
# CONFIG_KERNEL_INIT_PRIORITY_DEFAULT, so GPIO_INIT_PRIORITY needs to be
# higher than that.
if GPIO

config GPIO_INIT_PRIORITY
	default 41

endif # GPIO

endif # SOC_SERIES_MEC172X
```

## soc/microchip/mec/mec175x/Kconfig.defconfig.series
```kconfig
# Copyright (c) 2024 Microchip Technology Inc.
# SPDX-License-Identifier: Apache-2.0

# Microchip MEC175x MCU series configuration options

if SOC_SERIES_MEC175X

config NUM_IRQS
	# must be >= the highest interrupt number used
	# - include the UART interrupts
	# All NVIC external sources.
	default 198

config CORTEX_M_SYSTICK
	depends on !MCHP_XEC_RTOS_TIMER && !MCHP_XEC_CCT_KTIMER

config SYS_CLOCK_HW_CYCLES_PER_SEC
	default $(dt_node_int_prop_int,/cpus/cpu@0,clock-frequency) if CORTEX_M_SYSTICK
	default $(dt_node_int_prop_int,/soc/timer@40007400,clock-frequency) if MCHP_XEC_RTOS_TIMER
	# CCT free-running counter runs at input-clock (48 MHz) divided by 4 (DIV4).
	default 12000000 if MCHP_XEC_CCT_KTIMER

# The CCT kernel timer hands timekeeping to the 32 KHz RTOS timer across PLL-off
# sleep via the driver-provided LPM hooks. `select` cannot target a choice
# symbol, so steer the choice default here (this defconfig is parsed before the
# generic drivers/timer Kconfig, so this default wins). Ignored gracefully if
# the HOOKS option is unavailable (needs TICKLESS_KERNEL and PM).
choice SYSTEM_TIMER_LPM_COMPANION
	default SYSTEM_TIMER_LPM_COMPANION_HOOKS if MCHP_XEC_CCT_KTIMER
endchoice

if MCHP_XEC_RTOS_TIMER
config SYS_CLOCK_TICKS_PER_SEC
	default $(dt_node_int_prop_int,/soc/timer@40007400,clock-frequency)

endif # MCHP_XEC_RTOS_TIMER

config ARCH_HAS_CUSTOM_BUSY_WAIT
	default y if MCHP_XEC_RTOS_TIMER

endif # SOC_SERIES_MEC175X
```

## soc/microchip/mec/mec175x/Kconfig.soc
```kconfig
# Copyright (c) 2024 Microchip Technology Inc.
# SPDX-License-Identifier: Apache-2.0

# Microchip MEC175x MCU core series

config SOC_SERIES_MEC175X
	bool
	select SOC_FAMILY_MICROCHIP_MEC
	help
	  Enable support for Microchip MEC Cortex-M4F MCU series

config SOC_SERIES
	default "mec175x" if SOC_SERIES_MEC175X

config SOC_MEC1753_QLJ
	bool
	select SOC_SERIES_MEC175X

config SOC_MEC1753_QSZ
	bool
	select SOC_SERIES_MEC175X

config SOC
	default "mec1753_qlj" if SOC_MEC1753_QLJ
	default "mec1753_qsz" if SOC_MEC1753_QSZ

# SoC power management
if SOC_SERIES_MEC175X
config SOC_MEC_PM_DEBUG_ON_DEEP_SLEEP
	bool "Keep JTAG/SWD on in deep sleep"
	default n
	help
	  Do not disable the JTAG/SWD debug interface in deep sleep.
	  A side-effect is the PLL will not shut off in deep sleep.

config SOC_MEC_PM_DEBUG_DEEP_SLEEP_CLK_REQ
	bool "Capture PCR CLK_REQ in VBAT memory"
	default n
	help
	  Save PCR peripheral clock requires status and EC subsystem
	  sleep mirror status in VBAT memory.

config SOC_MEC_PM_DEBUG_DS_CLK_REQ_VBAT_MEM_OFS
	int "VBAT memory offset for CLK_REQ"
	default 0
	depends on SOC_MEC_PM_DEBUG_DEEP_SLEEP_CLK_REQ
	help
	  Start byte offset for saving PCR CLK_REQ register values
	  if debug feature enabled. A total of 32 bytes are saved.

config SOC_MEC_PM_WAKE_PLL_LOCK_WAIT
	bool "Wait for PLL to lock with timeout"
	default y
	depends on PM || PM_DEVICE
	help
	  Upon wake spin with interrupts masked until PLL is locked.

config SOC_MEC_PM_WAKE_PLL_LOCK_WAIT_TIMEOUT_MS
	int ""
	default 6
	depends on SOC_MEC_PM_WAKE_PLL_LOCK_WAIT
	help
	  Add a timeout using 32 KHz based hibernation timer 0 to the
	  PLL lock spin loop. Current MEC HW maximum PLL lock time is
	  3 ms. Default value set to 6 ms for guard band. Zero disables
	  the timeout.
endif # SOC_SERIES_MEC175X
```

## soc/microchip/mr/Kconfig
```kconfig
# Microchip Mount Rainier MCU family
# (c) 2026 Microchip Technology Inc. and its subsidiaries.
# SPDX-License-Identifier: Apache-2.0

config SOC_FAMILY_MICROCHIP_MR
	bool
	# Declares the platform can use SEGGER RTT (live debug-probe console).
	# Capability flag only; inert unless the segger module is present and RTT
	# is configured. Standard pattern used by in-tree SoC families.
	select HAS_SEGGER_RTT if ZEPHYR_SEGGER_MODULE

if SOC_FAMILY_MICROCHIP_MR

# Pull in the per-series hardware Kconfig (CPU/arch selects).
rsource "*/Kconfig"

endif # SOC_FAMILY_MICROCHIP_MR
```

## soc/microchip/mr/Kconfig.defconfig
```kconfig
# (c) 2026 Microchip Technology Inc. and its subsidiaries.
# SPDX-License-Identifier: Apache-2.0

if SOC_FAMILY_MICROCHIP_MR

rsource "*/Kconfig.defconfig.series"

endif # SOC_FAMILY_MICROCHIP_MR
```

## soc/microchip/mr/Kconfig.soc
```kconfig
# Microchip Mount Rainier MCU family
# (c) 2026 Microchip Technology Inc. and its subsidiaries.
# SPDX-License-Identifier: Apache-2.0

config SOC_FAMILY_MICROCHIP_MR
	bool

config SOC_FAMILY
	default "microchip_mr" if SOC_FAMILY_MICROCHIP_MR

rsource "*/Kconfig.soc"
```

## soc/microchip/mr/mec176x/Kconfig
```kconfig
# Microchip Mount Rainier MEC176x core series
# (c) 2026 Microchip Technology Inc. and its subsidiaries.
# SPDX-License-Identifier: Apache-2.0
#
# Cortex-M55 (armv8.1-m) feature selection, per Mount Rainier DOS section 4.10:
#   - M55 with TrustZone, Helium (MVE) extension, single-precision FPU
#   - 16-region MPU (x2: secure + non-secure) + 8-region SAU
#   - No cache controller; ITCM + DTCM present
#   - NVIC 8 priority levels (3 priority bits), clock up to 192 MHz

config SOC_SERIES_MEC176X
	select ARM
	select CPU_CORTEX_M55
	select CPU_CORTEX_M_HAS_SYSTICK
	select CPU_CORTEX_M_HAS_VTOR
	select CPU_CORTEX_M_HAS_DWT
	select CPU_HAS_FPU
	select ARMV8_M_DSP
	select ARMV8_1_M_MVEI
	select ARMV8_1_M_MVEF
	select CPU_HAS_ARM_MPU
	select CPU_HAS_ARM_SAU
	select ARM_TRUSTZONE_M
	select SOC_EARLY_INIT_HOOK
```

## soc/microchip/mr/mec176x/Kconfig.defconfig.series
```kconfig
# Microchip Mount Rainier MEC176x series defaults
# (c) 2026 Microchip Technology Inc. and its subsidiaries.
# SPDX-License-Identifier: Apache-2.0

if SOC_SERIES_MEC176X

config NUM_IRQS
	# Must be > the highest NVIC line used. Mount Rainier GIRQ map tops out at
	# NVIC 197 (Mount_Rainier_GIRQ_mapping.xlsx); UART3 is 184.
	default 198

# Plain Cortex-M SysTick as the kernel timer (no MEC RTOS timer in this bring-up).
config SYS_CLOCK_HW_CYCLES_PER_SEC
	default $(dt_node_int_prop_int,/cpus/cpu@0,clock-frequency)

endif # SOC_SERIES_MEC176X
```

## soc/microchip/mr/mec176x/Kconfig.soc
```kconfig
# Microchip Mount Rainier MEC176x series
# (c) 2026 Microchip Technology Inc. and its subsidiaries.
# SPDX-License-Identifier: Apache-2.0

config SOC_SERIES_MEC176X
	bool
	select SOC_FAMILY_MICROCHIP_MR
	help
	  Microchip Mount Rainier MEC176x ARM Cortex-M55 MCU series.

config SOC_SERIES
	default "mec176x" if SOC_SERIES_MEC176X

config SOC_MEC1767_XYZ
	bool
	select SOC_SERIES_MEC176X

config SOC
	default "mec1767_xyz" if SOC_MEC1767_XYZ
```

## tests/drivers/counter/counter_basic_api/boards/mec_assy6941_mec1743qlj.conf
```kconfig
# To test the counter driver for MCHP RTOS timer and basic timer 5
# we must switch rtimer to use the counter driver which requires
# switching kernel to use ARM SysTick.
CONFIG_RTOS_TIMER=n
```

## tests/drivers/dma/scatter_gather/boards/mec15xxevb_assy6853.conf
```kconfig
# MEC15xx does not have enough data SRAM. Reduce transfer size
CONFIG_DMA_SG_XFER_SIZE=4096
```

## tests/drivers/flash/common/boards/mec_assy6941_mec1743_qlj.conf
```kconfig
CONFIG_FLASH_JESD216_API=y
CONFIG_SPI=y
CONFIG_SPI_NOR=y
CONFIG_TEST_DRIVER_FLASH_SIZE=16777216
```

## tests/drivers/i2c/i2c_api/boards/mec_assy6941_mec1753_qlj.conf
```kconfig
# Copyright (c) 2026 Microchip Technology Inc.
# SPDX-License-Identifier: Apache-2.0

# Test requires one of the GY271 sensor types selected — it probes for a
# sensor at the chosen address at run time. On the mec_assy6941 board no
# sensor is physically present, so the test's run-time probe will fail;
# what this config enables is build-time DT + driver verification.
CONFIG_SENSOR_GY271_HMC=y

# Exercise driver conditional-compile paths.
CONFIG_I2C_CALLBACK=y
CONFIG_I2C_TARGET=y
```
