## CMakeLists.txt
```
# SPDX-License-Identifier: Apache-2.0

cmake_minimum_required(VERSION 3.20.0)

find_package(Zephyr REQUIRED HINTS $ENV{ZEPHYR_BASE})
project(espi_target)

target_sources(app PRIVATE src/main.c)
```

## sample.yaml
```
sample:
  name: eSPI Target for the emulated eSPI host
tests:
  sample.boards.mchp_mec.espi_target:
    build_only: true
    platform_allow:
      - mec_assy6941/mec1753_qsz
    tags:
      - drivers
      - espi
```

## prj.conf
```kconfig
CONFIG_LOG=y
CONFIG_LOG_MODE_IMMEDIATE=y
CONFIG_GPIO=y
CONFIG_PINCTRL=y
CONFIG_PM=n

CONFIG_ESPI=y
CONFIG_ESPI_LOG_LEVEL_INF=y

# Host emulator waits for the Target to send TARGET_BOOT_DONE/STATUS
CONFIG_ESPI_AUTOMATIC_BOOT_DONE_ACKNOWLEDGE=n

# ACPI_EC0 (62h/66h), 8042 KBC and Port 80h
CONFIG_ESPI_PERIPHERAL_HOST_IO=y
# Driver reads ACPI_EC0 input byte in the IBF ISR, clearing IBF
CONFIG_ESPI_PERIPHERAL_ACPI_EC_IBF_EVT_DATA=y
CONFIG_ESPI_PERIPHERAL_8042_KBC=y
CONFIG_ESPI_PERIPHERAL_DEBUG_PORT_80=y

# Generic ACPI ECs used by the Host emulator I/O writes
CONFIG_ESPI_PERIPHERAL_HOST_IO_PVT=n
CONFIG_ESPI_PERIPHERAL_HOST_IO_PVT2=y
CONFIG_ESPI_PERIPHERAL_HOST_IO_PVT2_PORT_NUM=0x320
CONFIG_ESPI_PERIPHERAL_HOST_IO_PVT3=y
CONFIG_ESPI_PERIPHERAL_HOST_IO_PVT3_PORT_NUM=0x330
CONFIG_ESPI_PERIPHERAL_XEC_ACPI_EC4=y
CONFIG_ESPI_PERIPHERAL_XEC_ACPI_EC4_PORT_NUM=0x340

# EMI0/EMI1 mapped to Host memory
CONFIG_ESPI_PERIPHERAL_XEC_EMI0=y
CONFIG_ESPI_PERIPHERAL_XEC_EMI1=y

# Not used by the Host emulator
CONFIG_ESPI_PERIPHERAL_UART=n
CONFIG_ESPI_PERIPHERAL_XEC_MAILBOX=n
```

## boards/mec_assy6906_mech1723_nlj.overlay
```dts
/*
 * Copyright (c) 2025 Microchip Technology Inc.
 *
 * SPDX-License-Identifier: Apache-2.0
 */

/* mec_assy6906 EVB with MEC1723N-LJ daughter card
 * MEC1723 does not have an internal SPI flash.
 */

#include "mec_common.dtsi"

&qspi0 {
	compatible = "microchip,mec5-qspi";
	status = "okay";
	pinctrl-0 = < &qspi_shd_cs0_n_gpio055
		      &qspi_shd_clk_gpio056
		      &qspi_shd_io0_gpio223
		      &qspi_shd_io1_gpio224
		      &qspi_shd_io2_gpio227
		      &qspi_shd_io3_gpio016 >;
	pinctrl-names = "default";
};
```

## boards/mec_assy6906_mech1723_nsz.overlay
```dts
/*
 * Copyright (c) 2025 Microchip Technology Inc.
 *
 * SPDX-License-Identifier: Apache-2.0
 */

/* mec_assy6906 EVB with MEC1723N-SZ daughter card
 * MEC1723 does not have an internal SPI flash.
 */

#include "mec_common.dtsi"

&qspi0 {
	compatible = "microchip,mec5-qspi";
	status = "okay";
	pinctrl-0 = < &qspi_shd_cs0_n_gpio055
		      &qspi_shd_clk_gpio056
		      &qspi_shd_io0_gpio223
		      &qspi_shd_io1_gpio224
		      &qspi_shd_io2_gpio227
		      &qspi_shd_io3_gpio016 >;
	pinctrl-names = "default";
};
```

## boards/mec_assy6906_mech1723nlj.overlay
```dts
/*
 * Copyright (c) 2023 Microchip Technology Inc.
 *
 * SPDX-License-Identifier: Apache-2.0
 */

/* mec_assy6906 EVB with MEC1723N-LJ daughter card
 * MEC1723 does not have an internal SPI flash.
 */

#include "mec_common.dtsi"

&qspi0 {
	compatible = "microchip,mec5-qspi";
	status = "okay";
	pinctrl-0 = < &qspi_shd_cs0_n_gpio055
		      &qspi_shd_clk_gpio056
		      &qspi_shd_io0_gpio223
		      &qspi_shd_io1_gpio224
		      &qspi_shd_io2_gpio227
		      &qspi_shd_io3_gpio016 >;
	pinctrl-names = "default";
};
```

## boards/mec_assy6906_mech1723nsz.overlay
```dts
/*
 * Copyright (c) 2023 Microchip Technology Inc.
 *
 * SPDX-License-Identifier: Apache-2.0
 */

/* mec_assy6906 EVB with MEC1723N-SZ daughter card
 * MEC1723 does not have an internal SPI flash.
 */

#include "mec_common.dtsi"

&qspi0 {
	compatible = "microchip,mec5-qspi";
	status = "okay";
	pinctrl-0 = < &qspi_shd_cs0_n_gpio055
		      &qspi_shd_clk_gpio056
		      &qspi_shd_io0_gpio223
		      &qspi_shd_io1_gpio224
		      &qspi_shd_io2_gpio227
		      &qspi_shd_io3_gpio016 >;
	pinctrl-names = "default";
};
```

## boards/mec_assy6941_mec1743qlj.overlay
```dts
/*
 * Copyright (c) 2023 Microchip Technology Inc.
 *
 * SPDX-License-Identifier: Apache-2.0
 */

/* mec_assy6941 EVB with MEC1743Q-LJ daughter card
 * MEC1743 does not have an internal SPI flash.
 */

#include "mec_common.dtsi"

&qspi0 {
	compatible = "microchip,mec5-qspi";
	status = "okay";
	pinctrl-0 = < &qspi_shd_cs0_n_gpio055
		      &qspi_shd_clk_gpio056
		      &qspi_shd_io0_gpio223
		      &qspi_shd_io1_gpio224
		      &qspi_shd_io2_gpio227
		      &qspi_shd_io3_gpio016 >;
	pinctrl-names = "default";
};
```

## boards/mec_assy6941_mec1753_qlj.overlay
```dts
/*
 * Copyright (c) 2025 Microchip Technology Inc.
 *
 * SPDX-License-Identifier: Apache-2.0
 */

/* mec_assy6941 EVB with MEC1753Q-LJ daughter card
 * MEC1753 does not have an internal SPI flash.
 */

#include "mec_common.dtsi"

&qspi0 {
	compatible = "microchip,mec5-qspi";
	status = "okay";
	pinctrl-0 = < &qspi_shd_cs0_n_gpio055
		      &qspi_shd_clk_gpio056
		      &qspi_shd_io0_gpio223
		      &qspi_shd_io1_gpio224
		      &qspi_shd_io2_gpio227
		      &qspi_shd_io3_gpio016 >;
	pinctrl-names = "default";
};
```

## src/main.c
```c
/*
 * Copyright (c) 2026 Microchip Technology Inc.
 *
 * SPDX-License-Identifier: Apache-2.0
 */

/* eSPI Target sample for the in-tree Microchip XEC V2 eSPI driver.
 * Pairs with samples/boards/mchp_mec5/espi_host_emu running on a second
 * board. Handshake pins:
 *   espi-gpios[0] Target_nREADY output to Host emulator
 *   espi-gpios[1] VCC_PWRGD_ALT input driven by Host emulator
 *   espi-gpios[2] Host_nREADY input from Host emulator
 */

#include <errno.h>
#include <stdint.h>
#include <string.h>

#include <soc.h>
#include <zephyr/device.h>
#include <zephyr/devicetree.h>
#include <zephyr/kernel.h>
#include <zephyr/drivers/espi.h>
#include <zephyr/drivers/espi/mchp_xec_espi.h>
#include <zephyr/drivers/gpio.h>
#include <zephyr/drivers/pinctrl.h>
#include <zephyr/logging/log.h>
#include <zephyr/logging/log_ctrl.h>
LOG_MODULE_REGISTER(app, LOG_LEVEL_INF);

#define ZEPHYR_USER_NODE DT_PATH(zephyr_user)
#define ESPI0_NODE       DT_NODELABEL(espi0)

#define ESPI0_IOC_BASE   DT_REG_ADDR_BY_NAME(ESPI0_NODE, io)

/* EC_IRQ generates the EC Serial IRQ in the slot programmed in SIRQ[SIRQ_EC].
 * The XEC V2 driver has no API for it.
 */
#define APP_EC_SIRQ_SLOT 7u

static struct xec_espi_ioc_bar_ldm *const espi_ldm_regs =
	(struct xec_espi_ioc_bar_ldm *)(ESPI0_IOC_BASE + MCHP_ESPI_IO_HOST_BAR_OFS);
static struct xec_espi_ioc_cfg_regs *const espi_cfg_regs =
	(struct xec_espi_ioc_cfg_regs *)(ESPI0_IOC_BASE + MCHP_ESPI_IO_CFG_OFS);

PINCTRL_DT_DEFINE(ZEPHYR_USER_NODE);

static const struct pinctrl_dev_config *app_pinctrl_cfg =
	PINCTRL_DT_DEV_CONFIG_GET(ZEPHYR_USER_NODE);

static const struct gpio_dt_spec target_n_ready_out_dt =
	GPIO_DT_SPEC_GET_BY_IDX(ZEPHYR_USER_NODE, espi_gpios, 0);
static const struct gpio_dt_spec vcc_pwrgd_alt_in_dt =
	GPIO_DT_SPEC_GET_BY_IDX(ZEPHYR_USER_NODE, espi_gpios, 1);
static const struct gpio_dt_spec host_n_ready_in_dt =
	GPIO_DT_SPEC_GET_BY_IDX(ZEPHYR_USER_NODE, espi_gpios, 2);

static const struct device *const espi_dev = DEVICE_DT_GET(ESPI0_NODE);

static struct espi_callback espi_cb_reset;
static struct espi_callback espi_cb_chan_ready;
static struct espi_callback espi_cb_vw;
static struct espi_callback espi_cb_periph;
static struct gpio_callback gpio_cb_vcc_pwrgd;

static volatile uint32_t espi_reset_ev_cnt;
static volatile uint8_t espi_reset_ev_state;

static uint8_t *sram_bar_buf[2];
static size_t sram_bar_size[2];

static void spin_on(uint32_t id, int rval)
{
	LOG_ERR("spin id = %u ret = %d", id, rval);
	log_panic();

	while (1) {
		k_sleep(K_MSEC(1000));
	}
}

static void gpio_cb(const struct device *port, struct gpio_callback *cb, gpio_port_pins_t pins)
{
	ARG_UNUSED(port);
	ARG_UNUSED(cb);
	ARG_UNUSED(pins);

	LOG_INF("GPIO CB: VCC_PWRGD_ALT = %d", gpio_pin_get_dt(&vcc_pwrgd_alt_in_dt));
}

static void espi_reset_cb(const struct device *dev, struct espi_callback *cb,
			  struct espi_event ev)
{
	ARG_UNUSED(dev);
	ARG_UNUSED(cb);

	espi_reset_ev_cnt++;
	espi_reset_ev_state = (uint8_t)(ev.evt_data & 0x7fu);
	LOG_INF("eSPI CB: eSPI_nReset = %u", espi_reset_ev_state);
}

static void espi_chan_ready_cb(const struct device *dev, struct espi_callback *cb,
			       struct espi_event ev)
{
	static const char *const chan_names[] = {"PC", "VW", "OOB", "FC"};
	const char *name = "?";

	ARG_UNUSED(dev);
	ARG_UNUSED(cb);

	for (size_t n = 0; n < ARRAY_SIZE(chan_names); n++) {
		if (ev.evt_details == BIT(n)) {
			name = chan_names[n];
		}
	}

	LOG_INF("eSPI CB: channel %s ready = %u", name, ev.evt_data);
}

static void espi_vw_received_cb(const struct device *dev, struct espi_callback *cb,
				struct espi_event ev)
{
	ARG_UNUSED(dev);
	ARG_UNUSED(cb);

	LOG_INF("eSPI CB: VW received: signal %u level %u", ev.evt_details, ev.evt_data);
}

static void espi_periph_cb(const struct device *dev, struct espi_callback *cb,
			   struct espi_event ev)
{
	ARG_UNUSED(dev);
	ARG_UNUSED(cb);

	if ((ev.evt_details & 0xffffu) == ESPI_PERIPHERAL_DEBUG_PORT80) {
#ifdef CONFIG_ESPI_XEC_P80_MULTIBYTE
		/* One event per Host write: evt_details b[19:16] = byte lane mask,
		 * b[23:20] = width in bytes, evt_data = bytes placed in their lanes.
		 */
		LOG_INF("eSPI CB: PC Port 80 width %u lanes 0x%x = 0x%08x",
			(ev.evt_details >> 20) & 0xfu, (ev.evt_details >> 16) & 0xfu, ev.evt_data);
#else
		/* One event per byte: evt_details b[23:16] = byte lane,
		 * evt_data b[7:0] = value written by the Host.
		 */
		LOG_INF("eSPI CB: PC Port 80 lane %u = 0x%02x", (ev.evt_details >> 16) & 0xffu,
			ev.evt_data & 0xffu);
#endif
		return;
	}

	switch (ev.evt_details) {
	case ESPI_PERIPHERAL_UART:
		LOG_INF("eSPI CB: PC Host UART");
		break;
	case ESPI_PERIPHERAL_8042_KBC:
		LOG_INF("eSPI CB: PC 8042-KBC data 0x%x", ev.evt_data);
		break;
	case ESPI_PERIPHERAL_HOST_IO: {
		struct espi_evt_data_acpi *acpi = (struct espi_evt_data_acpi *)&ev.evt_data;

		LOG_INF("eSPI CB: PC ACPI_EC0 %s 0x%02x", acpi->type ? "cmd" : "data", acpi->data);
		break;
	}
	case ESPI_PERIPHERAL_HOST_IO_PVT:
	case ESPI_PERIPHERAL_HOST_IO_PVT2:
	case ESPI_PERIPHERAL_HOST_IO_PVT3:
		LOG_INF("eSPI CB: PC Host PVT%u I/O data 0x%x",
			ev.evt_details - ESPI_PERIPHERAL_HOST_IO_PVT + 1u, ev.evt_data);
		break;
#ifdef CONFIG_ESPI_PERIPHERAL_XEC_ACPI_EC4
	case MCHP_XEC_ESPI_PERIPHERAL_ACPI_EC4:
		LOG_INF("eSPI CB: PC ACPI_EC4 I/O data 0x%x", ev.evt_data);
		break;
#endif
	default:
#if defined(CONFIG_ESPI_PERIPHERAL_XEC_EMI0) || defined(CONFIG_ESPI_PERIPHERAL_XEC_EMI1) ||      \
	defined(CONFIG_ESPI_PERIPHERAL_XEC_EMI2)
		if ((ev.evt_details & ~0xffu) == MCHP_XEC_ESPI_PERIPHERAL_EMI) {
			uint8_t emi_id = ev.evt_details & 0xffu;

			LOG_INF("eSPI CB: EMI%u Host-to-EC mailbox = 0x%02x", emi_id,
				ev.evt_data);
			mchp_xec_espi_emi_mbox_ack(dev, emi_id);
			break;
		}
#endif
		LOG_INF("eSPI CB: PC details 0x%x data 0x%x", ev.evt_details, ev.evt_data);
		break;
	}
}

static int app_add_callbacks(void)
{
	int ret;

	espi_init_callback(&espi_cb_reset, espi_reset_cb, ESPI_BUS_RESET);
	espi_init_callback(&espi_cb_chan_ready, espi_chan_ready_cb, ESPI_BUS_EVENT_CHANNEL_READY);
	espi_init_callback(&espi_cb_vw, espi_vw_received_cb, ESPI_BUS_EVENT_VWIRE_RECEIVED);
	espi_init_callback(&espi_cb_periph, espi_periph_cb, ESPI_BUS_PERIPHERAL_NOTIFICATION);

	ret = espi_add_callback(espi_dev, &espi_cb_reset);
	ret = ret ? ret : espi_add_callback(espi_dev, &espi_cb_chan_ready);
	ret = ret ? ret : espi_add_callback(espi_dev, &espi_cb_vw);
	ret = ret ? ret : espi_add_callback(espi_dev, &espi_cb_periph);

	return ret;
}

static void app_sram_bars_init(void)
{
	for (uint8_t id = 0; id < ARRAY_SIZE(sram_bar_buf); id++) {
		int ret = mchp_xec_espi_sram_bar_get(espi_dev, id, &sram_bar_buf[id],
						     &sram_bar_size[id]);

		if (ret) {
			LOG_INF("SRAM BAR%u not enabled (%d)", id, ret);
			continue;
		}

		memset(sram_bar_buf[id], 0, sram_bar_size[id]);
		LOG_INF("SRAM BAR%u: EC buffer %p size %u", id, sram_bar_buf[id],
			(uint32_t)sram_bar_size[id]);
	}
}

static void app_sram_bars_dump(void)
{
	for (uint8_t id = 0; id < ARRAY_SIZE(sram_bar_buf); id++) {
		if (sram_bar_buf[id] != NULL) {
			LOG_HEXDUMP_INF(sram_bar_buf[id], 32, "SRAM BAR data written by Host:");
		}
	}
}

static void wait_chan_enabled(enum espi_channel ch, const char *name)
{
	LOG_INF("Poll driver for %s channel enable", name);
	while (!espi_get_channel_status(espi_dev, ch)) {
		k_sleep(K_MSEC(10));
	}
	LOG_INF("%s channel is enabled", name);
}

static int toggle_sci(void)
{
	uint8_t level = 0;
	int ret;

	ret = espi_receive_vwire(espi_dev, ESPI_VWIRE_SIGNAL_SCI, &level);
	if (ret) {
		return ret;
	}

	ret = espi_send_vwire(espi_dev, ESPI_VWIRE_SIGNAL_SCI, level ^ 1u);
	if (ret) {
		return ret;
	}

	k_sleep(K_MSEC(500)); /* Host eSPI emulator polls */

	return espi_send_vwire(espi_dev, ESPI_VWIRE_SIGNAL_SCI, level);
}

int main(void)
{
	struct espi_cfg ecfg = {
		.io_caps = ESPI_IO_MODE_SINGLE_LINE,
		.channel_caps = ESPI_CHANNEL_PERIPHERAL | ESPI_CHANNEL_VWIRE | ESPI_CHANNEL_OOB |
				ESPI_CHANNEL_FLASH,
		.max_freq = 20u,
	};
	int ret;

	LOG_INF("XEC eSPI Target sample for board: %s", CONFIG_BOARD);

	if (!device_is_ready(espi_dev)) {
		spin_on(__LINE__, -ENODEV);
	}

	ret = gpio_pin_configure_dt(&host_n_ready_in_dt, GPIO_INPUT);
	if (ret) {
		spin_on(__LINE__, ret);
	}

	LOG_INF("Wait for Host Emulator Ready");
	do {
		k_sleep(K_MSEC(10));
		ret = gpio_pin_get_dt(&host_n_ready_in_dt);
		if (ret < 0) {
			spin_on(__LINE__, ret);
		}
	} while (ret == 1);
	LOG_INF("Host Emulator is Ready");

	ret = pinctrl_apply_state(app_pinctrl_cfg, PINCTRL_STATE_DEFAULT);
	if (ret) {
		spin_on(__LINE__, ret);
	}

	ret = gpio_pin_configure_dt(&target_n_ready_out_dt, GPIO_OUTPUT_HIGH);
	if (ret) {
		spin_on(__LINE__, ret);
	}

	gpio_init_callback(&gpio_cb_vcc_pwrgd, gpio_cb, BIT(vcc_pwrgd_alt_in_dt.pin));
	ret = gpio_add_callback_dt(&vcc_pwrgd_alt_in_dt, &gpio_cb_vcc_pwrgd);
	ret = ret ? ret : gpio_pin_configure_dt(&vcc_pwrgd_alt_in_dt, GPIO_INPUT);
	ret = ret ? ret : gpio_pin_interrupt_configure_dt(&vcc_pwrgd_alt_in_dt,
							  GPIO_INT_EDGE_BOTH);
	if (ret) {
		spin_on(__LINE__, ret);
	}

	k_sleep(K_MSEC(10)); /* let pins settle */

	/* XEC V2 driver selects eSPI VW PLTRST# as platform reset and releases
	 * RESET_VCC during initialization.
	 */
	LOG_INF("Call eSPI driver config API");
	ret = espi_config(espi_dev, &ecfg);
	if (ret) {
		spin_on(__LINE__, ret);
	}

	ret = app_add_callbacks();
	if (ret) {
		spin_on(__LINE__, ret);
	}

	app_sram_bars_init();

	/* EC SIRQ slot used when the Target generates EC_IRQ below */
	espi_cfg_regs->SIRQ[SIRQ_EC] = APP_EC_SIRQ_SLOT;

	LOG_INF("Signal Host emulator Target is Ready");
	gpio_pin_set_dt(&target_n_ready_out_dt, 0);

	LOG_INF("Wait for Host to de-assert ESPI_nRESET");
	while ((espi_reset_ev_cnt == 0) || (espi_reset_ev_state == 0)) {
		k_sleep(K_MSEC(10));
	}

	wait_chan_enabled(ESPI_CHANNEL_VWIRE, "VW");
	wait_chan_enabled(ESPI_CHANNEL_OOB, "OOB");
	wait_chan_enabled(ESPI_CHANNEL_FLASH, "Flash");

	LOG_INF("Send VW TARGET_BOOT_LOAD_DONE/STATUS = 1");
	ret = espi_send_vwire(espi_dev, ESPI_VWIRE_SIGNAL_TARGET_BOOT_STS, 1);
	ret = ret ? ret : espi_send_vwire(espi_dev, ESPI_VWIRE_SIGNAL_TARGET_BOOT_DONE, 1);
	if (ret) {
		spin_on(__LINE__, ret);
	}

	wait_chan_enabled(ESPI_CHANNEL_PERIPHERAL, "Peripheral");

	k_sleep(K_MSEC(1000));

	LOG_INF("Send EC_IRQ=%u Serial IRQ to the Host", APP_EC_SIRQ_SLOT);
	espi_ldm_regs->PCECIRQ = MCHP_ESPI_EC_IRQ_GEN;

	k_sleep(K_MSEC(500));

	LOG_INF("Toggle nSCI VWire");
	ret = toggle_sci();
	if (ret) {
		spin_on(__LINE__, ret);
	}

	/* Host emulator runs its I/O and memory tests next. Periodically show
	 * what the Host wrote into the SRAM BARs.
	 */
	while (1) {
		k_sleep(K_SECONDS(5));
		app_sram_bars_dump();
	}

	return 0;
}
```

## src/ESPI_KBC_Hal.c
```c
/****************************************************************************
* 2014 Microchip Technology Inc. and its subsidiaries.
* You may use this software and any derivatives exclusively with
* Microchip products.
* THIS SOFTWARE IS SUPPLIED BY MICROCHIP "AS IS".
* NO WARRANTIES, WHETHER EXPRESS, IMPLIED OR STATUTORY, APPLY TO THIS SOFTWARE,
* INCLUDING ANY IMPLIED WARRANTIES OF NON-INFRINGEMENT, MERCHANTABILITY,
* AND FITNESS FOR A PARTICULAR PURPOSE, OR ITS INTERACTION WITH MICROCHIP
* PRODUCTS, COMBINATION WITH ANY OTHER PRODUCTS, OR USE IN ANY APPLICATION.
* IN NO EVENT WILL MICROCHIP BE LIABLE FOR ANY INDIRECT, SPECIAL, PUNITIVE,
* INCIDENTAL OR CONSEQUENTIAL LOSS, DAMAGE, COST OR EXPENSE OF ANY KIND
* WHATSOEVER RELATED TO THE SOFTWARE, HOWEVER CAUSED, EVEN IF MICROCHIP HAS
* BEEN ADVISED OF THE POSSIBILITY OR THE DAMAGES ARE FORESEEABLE.
* TO THE FULLEST EXTENT ALLOWED BY LAW, MICROCHIP'S TOTAL LIABILITY ON ALL
* CLAIMS IN ANY WAY RELATED TO THIS SOFTWARE WILL NOT EXCEED THE AMOUNT OF
* FEES, IF ANY, THAT YOU HAVE PAID DIRECTLY TO MICROCHIP FOR THIS SOFTWARE.
* MICROCHIP PROVIDES THIS SOFTWARE CONDITIONALLY UPON YOUR ACCEPTANCE
* OF THESE TERMS.
*/

/*
 **********************************************************************************
 *  ESPI_PC_Hal.C
 *      This is the ESPI service file: Peripheral channel process
 **********************************************************************************
 */

/******************************************************************************/
/** @defgroup ESPI_PC ESPI_PC
 *  @{
 */

/** @file ESPI_PC.c
* \brief ESPI_PC source file
* \author KBCEC Team
*
******************************************************************************/

/* for global */
#include <zephyr/kernel.h>
#include <soc.h>
//#include <soc_espi.h>
#include <errno.h>
#include <zephyr/arch/common/ffs.h>
#include <zephyr/device.h>
#include <zephyr/devicetree.h>
#include <zephyr/drivers/espi.h>
#include <zephyr/drivers/pinctrl.h>
#include <zephyr/dt-bindings/espi/mchp-mec5-espi.h>
#include <zephyr/logging/log.h>
#include <zephyr/sys/sys_io.h>
#include <zephyr/sys/util.h>
#include <zephyr/irq.h>
/* TODO #include "espi_utils.h" */
//#include "espi_mchp_mec5_private.h"

/* MEC5 HAL */
#include <device_mec5.h>
#include <mec_retval.h>
#include <mec_pcr_api.h>
#include <mec_espi_api.h>
#include <mec_kbc_api.h>

//LOG_MODULE_REGISTER(espi_acpi_ec, CONFIG_ESPI_LOG_LEVEL);

/* get KBC0 / 8042 register struct from device tree */
#define KBC0_8042_NODE DT_NODELABEL(kbc0)
//struct kbc_regs *const kbc0_8042_regs = (struct kbc_regs *)DT_REG_ADDR(KBC0_8042_NODE);
struct mec_kbc_regs *const kbc0_8042_regs = (struct mec_kbc_regs *)DT_REG_ADDR(KBC0_8042_NODE);

/* for local */
#include "ESPI_KBC_Hal.h"

/* global variables */
unsigned char Cmd_Byte = 0;
unsigned char Cmd_D4h_AUX_Cmd = 0;
unsigned char AUX_F3h_dat = 0;
unsigned char AUX_E8h_dat = 0;

unsigned char Cmd_KBD = 0;
unsigned char Ccb42_byte = 0;
unsigned char KBD_EDh_dat = 0;

/* support kbc / 8042 cmd & data process */
/* tx KBC/KBD data to KBC */
void Data_To_Host(unsigned char value)
{
	unsigned char sts_byte;
	/* set status properly */
//	sts_byte = mec_kbc_status(kbc0_8042_regs);
	sts_byte = mec_hal_kbc_status(kbc0_8042_regs);
	sts_byte &=  ~(MEC_KBC_STS_UD2_B1  | /* Parity error bits. */
                   MEC_KBC_STS_UD2_B0  | /* General time out error bits. */
                   MEC_KBC_STS_AUXOBF  | /* Send time out error bits for AT. */
                   MEC_KBC_STS_AUXOBF);  /* Aux device bits for PS/2. */
//	mec_kbc_status_wr(kbc0_8042_regs, sts_byte, 0x00);
	mec_hal_kbc_status_wr(kbc0_8042_regs, sts_byte, 0x00);

//	mec_kbc_wr_data(kbc0_8042_regs, value, MEC_KBC_DATA_KB);
	mec_hal_kbc_wr_data(kbc0_8042_regs, value, MEC_KBC_DATA_KB);
}

/* tx AUX data to KBC */
void Data_To_Host_AUX(unsigned char value)
{
	unsigned char sts_byte;
	/* set status properly */
//	sts_byte = mec_kbc_status(kbc0_8042_regs);
	sts_byte = mec_hal_kbc_status(kbc0_8042_regs);
	sts_byte = (sts_byte & ~(MEC_KBC_STS_UD2_B1  | /* Parity error bits. */
                   			MEC_KBC_STS_UD2_B0   | /* General time out error bits. */
                   			MEC_KBC_STS_AUXOBF))   /* Send time out error bits for AT. */
                   			| MEC_KBC_STS_AUXOBF;  /* Aux device bits for PS/2. */
//	mec_kbc_status_wr(kbc0_8042_regs, sts_byte, 0x00);
	mec_hal_kbc_status_wr(kbc0_8042_regs, sts_byte, 0x00);

//	mec_kbc_wr_data(kbc0_8042_regs, value, MEC_KBC_DATA_AUX);
	mec_hal_kbc_wr_data(kbc0_8042_regs, value, MEC_KBC_DATA_AUX);
}

unsigned char Output_Buffer_Full(void)
{
	unsigned char ret;
//	ret = mec_kbc_status(kbc0_8042_regs) & MEC_KBC_STS_OBF;
	ret = mec_hal_kbc_status(kbc0_8042_regs) & MEC_KBC_STS_OBF;
	return ret;
}

/******************************************************************************/
/** ESPI_Srvc_Kbcdat1
 * Process KBC commands...
 *
 * @param None
 *
 * @return None
 *
 ******************************************************************************/
void ESPI_Srvc_Kbcdat1(unsigned char value)
{
	unsigned char value_tmp;

	if(Cmd_Byte == 0)
	{	/* this is KBD cmd, host writes 60h / data register directly */

		if(Cmd_KBD == 0)
		{	/* first kbd cmd */
			switch(value)
			{
				case 0xED:
					/* AUX cmd - ack FAh to host */
	        		while(Output_Buffer_Full())
					{
					}
					/* ACK */
					value_tmp = 0xFA;
            		Data_To_Host(value_tmp);
					Cmd_KBD = 0xED;
					break;


      			default:
			    	break;
			} /* switch(Cmd_Byte) */
		}
		else
		{
			switch(Cmd_KBD)
			{
				case 0xED:
					KBD_EDh_dat = value;
					/* AUX cmd - ack FAh to host */
	        		while(Output_Buffer_Full())
					{
					}
					/* ACK */
					value_tmp = 0xFA;
            		Data_To_Host(value_tmp);
					Cmd_KBD = 0;
					break;

      			default:
			    	break;
			} /* switch(Cmd_Byte) */
		}

	}
	else
	{
		switch(Cmd_Byte)
		{
			case 0xD4:
				/* 0xD4 - following cmd or data to AUX device */
				if(Cmd_D4h_AUX_Cmd == 0)
				{
				switch(value)
				{
					case 0xE8:
						/* AUX cmd - ack FAh to host */
	        			while(Output_Buffer_Full())
						{
						}
						/* ACK */
            			Data_To_Host_AUX(0xFA);
						Cmd_Byte = 0;
						Cmd_D4h_AUX_Cmd = 0xE8;
						break;

					case 0xF3:
						/* AUX cmd - ack FAh to host */
	        			while(Output_Buffer_Full())
						{
						}
						/* ACK */
            			Data_To_Host_AUX(0xFA);
						Cmd_Byte = 0;
						Cmd_D4h_AUX_Cmd = 0xF3;
						break;

					case 0xE6:
						/* AUX cmd - ack FAh to host */
	        			while(Output_Buffer_Full())
						{
						}
						/* ACK */
						//value_tmp = 0xFA;
            			Data_To_Host_AUX(0xFA);
						Cmd_Byte = 0;
						break;

					case 0xF4:
						/* AUX cmd - ack FAh to host */
	        			while(Output_Buffer_Full())
						{
						}
						/* ACK */
						value_tmp = 0xFA;
            			Data_To_Host_AUX(value_tmp);
						Cmd_Byte = 0;
						break;

					case 0xFF:
						/* AUX cmd - reset AUX */
	        			while(Output_Buffer_Full())
						{
						}
						/* ACK */
						//value_tmp = 0xFA;
            			Data_To_Host_AUX(0xFA);

	        			while(Output_Buffer_Full())
						{
						}
						/* ACK */
            			Data_To_Host_AUX(0xAA);

	        			while(Output_Buffer_Full())
						{
						}
						/* ACK */
            			Data_To_Host_AUX(0x00);

						Cmd_Byte = 0;
						break;

					default:
						break;
				} /* switch(value) */
				}
				else
				{	/* has previous AUX cmd */
					switch(Cmd_D4h_AUX_Cmd)
					{
						case 0xE8:
							/* AUX cmd - ack FAh to host */
	        				while(Output_Buffer_Full())
							{
							}
							/* ACK */
							//value_tmp = 0xFA;
            				Data_To_Host_AUX(0xFA);

							/* grab data of E8h */
							AUX_E8h_dat = value;
							Cmd_Byte = 0;
							Cmd_D4h_AUX_Cmd = 0;
							break;

						case 0xF3:
							/* AUX cmd - ack FAh to host */
	        				while(Output_Buffer_Full())
							{
							}
							/* ACK */
							value_tmp = 0xFA;
            				Data_To_Host_AUX(value_tmp);

							/* grab data of F3h */
							AUX_F3h_dat = value;
							Cmd_Byte = 0;
							Cmd_D4h_AUX_Cmd = 0;
							break;

						default:
							break;
					}
				}
				break;

			case 0x60:
				/* 0x60 - following one data */
				Ccb42_byte = value;
				Cmd_Byte = 0;
				break;


      		default:
			    break;
		} /* switch(Cmd_Byte) */
	}
}


/******************************************************************************/
/** ESPI_KBC_Cmd
 * Process KBC commands...
 *
 * @param None
 *
 * @return None
 *
 ******************************************************************************/
void ESPI_KBC_Cmd(unsigned char command_num)
{
	unsigned char value_tmp;

	switch(command_num)
	{
		case 0xAA:
	        while(Output_Buffer_Full())
			{
			}
			/* self test */
			value_tmp = 0x55;
            Data_To_Host(value_tmp);
			break;

		case 0xD4:
			/* 0xD4 - following cmd or data to AUX device */
			/* will rx one data byte */
			Cmd_Byte = command_num;   /* Save command number and wait for value byte. */
			break;

		case 0x60:
			/* 0x60 - following one data */
			Cmd_Byte = command_num;   /* Save command number and wait for value byte. */
			break;

		case 0x20:
	        while(Output_Buffer_Full())
			{
			}
			/* read */
            Data_To_Host(Ccb42_byte);
			break;

		case 0xAD:     
			break;

		case 0xA7:     
			break;

		case 0xA8:     
			break;

      	default:
			trace1(0, ESPI_PC, 0, "ESPI_KBC_Cmd: oop??? unsupported cmd, command_num  = %02Xh", command_num);
            break;
	} /* switch(command_num) */
}

/**   @}
 */
```

## src/ESPI_KBC_Hal.h
```c
/****************************************************************************
* 2014 Microchip Technology Inc. and its subsidiaries.
* You may use this software and any derivatives exclusively with
* Microchip products.
* THIS SOFTWARE IS SUPPLIED BY MICROCHIP "AS IS".
* NO WARRANTIES, WHETHER EXPRESS, IMPLIED OR STATUTORY, APPLY TO THIS SOFTWARE,
* INCLUDING ANY IMPLIED WARRANTIES OF NON-INFRINGEMENT, MERCHANTABILITY,
* AND FITNESS FOR A PARTICULAR PURPOSE, OR ITS INTERACTION WITH MICROCHIP
* PRODUCTS, COMBINATION WITH ANY OTHER PRODUCTS, OR USE IN ANY APPLICATION.
* IN NO EVENT WILL MICROCHIP BE LIABLE FOR ANY INDIRECT, SPECIAL, PUNITIVE,
* INCIDENTAL OR CONSEQUENTIAL LOSS, DAMAGE, COST OR EXPENSE OF ANY KIND
* WHATSOEVER RELATED TO THE SOFTWARE, HOWEVER CAUSED, EVEN IF MICROCHIP HAS
* BEEN ADVISED OF THE POSSIBILITY OR THE DAMAGES ARE FORESEEABLE.
* TO THE FULLEST EXTENT ALLOWED BY LAW, MICROCHIP'S TOTAL LIABILITY ON ALL
* CLAIMS IN ANY WAY RELATED TO THIS SOFTWARE WILL NOT EXCEED THE AMOUNT OF
* FEES, IF ANY, THAT YOU HAVE PAID DIRECTLY TO MICROCHIP FOR THIS SOFTWARE.
* MICROCHIP PROVIDES THIS SOFTWARE CONDITIONALLY UPON YOUR ACCEPTANCE
* OF THESE TERMS.
*/

/******************************************************************************/
/** @defgroup ESPI_PC ESPI_PC
 *  @{
 */

/** @file ESPI_PC.h
* \brief ESPI_PC header file
* \author KBCEC Team
* 
******************************************************************************/
#ifndef ESPI_KBC_Hal_H
#define ESPI_KBC_Hal_H

/* function declarations */
/* init */
typedef unsigned char           BYTE;
typedef unsigned short          WORD;
typedef unsigned long           DWORD;

#define trace0(nbr,cat,b,str) 
#define trace1(nbr,cat,b,str,p1) 
#define trace2(nbr,cat,b,str,p1,p2) 

/* EC cmds */
void ESPI_KBC_Cmd(unsigned char command_num);
void ESPI_Srvc_Kbcdat1(unsigned char value);

#endif /* ESPI_PC_H */

/**   @}
 */
```

## src/ESPI_PC_Hal.c
```c
/****************************************************************************
* 2014 Microchip Technology Inc. and its subsidiaries.
* You may use this software and any derivatives exclusively with
* Microchip products.
* THIS SOFTWARE IS SUPPLIED BY MICROCHIP "AS IS".
* NO WARRANTIES, WHETHER EXPRESS, IMPLIED OR STATUTORY, APPLY TO THIS SOFTWARE,
* INCLUDING ANY IMPLIED WARRANTIES OF NON-INFRINGEMENT, MERCHANTABILITY,
* AND FITNESS FOR A PARTICULAR PURPOSE, OR ITS INTERACTION WITH MICROCHIP
* PRODUCTS, COMBINATION WITH ANY OTHER PRODUCTS, OR USE IN ANY APPLICATION.
* IN NO EVENT WILL MICROCHIP BE LIABLE FOR ANY INDIRECT, SPECIAL, PUNITIVE,
* INCIDENTAL OR CONSEQUENTIAL LOSS, DAMAGE, COST OR EXPENSE OF ANY KIND
* WHATSOEVER RELATED TO THE SOFTWARE, HOWEVER CAUSED, EVEN IF MICROCHIP HAS
* BEEN ADVISED OF THE POSSIBILITY OR THE DAMAGES ARE FORESEEABLE.
* TO THE FULLEST EXTENT ALLOWED BY LAW, MICROCHIP'S TOTAL LIABILITY ON ALL
* CLAIMS IN ANY WAY RELATED TO THIS SOFTWARE WILL NOT EXCEED THE AMOUNT OF
* FEES, IF ANY, THAT YOU HAVE PAID DIRECTLY TO MICROCHIP FOR THIS SOFTWARE.
* MICROCHIP PROVIDES THIS SOFTWARE CONDITIONALLY UPON YOUR ACCEPTANCE
* OF THESE TERMS.
*/

/*
 **********************************************************************************
 *  ESPI_PC_Hal.C
 *      This is the ESPI service file: Peripheral channel process
 **********************************************************************************
 */

/******************************************************************************/
/** @defgroup ESPI_PC ESPI_PC
 *  @{
 */

/** @file ESPI_PC.c
* \brief ESPI_PC source file
* \author KBCEC Team
*
******************************************************************************/

/* for global */
#include <zephyr/kernel.h>
#include <soc.h>
//#include <soc_espi.h>
#include <errno.h>
#include <zephyr/arch/common/ffs.h>
#include <zephyr/device.h>
#include <zephyr/devicetree.h>
#include <zephyr/drivers/espi.h>
#include <zephyr/drivers/pinctrl.h>
#include <zephyr/dt-bindings/espi/mchp-mec5-espi.h>
#include <zephyr/logging/log.h>
#include <zephyr/sys/sys_io.h>
#include <zephyr/sys/util.h>
#include <zephyr/irq.h>
/* TODO #include "espi_utils.h" */
//#include "espi_mchp_mec5_private.h"

/* MEC5 HAL */
#include <device_mec5.h>
#include <mec_retval.h>
#include <mec_pcr_api.h>
#include <mec_espi_api.h>
#include <mec_acpi_ec_api.h>

//LOG_MODULE_REGISTER(espi_acpi_ec, CONFIG_ESPI_LOG_LEVEL);

/* get ACPI EC0 register struct from device tree */
#define ACPI_EC0_NODE DT_NODELABEL(acpi_ec0)
//struct acpi_ec_regs *const acpi_ec0_regs = (struct acpi_ec_regs *)DT_REG_ADDR(ACPI_EC0_NODE);
struct mec_acpi_ec_regs *const acpi_ec0_regs = (struct mec_acpi_ec_regs *)DT_REG_ADDR(ACPI_EC0_NODE);

/* get ESPI device - only one instance */
static const struct device *const espi_dev = DEVICE_DT_GET(DT_NODELABEL(espi0));

/* for local */
#include "ESPI_PC_Hal.h"

#define ON  1
#define OFF 0
/* ON: support KabyLake platform; OFF: Skylake platform */
#define KBL_SUPPORTED	        ON
#define ESPI_OOB_FC_TEST		OFF

/* global variables */
unsigned char Cmd_Byte2 = 0;
unsigned char Tmp_Load2 = 0;    /* Increment value byte counter. */
unsigned char EC_Addr;         	/* Store address byte. */
unsigned char Ext_Cb3_ACPI_ENABLED = 0;
unsigned char espi_acpi_ec_space[256] = {
    // 0     1     2     3     4     5     6     7     8     9     A     B     C     D     E     F
    0x00, 0x00, 0x00, 0x40, 0x00, 0x00, 0x00, 0x00, 0x00, 0x00, 0x00, 0x00, 0x00, 0x00, 0x00, 0x00, // 00h-0Fh
    0x00, 0x00, 0x00, 0x00, 0x00, 0x00, 0x00, 0x00, 0x00, 0x00, 0x00, 0x00, 0x00, 0x00, 0x00, 0x00, // 10h-1Fh
    0x00, 0x00, 0x00, 0x00, 0x00, 0x00, 0x00, 0x00, 0x00, 0x00, 0x00, 0x00, 0x00, 0x00, 0x00, 0x00, // 20h-2Fh
    0x99, 0x00, 0x0A, 0x00, 0x00, 0x00, 0x00, 0x00, 0x00, 0x00, 0x00, 0x00, 0x00, 0x00, 0x00, 0x00, // 30h-3Fh
    0x00, 0x00, 0x00, 0x00, 0x00, 0x00, 0x00, 0x00, 0x00, 0x00, 0x00, 0x00, 0x00, 0x00, 0x00, 0x00, // 40h-4Fh
    0x00, 0x00, 0x00, 0x00, 0x00, 0x00, 0x00, 0x62, 0x11, 0x9F, 0x0E, 0x96, 0x11, 0x8B, 0x1F, 0x00, // 50h-5Fh
    0x00, 0xA3, 0x08, 0x00, 0x00, 0x00, 0x00, 0x00, 0x00, 0x00, 0x00, 0x00, 0x00, 0x00, 0x00, 0x00, // 60h-6Fh
    0x00, 0x00, 0x00, 0x00, 0x00, 0x00, 0x00, 0x00, 0x02, 0x01, 0x00, 0x00, 0x00, 0x00, 0x00, 0x00, // 70h-7Fh
    0x00, 0x00, 0x00, 0x00, 0x00, 0x00, 0x00, 0x00, 0x00, 0x00, 0x00, 0x00, 0x00, 0x00, 0x00, 0x00, // 80h-8Fh
    0x00, 0x00, 0x00, 0x00, 0x00, 0x00, 0x00, 0x00, 0x00, 0x00, 0x00, 0x00, 0x00, 0x00, 0x00, 0x00, // 90h-9Fh
    0x00, 0x00, 0x00, 0x00, 0x00, 0x00, 0x00, 0x00, 0x00, 0x00, 0x00, 0x00, 0x00, 0x00, 0x00, 0x00, // A0h-AFh
    0x00, 0x00, 0x00, 0x00, 0x00, 0x00, 0x00, 0x00, 0x00, 0x00, 0x00, 0x00, 0x00, 0x00, 0x00, 0x00, // B0h-BFh
    0x00, 0x00, 0x00, 0x00, 0x00, 0x00, 0x00, 0x00, 0x00, 0x1F, 0x00, 0x00, 0x00, 0x00, 0x00, 0x00, // C0h-CFh
    0x00, 0x00, 0x00, 0xB0, 0x1D, 0x00, 0x00, 0x00, 0x00, 0x00, 0x00, 0x00, 0x00, 0x00, 0x00, 0x00, // D0h-DFh
    0x00, 0x00, 0x00, 0x00, 0x00, 0x00, 0x00, 0x00, 0x00, 0x00, 0x00, 0x00, 0x00, 0x00, 0x00, 0x00, // E0h-EFh
    0x00, 0x00, 0x00, 0x00, 0x00, 0x00, 0x00, 0x00, 0x00, 0x00, 0x03, 0x07, 0x00, 0x00, 0x00, 0x00  // F0h-FFh
};


/* Generate SCI to host*/
void ACPI_Gen_Int(void)
{
	/* check if system is in acpi mode */
	if(Ext_Cb3_ACPI_ENABLED == 1)
	{
		espi_send_vwire(espi_dev, ESPI_VWIRE_SIGNAL_SCI, 0);
		k_busy_wait(100);
		espi_send_vwire(espi_dev, ESPI_VWIRE_SIGNAL_SCI, 1);
	}
}

/* tx data to EC0 */
void Data_To_Host2(unsigned char value)
{
	//mec_acpi_ec_host_to_ec_data_wr8(acpi_ec0_regs, 0x00, value);
//	mec_acpi_ec_e2h_data_wr8(acpi_ec0_regs, 0x00, value);
	mec_hal_acpi_ec_e2h_data_wr8(acpi_ec0_regs, 0x00, value);
}

unsigned char Output_Buffer2_Full(void)
{
	unsigned char ret;
//	ret = mec_acpi_ec_status_obf(acpi_ec0_regs);
	ret = mec_hal_acpi_ec_status_obf(acpi_ec0_regs);
	return ret;
}

/******************************************************************************/
/** ESPI_ACPI_Cmd
 * Process ACPI commands...
 *
 * @param None
 *
 * @return None
 *
 ******************************************************************************/
void ESPI_ACPI_Cmd(BYTE command_num)
{
	BYTE value_tmp;
    unsigned short value2;

	trace1(0, ESPI_PC, 0, "ESPI_ACPI_Cmd: command_num  = %02Xh", command_num);
	switch(command_num)
	{
		case 0x04:     
			break;

		case 0x05:     
			break;

		case 0x06:                
	        while(Output_Buffer2_Full())
			{
			}
			/* Query system status */
			/* bit5=0, undocked; bit4=1, AC powered; bit[3:0]=0, CPU thermal state */
			value_tmp = 0x10;
            Data_To_Host2(value_tmp);
			//ACPI_Gen_Int();
			break;

		case 0x09:                
	        while(Output_Buffer2_Full())
			{
			}
			/* 1st byte: "K" */
            Data_To_Host2(0x4b);
			//ACPI_Gen_Int();
	        trace1(0, ESPI_PC, 0, "ESPI_ACPI_Cmd: TGL 0x09 return K = %02Xh", 0x4B);

	        while(Output_Buffer2_Full())
			{
			}
			/* 2nd byte: "S" */
            Data_To_Host2(0x53);
			//ACPI_Gen_Int();
	        trace1(0, ESPI_PC, 0, "ESPI_ACPI_Cmd: TGL 0x09 return S = %02Xh", 0x53);

	        while(Output_Buffer2_Full())
			{
			}
			/* 3rd byte: "C" */
            Data_To_Host2(0x43);
			//ACPI_Gen_Int();
	        trace1(0, ESPI_PC, 0, "ESPI_ACPI_Cmd: TGL 0x09 return C = %02Xh", 0x43);

	        while(Output_Buffer2_Full())
			{
			}
#if 1
/* TGL porting */

			/* 4th byte: 0 */
            Data_To_Host2(0x94);
#else
            Data_To_Host2(0x00);
#endif
			//ACPI_Gen_Int();
			/* case: 0x09: */
	        trace1(0, ESPI_PC, 0, "ESPI_ACPI_Cmd: TGL 0x09 return 4th Byte = %02Xh", 0x94);
			break;

		case 0x0A:                
	        while(Output_Buffer2_Full())
			{
			}
			/* Get switch status */
			/* bit5=0, undocked; bit4=1, AC powered; bit2=0, NMI jumpr is ON; bit1=0, virtual batt status; bit0=0, lid switch is open */
			value_tmp = 0x10;
            Data_To_Host2(value_tmp);
			//ACPI_Gen_Int();
			break;

		case 0x0D:                
	        while(Output_Buffer2_Full())
			{
			}
#if 1
/* TGL porting */

            Data_To_Host2(0xF8);
            //Data_To_Host2(0x01);
	        trace1(0, ESPI_PC, 0, "ESPI_ACPI_Cmd: TGL 0x0D return FAB ID = %02Xh", 0xF8);
#else
#if (KBL_SUPPORTED == ON)
/* ON: support KabyLake platform */

            Data_To_Host2(0xC0);
#else
/* Skylake platform */

            Data_To_Host2(0x02);
#endif
#endif
			//ACPI_Gen_Int();

	        while(Output_Buffer2_Full())
			{
			}
#if 1
/* TGL porting */

            Data_To_Host2(0x01);
	        trace1(0, ESPI_PC, 0, "ESPI_ACPI_Cmd: TGL 0x0D return BRD ID = %02Xh", 0x01);
#else
            Data_To_Host2(0x04);
#endif
			//ACPI_Gen_Int();
			break;

		case 0x0E:     
			/* have one parameter */
			Cmd_Byte2 = command_num;  /* Signal to wait for value from Host. */
			break;

#if 1
/* TGL porting */

		case 0x13:     
			/* have one parameter */
			Cmd_Byte2 = command_num;  /* Signal to wait for value from Host. */
			break;
#endif

#if (KBL_SUPPORTED == ON)
/* ON: support KabyLake platform */

		case 0x1A:      
            /* PWMUpdate: PWM value is in EC space */
	        /* need to do here to process PWM update */
	        trace1(0, ESPI_PC, 0, "ESPI_ACPI_Cmd: KBL 0x1A PWMUpdate = %02Xh", command_num);
			break;

		case 0x1B:      
            /* get PMIC vendor ID */
	        while(Output_Buffer2_Full())
			{
			}
            Data_To_Host2(0x1F);
	        trace1(0, ESPI_PC, 0, "ESPI_ACPI_Cmd: KBL 0x1B return PMIC Vendor ID to host = %02Xh", 0x1F);
			break;

		case 0x1C:     
			/* have one parameter */
			Cmd_Byte2 = command_num;  /* Signal to wait for value from Host. */
	        trace1(0, ESPI_PC, 0, "ESPI_ACPI_Cmd: KBL 0x1C, a parameter from host, Cmd_Byte2 = %02Xh", Cmd_Byte2);
			break;

		case 0xB0:               
            /* BIOS guard cmd */
	        while(Output_Buffer2_Full())
			{
			}
            Data_To_Host2(0x00);
	        trace1(0, ESPI_PC, 0, "ESPI_ACPI_Cmd: KBL 0xB0 return (can be disabled from BIOS menu) = %02Xh", 0x00);
			break;
#endif

		case 0x23:     
			break;

		case 0x27:     
			/* have one parameter */
			Cmd_Byte2 = command_num;  /* Signal to wait for value from Host. */
			break;

		case 0x29:     
			/* have one parameter */
			Cmd_Byte2 = command_num;  /* Signal to wait for value from Host. */
			break;

		case 0x2D:     
#if 0
/* TGL porting */

	        while(Output_Buffer2_Full())
			{
			}
			/* 1st byte: "K" */
            Data_To_Host2(0x4b);
			//ACPI_Gen_Int();
	        trace1(0, ESPI_PC, 0, "ESPI_ACPI_Cmd: TGL 0x2D return K = %02Xh", 0x4B);

	        while(Output_Buffer2_Full())
			{
			}
			/* 2nd byte: "S" */
            Data_To_Host2(0x53);
			//ACPI_Gen_Int();
	        trace1(0, ESPI_PC, 0, "ESPI_ACPI_Cmd: TGL 0x2D return S = %02Xh", 0x53);

	        while(Output_Buffer2_Full())
			{
			}
			/* 3rd byte: "C" */
            Data_To_Host2(0x43);
			//ACPI_Gen_Int();
	        trace1(0, ESPI_PC, 0, "ESPI_ACPI_Cmd: TGL 0x2D return C = %02Xh", 0x43);

	        while(Output_Buffer2_Full())
			{
			}
			/* 4th byte: 0 */
            Data_To_Host2(0x94);
			//ACPI_Gen_Int();
	        trace1(0, ESPI_PC, 0, "ESPI_ACPI_Cmd: TGL 0x2D return 4th Byte = %02Xh", 0x94);
			/* case: 0x2D: */
#endif
			break;

		case 0x2E:     
			break;

		case 0x2F:     
			break;

#if 1
/* TGL porting */

		case 0x39:     
			/* have one parameter */
			Cmd_Byte2 = command_num;  /* Signal to wait for value from Host. */
			break;
#endif

		case 0x46:     
			break;

		case 0x4B:     
			break;

		case 0x4D:     
			/* have one parameter */
			Cmd_Byte2 = command_num;  /* Signal to wait for value from Host. */
			break;

		case 0x58:     
			/* have one parameter */
			Cmd_Byte2 = command_num;  /* Signal to wait for value from Host. */
			break;

		case 0x64:     
			break;

		case 0x70:     
			/* SMI Query */
//			value2 = Pc_Cmd8(0x92);
			value2 = 0;
			trace1(0, ESPI_PC, 0, "ESPI_ACPI_Cmd: SMI cause code  = %04Xh", value2);
			if(value2 != (WORD) ~0)
			{
				while(Output_Buffer2_Full())
				{
				}
				/* send SMI cause code to host */
				Data_To_Host2((BYTE)value2);
			}
			break;

#if 1
/* processed in Insyde ACPI cmd/data */
		case 0x80:     
			/* Generate interrupt to signal the Host that the
            command has been taken and more value can be sent. */
			ACPI_Gen_Int();

			/* have one parameter */
			Cmd_Byte2 = command_num;  /* Signal to wait for value from Host. */
			break;

		case 0x81:     
			/* Generate interrupt to signal the Host that the
            command has been taken and more value can be sent. */
			ACPI_Gen_Int();

			/* have 2 parameter2 */
			Cmd_Byte2 = command_num;  /* Signal to wait for value from Host. */
			break;

		case 0x82:     
			/* Set Burst bit in secondary Host interface status register. */
//			Write_Host_Status_Reg2(Read_Host_Status_Reg2() |
//								   maskSTATUS_PORT2_BURST);
			while(Output_Buffer2_Full())
			{
			}
			/* enable burst mode */
			value_tmp = 0x90;
            Data_To_Host2(value_tmp);
			ACPI_Gen_Int();
			break;

		case 0x83:     
			/* Clear Burst bit in secondary Host interface status register. */
//			Write_Host_Status_Reg2(Read_Host_Status_Reg2() &
//                                   ~maskSTATUS_PORT2_BURST);
			/* disable burst mode */
			ACPI_Gen_Int();
			break;
#endif

		case 0x8A:     
	        while(Output_Buffer2_Full())
			{
			}
			/* Get switch status - dock status, =1, docked; =0, undocked */
			value_tmp = 0x00;
            Data_To_Host2(value_tmp);
	        trace1(0, ESPI_PC, 0, "ESPI_ACPI_Cmd: TGL 0x8A return SW sts - undocked = %02Xh", value_tmp);
			//ACPI_Gen_Int();
			break;
			
		case 0x90:                
	        while(Output_Buffer2_Full())
			{
			}
#if 1
/* TGL porting */

			/* 1st byte: FW revision - major */
            Data_To_Host2(0x01);
#else
            Data_To_Host2(BUILDNUMBER >> 8);
#endif
	        trace1(0, ESPI_PC, 0, "ESPI_ACPI_Cmd: TGL 0x90 return FW Rev major = %02Xh", 0x01);
			//ACPI_Gen_Int();

	        while(Output_Buffer2_Full())
			{
			}
			/* 2nd byte: FW revision - minor */
#if 1
/* TGL porting */

            Data_To_Host2(0x10);
#else
            Data_To_Host2(BUILDNUMBER & 0x00FF);
#endif
	        trace1(0, ESPI_PC, 0, "ESPI_ACPI_Cmd: TGL 0x90 return FW Rev minor = %02Xh", 0x10);
			//ACPI_Gen_Int();
			/* case: 0x90: */
			break;

		case 0xAA:     
			/* enable ACPI mode */
			Ext_Cb3_ACPI_ENABLED = 1;
			break;

		case 0xAB:     
			/* disable ACPI mode, back to APM mode */
			Ext_Cb3_ACPI_ENABLED = 0;
			break;

		case 0xBC:     
			/* disable SMIs */
			break;
			
 		case 0xBD:     
			/* enable SMIs */
			break;

#if 1
/* TGL porting */

		case 0xDF:     
			/* have one parameter */
			Cmd_Byte2 = command_num;  /* Signal to wait for value from Host. */
			break;

		case 0xE1:     
			break;

		case 0xF3:     
			/* have one parameter */
			Cmd_Byte2 = command_num;  /* Signal to wait for value from Host. */
			break;
#endif

#if (ESPI_OOB_FC_TEST == ON)
/* Support MEC14xx ESPI OOB & FC TX & RX */

		case 0xF1:     
			trace0(0, ESPI_PC, 0, "ESPI_ACPI_Cmd: rx MCHP PE command 0xF1.");
			/* write memory: have 9 parameters */
			Cmd_Byte2 = command_num;  /* Signal to wait for value from Host. */
			break;

		case 0xF2:     
			trace0(0, ESPI_PC, 0, "ESPI_ACPI_Cmd: rx MCHP PE command 0xF2.");
			/* read memory: have 5 parameters */
			Cmd_Byte2 = command_num;  /* Signal to wait for value from Host. */
			break;
#endif

       default:
			trace1(0, ESPI_PC, 0, "ESPI_ACPI_Cmd: oop??? unsupported cmd, command_num  = %02Xh", command_num);
			//while(1);
            break;
	} /* switch(command_num) */
}

/******************************************************************************/
/** ESPI_Srvc_Pcdat2
 * Process ACPI commands with parameters
 *
 * @param None
 *
 * @return None
 *
 ******************************************************************************/
void ESPI_Srvc_Pcdat2(BYTE value)
{
	BYTE value_tmp;

	trace1(0, ESPI_PC, 0, "ESPI_Srvc_Pcdat2: command: Cmd_Byte2 = %02Xh", Cmd_Byte2);
	trace1(0, ESPI_PC, 0, "ESPI_Srvc_Pcdat2: data: value = %02Xh", value);
	switch(Cmd_Byte2)
	{
		case 0x0E:     
			/* value is to select AON or ALS */
			/* need to add app code here... */
			value_tmp = value;
			Cmd_Byte2 = 0;
			break;

#if 1
/* TGL porting */

		case 0x13:     
			/* value is the set deep sleep mode */
			/* need to add app code here... */
			value_tmp = value;
	        trace1(0, ESPI_PC, 0, "ESPI_Srvc_Pcdat2: TGL CMD 0x13 data: value_tmp = %02Xh", value_tmp);
			Cmd_Byte2 = 0;
			break;
#endif

#if (KBL_SUPPORTED == ON)
/* ON: support KabyLake platform */

		case 0x1C:     
			/* value is ??? not in spec. */
			/* need to add app code here... */
			value_tmp = value;
	        trace1(0, ESPI_PC, 0, "ESPI_ACPI_Cmd: KBL 0x1C's parameter from host = %02Xh", value_tmp);
			Cmd_Byte2 = 0;
			break;
#endif

		case 0x27:     
			/* value is to enable low power mode: =1, enable; =0, disable */
			/* need to add app code here... */
			value_tmp = value;
			Cmd_Byte2 = 0;
			break;

		case 0x29:     
			/* value is the set deep sleep mode */
			/* need to add app code here... */
			value_tmp = value;
			Cmd_Byte2 = 0;
			break;

#if 1
/* TGL porting */

		case 0x39:     
			/* value is the set deep sleep mode */
			/* need to add app code here... */
			value_tmp = value;
	        trace1(0, ESPI_PC, 0, "ESPI_Srvc_Pcdat2: TGL CMD 0x39 data: value_tmp = %02Xh", value_tmp);
			Cmd_Byte2 = 0;
			break;
#endif

		case 0x58:     
			/* value is the vritical temperature threshold */
			/* need to add app code here... */
			value_tmp = value;
			Cmd_Byte2 = 0;
			break;

		case 0x4D:     
			/* value is the set PECI injected temperature */
			/* need to add app code here... */
			value_tmp = value;
			Cmd_Byte2 = 0;
			break;

#if 1
/* processed in Insyde ACPI cmd/data */
		case 0x80:     // read
			/* Generate interrupt to signal the Host that the
            data has been taken and more value can be sent. */
			ACPI_Gen_Int();
			/* value is the ACPI space index */
			value_tmp = espi_acpi_ec_space[value];
	        while(Output_Buffer2_Full())
			{
			}
            Data_To_Host2(value_tmp);
			ACPI_Gen_Int();
			Cmd_Byte2 = 0;
			break;

		case 0x81:     // wr
			/* Generate interrupt to signal the Host that the
            data has been taken and more value can be sent. */
			ACPI_Gen_Int();
			/* process 2 parameters */
			if(Tmp_Load2 == 0) 
			{
				/* Just received 1st address byte (index) from Host. */
				Tmp_Load2++;             /* Increment value byte counter. */
				EC_Addr = value;         /* Store address byte. */
			}
			else if(Tmp_Load2 == 1) 
			{
				/* Just received 2nd data byte from Host. */
				/* need to add app code here... */
				espi_acpi_ec_space[EC_Addr] = value;     
				Cmd_Byte2 = 0;
				Tmp_Load2 = 0;
			}
			break;
#endif

#if (ESPI_OOB_FC_TEST == ON)
/* Support MEC14xx ESPI OOB & FC TX & RX */

		case 0xF1:     
			trace0(0, ESPI_PC, 0, "ESPI_Srvc_Pcdat2: rx MCHP PE command 0xF1's data.");
			/* write memory: have 9 parameters */
			ESPI_write_mem_0xF1(value);
			break;

		case 0xF2:     
			trace0(0, ESPI_PC, 0, "ESPI_Srvc_Pcdat2: rx MCHP PE command 0xF2's data.");
			/* read memory: have 5 parameters */
			ESPI_read_mem_0xF2(value);
			break;
#endif

#if 1
/* TGL porting */

		case 0xDF:     
			/* function is ... */
			/* need to add app code here... */
			value_tmp = value;
	        trace1(0, ESPI_PC, 0, "ESPI_Srvc_Pcdat2: TGL CMD 0xDF data: value_tmp = %02Xh", value_tmp);
			Cmd_Byte2 = 0;
			break;

		case 0xF3:     
			/* function is ... */
			/* need to add app code here... */
			value_tmp = value;
	        trace1(0, ESPI_PC, 0, "ESPI_Srvc_Pcdat2: TGL CMD 0xF3 data: value_tmp = %02Xh", value_tmp);
			Cmd_Byte2 = 0;
			break;
#endif

        default:
			trace1(0, ESPI_PC, 0, "ESPI_Srvc_Pcdat2: oop??? unsupported cmd with parameter, Cmd_Byte2  = %02Xh", Cmd_Byte2);
			//LOG_INF("Dat2, unsupported Cmd_Byte2=0x%02x", Cmd_Byte2);
			//while(1);
            break;
	} /* switch(Cmd_Byte2) */
}

/**   @}
 */
```

## src/ESPI_PC_Hal.h
```c
/****************************************************************************
* 2014 Microchip Technology Inc. and its subsidiaries.
* You may use this software and any derivatives exclusively with
* Microchip products.
* THIS SOFTWARE IS SUPPLIED BY MICROCHIP "AS IS".
* NO WARRANTIES, WHETHER EXPRESS, IMPLIED OR STATUTORY, APPLY TO THIS SOFTWARE,
* INCLUDING ANY IMPLIED WARRANTIES OF NON-INFRINGEMENT, MERCHANTABILITY,
* AND FITNESS FOR A PARTICULAR PURPOSE, OR ITS INTERACTION WITH MICROCHIP
* PRODUCTS, COMBINATION WITH ANY OTHER PRODUCTS, OR USE IN ANY APPLICATION.
* IN NO EVENT WILL MICROCHIP BE LIABLE FOR ANY INDIRECT, SPECIAL, PUNITIVE,
* INCIDENTAL OR CONSEQUENTIAL LOSS, DAMAGE, COST OR EXPENSE OF ANY KIND
* WHATSOEVER RELATED TO THE SOFTWARE, HOWEVER CAUSED, EVEN IF MICROCHIP HAS
* BEEN ADVISED OF THE POSSIBILITY OR THE DAMAGES ARE FORESEEABLE.
* TO THE FULLEST EXTENT ALLOWED BY LAW, MICROCHIP'S TOTAL LIABILITY ON ALL
* CLAIMS IN ANY WAY RELATED TO THIS SOFTWARE WILL NOT EXCEED THE AMOUNT OF
* FEES, IF ANY, THAT YOU HAVE PAID DIRECTLY TO MICROCHIP FOR THIS SOFTWARE.
* MICROCHIP PROVIDES THIS SOFTWARE CONDITIONALLY UPON YOUR ACCEPTANCE
* OF THESE TERMS.
*/

/******************************************************************************/
/** @defgroup ESPI_PC ESPI_PC
 *  @{
 */

/** @file ESPI_PC.h
* \brief ESPI_PC header file
* \author KBCEC Team
* 
******************************************************************************/
#ifndef ESPI_PC_Hal_H
#define ESPI_PC_Hal_H

/* function declarations */
/* init */
typedef unsigned char           BYTE;
typedef unsigned short          WORD;
typedef unsigned long           DWORD;

#define trace0(nbr,cat,b,str) 
#define trace1(nbr,cat,b,str,p1) 
#define trace2(nbr,cat,b,str,p1,p2) 

/* EC cmds */
void ESPI_ACPI_Cmd(BYTE command_num);
void ESPI_Srvc_Pcdat2(BYTE value);

/* test 1 */


#endif /* ESPI_PC_H */

/**   @}
 */
```

## src/espi_debug.h
```c
/*
 * Copyright (c) 2023 Microchip Technology, Inc.
 *
 * SPDX-License-Identifier: Apache-2.0
 */

#ifndef __SAMPLES_BOARDS_MEC5_ESPI_DEBUG_H_
#define __SAMPLES_BOARDS_MEC5_ESPI_DEBUG_H_

#include <stdint.h>

const char *get_vw_name(uint32_t vwire_enum_val);

void espi_debug_print_config(void);
void espi_debug_print_io_bars(void);
void espi_debug_print_mem_bars(void);
void espi_debug_print_ctvw(void);
void espi_debug_print_tcvw(void);
void espi_debug_print_pc(void);
void espi_debug_print_oob(void);

void espi_debug_print_cap_word(uint16_t cap_offset, uint32_t cap);

#endif /* __SAMPLES_BOARDS_MEC5_ESPI_DEBUG_H_ */
```
