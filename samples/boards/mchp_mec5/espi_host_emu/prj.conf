## Kconfig
```
# Copyright (c) 2024 Microchip Technology
# SPDX-License-Identifier: Apache-2.0

config SAMPLE_ESPI_ENABLE_PACKET_CRC
	bool "Configure eSPI packet CRC checking"
	default n
	help
	  eSPI emulated host will enable CRC packet checking

config SAMPLE_USE_ESPI_ALERT_PIN
	bool "Configure eSPI to use separate ESPI_nALERT pin instead of in-band alert"
	default n
	help
	  Use ESPI_nALERT side band pin as the alert mechanism
	  instead of the in-band alert on ESPI_IO1 pin.

config SAMPLE_ESPI_TAF
	bool "Exercise eSPI Flash channel in TAF (Target Attached Flash) mode"
	default n
	help
	  eSPI emulated host requests Target Attached Flash sharing mode
	  and runs flash write/read/erase tests using PUT_FLASH_NP.
	  If disabled, the Flash channel is enabled in Controller Attached
	  Flash Sharing (CAFS) mode and no flash traffic is generated.

config SAMPLE_ESPI_ACPI_EC4
	bool "Exercise Target ACPI_EC4"
	default y
	help
	  Write ACPI_EC4 at Host I/O 340h and at its Host memory mapping
	  0x10002000: data +0, command/status +4. Disable when the Target
	  does not map ACPI_EC4.

source "Kconfig.zephyr"
```

## sample.yaml
```
sample:
  name: Exercise eSPI driver with an emulated eSPI host
common:
  build_only: true
  platform_allow:
    - mec172xevb_assy6906
    - mec_assy6941/mec1753_qsz
  tags: drivers espi
tests:
  sample.boards.mchp_mec.espi_host_emu: {}
  sample.boards.mchp_mec.espi_host_emu.taf:
    extra_configs:
      - CONFIG_SAMPLE_ESPI_TAF=y
```

## prj.conf
```kconfig
CONFIG_LOG=y
CONFIG_LOG_MODE_IMMEDIATE=y
#CONFIG_LOG_MODE_MINIMAL=y
# !!! WARNING: deferred and buffer size not working.
# !!! log_panic() does not output messages.
#CONFIG_LOG_MODE_DEFERRED=y
#CONFIG_LOG_BUFFER_SIZE=4096
CONFIG_LOG_BACKEND_UART=y
#CONFIG_LOG_BACKEND_SWO=y
#CONFIG_LOG_BACKEND_SWO_REF_FREQ_HZ=96000000
#CONFIG_LOG_BACKEND_SWO_FREQ_HZ=4000000

CONFIG_GPIO=y
CONFIG_PINCTRL=y
CONFIG_LED=y
CONFIG_SPI=y
CONFIG_SERIAL=y
CONFIG_CONSOLE=y
CONFIG_UART_CONSOLE=y
CONFIG_I2C=y

CONFIG_EVENTS=y
CONFIG_PM=n

# Help debug new code
# CONFIG_DEBUG_COREDUMP=y
# CONFIG_TRAP_UNALIGNED_ACCESS=y
# CONFIG_DEBUG=y
```

## boards/mec_assy6906_mech1723nlj.conf
```kconfig
CONFIG_SAMPLE_USE_ESPI_ALERT_PIN=y
```

## boards/mec_assy6941_mec1753qlj.conf
```kconfig
CONFIG_SAMPLE_ESPI_ENABLE_PACKET_CRC=y
CONFIG_SAMPLE_USE_ESPI_ALERT_PIN=y
```

## boards/mec172xevb_assy6906.overlay
```dts
/*
 * Copyright (c) 2025 Microchip Technology Inc.
 *
 * SPDX-License-Identifier: Apache-2.0
 */

/* mec172xevb_assy6906 EVB with MEC1723N-SZ daughter card
 * MEC1723 does not have an internal SPI flash.
 * Connect QSPI to external shared SPI flash pins using SHD_nCS1.
 */

#include "mec_common.dtsi"

&qspi0 {
	compatible = "microchip,xec-qmspi-ldma";
	status = "okay";
	clock-frequency = <4000000>;
	pinctrl-0 = < &shd_cs0_n_gpio055_sleep
		      &shd_cs1_n_gpio002
		      &shd_clk_gpio056
		      &shd_io0_gpio223
		      &shd_io1_gpio224
		      &shd_io2_gpio227
		      &shd_io3_gpio016 >;
	pinctrl-names = "default";
};
```

## boards/mec_assy6906_mech1723_nlj.overlay
```dts
/*
 * Copyright (c) 2025 Microchip Technology Inc.
 *
 * SPDX-License-Identifier: Apache-2.0
 */

/* mec_assy6906 EVB with MEC1723N-LJ daughter card
 * MEC1723 does not have an internal SPI flash.
 * Connect QSPI to external shared SPI flash pins using SHD_nCS1.
 */

#include "mec_common.dtsi"

&pinctrl {
	qspi_shd_cs0_n_gpio055_sleep: qspi_shd_cs0_n_gpio055_sleep {
		pinmux = < MCHP_XEC_PINMUX(055, MCHP_AF2) >;
		low-power-enable;
	};
};

&qspi0 {
	compatible = "microchip,mec5-qspi";
	status = "okay";
	pinctrl-0 = < &qspi_shd_cs0_n_gpio055_sleep
		      &qspi_shd_cs1_n_gpio002
		      &qspi_shd_clk_gpio056
		      &qspi_shd_io0_gpio223
		      &qspi_shd_io1_gpio224
		      &qspi_shd_io2_gpio227
		      &qspi_shd_io3_gpio016 >;
	pinctrl-names = "default";
};
```

## boards/mec_assy6906_mech1723_nsz.overlay
```dts
/*
 * Copyright (c) 2025 Microchip Technology Inc.
 *
 * SPDX-License-Identifier: Apache-2.0
 */

/* mec_assy6906 EVB with MEC1723N-SZ daughter card
 * MEC1723 does not have an internal SPI flash.
 * Connect QSPI to external shared SPI flash pins using SHD_nCS1.
 */

#include "mec_common.dtsi"

&pinctrl {
	qspi_shd_cs0_n_gpio055_sleep: qspi_shd_cs0_n_gpio055_sleep {
		pinmux = < MCHP_XEC_PINMUX(055, MCHP_AF2) >;
		low-power-enable;
	};
};

&qspi0 {
	compatible = "microchip,mec5-qspi";
	status = "okay";
	pinctrl-0 = < &qspi_shd_cs0_n_gpio055_sleep
		      &qspi_shd_cs1_n_gpio002
		      &qspi_shd_clk_gpio056
		      &qspi_shd_io0_gpio223
		      &qspi_shd_io1_gpio224
		      &qspi_shd_io2_gpio227
		      &qspi_shd_io3_gpio016 >;
	pinctrl-names = "default";
};
```

## boards/mec_assy6906_mech1723nlj.overlay
```dts
/*
 * Copyright (c) 2023 Microchip Technology Inc.
 *
 * SPDX-License-Identifier: Apache-2.0
 */

/* mec_assy6906 EVB with MEC1723N-LJ daughter card
 * MEC1723 does not have an internal SPI flash.
 * Connect QSPI to external shared SPI flash pins using SHD_nCS1.
 */

#include "mec_common.dtsi"

&pinctrl {
	qspi_shd_cs0_n_gpio055_sleep: qspi_shd_cs0_n_gpio055_sleep {
		pinmux = < MCHP_XEC_PINMUX(055, MCHP_AF2) >;
		low-power-enable;
	};
};

&qspi0 {
	compatible = "microchip,mec5-qspi";
	status = "okay";
	pinctrl-0 = < &qspi_shd_cs0_n_gpio055_sleep
		      &qspi_shd_cs1_n_gpio002
		      &qspi_shd_clk_gpio056
		      &qspi_shd_io0_gpio223
		      &qspi_shd_io1_gpio224
		      &qspi_shd_io2_gpio227
		      &qspi_shd_io3_gpio016 >;
	pinctrl-names = "default";
};
```

## boards/mec_assy6906_mech1723nsz.overlay
```dts
/*
 * Copyright (c) 2023 Microchip Technology Inc.
 *
 * SPDX-License-Identifier: Apache-2.0
 */

/* mec_assy6906 EVB with MEC1723N-SZ daughter card
 * MEC1723 does not have an internal SPI flash.
 * Connect QSPI to external shared SPI flash pins using SHD_nCS1.
 */

#include "mec_common.dtsi"

&pinctrl {
	qspi_shd_cs0_n_gpio055_sleep: qspi_shd_cs0_n_gpio055_sleep {
		pinmux = < MCHP_XEC_PINMUX(055, MCHP_AF2) >;
		low-power-enable;
	};
};

&qspi0 {
	compatible = "microchip,mec5-qspi";
	status = "okay";
	pinctrl-0 = < &qspi_shd_cs0_n_gpio055_sleep
		      &qspi_shd_cs1_n_gpio002
		      &qspi_shd_clk_gpio056
		      &qspi_shd_io0_gpio223
		      &qspi_shd_io1_gpio224
		      &qspi_shd_io2_gpio227
		      &qspi_shd_io3_gpio016 >;
	pinctrl-names = "default";
};
```

## boards/mec_assy6941_mec1743_qlj.overlay
```dts
/*
 * Copyright (c) 2025 Microchip Technology Inc.
 *
 * SPDX-License-Identifier: Apache-2.0
 */

/* mec_assy6941 EVB with MEC1743Q-LJ daughter card
 * MEC1743 does not have an internal SPI flash.
 * Connect QSPI to external shared SPI flash pins using SHD_nCS1.
 */

#include "mec_common.dtsi"

&pinctrl {
	qspi_shd_cs0_n_gpio055_sleep: qspi_shd_cs0_n_gpio055_sleep {
		pinmux = < MCHP_XEC_PINMUX(055, MCHP_AF2) >;
		low-power-enable;
	};
};

&qspi0 {
	compatible = "microchip,mec5-qspi";
	status = "okay";
	pinctrl-0 = < &qspi_shd_cs0_n_gpio055_sleep
		      &qspi_shd_cs1_n_gpio002
		      &qspi_shd_clk_gpio056
		      &qspi_shd_io0_gpio223
		      &qspi_shd_io1_gpio224
		      &qspi_shd_io2_gpio227
		      &qspi_shd_io3_gpio016 >;
	pinctrl-names = "default";
};
```

## src/espi_hc_emu.h
```c
/*
 * Copyright (c) 2024 Microchip Technology, Inc.
 *
 * SPDX-License-Identifier: Apache-2.0
 */

#ifndef __SAMPLES_BOARDS_MEC_ASSY6941_ESPI_HC_EMU_H_
#define __SAMPLES_BOARDS_MEC_ASSY6941_ESPI_HC_EMU_H_

#include <stdint.h>
#include <stddef.h>
#include <zephyr/kernel.h>

int espi_hc_emu_init(uint32_t freqhz);
int espi_hc_emu_espi_reset_n(uint8_t level);
int espi_hc_emu_vcc_pwrgd(uint8_t level);
int espi_hc_emu_is_target_ready(void);

int espi_hc_emu_host_ready_n(uint8_t level);
int espi_hc_emu_espi_reset_n(uint8_t level);
int espi_hc_emu_vcc_pwrgd(uint8_t level);

int espi_hc_emu_xfr(const uint8_t *msg, size_t msglen, uint8_t *response, size_t resplen);

uint32_t espi_emu_event_wait(uint32_t events, bool clr_before_wait, k_timeout_t timeout);
uint32_t espi_emu_event_clear(uint32_t events);

#define ESPI_HC_EMU_MSG_BUFF_LEN		256u
#define ESPI_HC_EMU_RESP_BUFF_LEN		256u

enum kevents_espi {
	KEV_ESPI_RESET_ASSERT_POS = 0,
	KEV_ESPI_RESET_DEASSERT_POS,
	KEV_ESPI_ALERT_POS,
};

/* 16-bit GET_CONFIGURATION addresses */
#define ESPI_GET_CONFIG_DEV_ID			0x04u
#define ESPI_GET_CONFIG_GLB_CAP			0x08u
#define ESPI_GET_CONFIG_PC_CAP			0x10u
#define ESPI_GET_CONFIG_VW_CAP			0x20u
#define ESPI_GET_CONFIG_OOB_CAP			0x30u
#define ESPI_GET_CONFIG_FC_CAP			0x40u

/* 16-bit eSPI Status bit definitions */
#define ESPI_STATUS_PC_FREE_POS			0
#define ESPI_STATUS_PC_NP_FREE_POS		1
#define ESPI_STATUS_VW_FREE_POS			2
#define ESPI_STATUS_OOB_FREE_POS		3
#define ESPI_STATUS_PC_AVAIL_POS		4
#define ESPI_STATUS_PC_NP_AVAIL_POS		5
#define ESPI_STATUS_VW_AVAIL_POS		6
#define ESPI_STATUS_OOB_AVAIL_POS		7
#define ESPI_STATUS_FC_FREE_POS			8
#define ESPI_STATUS_FC_NP_FREE_POS		9
#define ESPI_STATUS_FC_AVAIL_POS		12
#define ESPI_STATUS_FC_NP_AVAIL_POS		13

#define ESPI_STATUS_ALL_AVAIL			\
	(BIT(ESPI_STATUS_PC_AVAIL_POS) | BIT(ESPI_STATUS_PC_NP_AVAIL_POS) | \
	 BIT(ESPI_STATUS_VW_AVAIL_POS) | BIT(ESPI_STATUS_OOB_AVAIL_POS) | \
	 BIT(ESPI_STATUS_FC_AVAIL_POS) | BIT(ESPI_STATUS_FC_NP_AVAIL_POS))

#define ESPI_VW_FLAG_DIR_CT 0x1

/* Host context VWire structure */
struct espi_hc_vw {
	uint8_t host_index;
	uint8_t mask;
	uint8_t reset_val;
	uint8_t levels;
	uint8_t valid;
	uint8_t rsvd[3];
};

/* MEC5 eSPI Target has 11 Controller-to-Target and 11
 * Target-to-Controller group registers.
 * We add two for eSPI Host indices 0 and 1 which are
 * used for Serial IRQ for Target-to-Controller.
 * Format of C2T and T2C VWires (except Serial IRQ)
 *   b[7:4]=valid
 *   b[3:0]=wire value 0=low, 1=high
 *
 * Format of Serial IRQ:
 *   b[7]=interrupt level: 0=low, 1=high(interrupt assertion)
 *   b[6:0]=interrupt line
 *          Host Index 0: IRQ 0-127
 *          Host Index 1: IRQ 128-255
 */

#define ESPI_MAX_CT_VW_GROUPS		(11)
#define ESPI_MAX_TC_VW_GROUPS		(11 + 2)

struct espi_msg_pkt {
	uint8_t buf[ESPI_HC_EMU_MSG_BUFF_LEN];
	uint16_t msglen;
	uint8_t msgofs;
	uint8_t crc8;
};

struct espi_resp_pkt {
	uint8_t buf[ESPI_HC_EMU_RESP_BUFF_LEN];
	uint32_t recvlen;
};

struct espi_hc_context {
	uint32_t version_id;
	uint32_t global_cap_cfg;
	uint32_t pc_cap_cfg;
	uint32_t vw_cap_cfg;
	uint32_t oob_cap_cfg;
	uint32_t fc_cap_cfg;
	uint32_t other_cfg;
	uint16_t pkt_status;
	uint8_t vwg_cnt_max;
	uint8_t vwg_cnt;
	struct espi_hc_vw c2t_vw[ESPI_MAX_CT_VW_GROUPS];
	struct espi_hc_vw t2c_vw[ESPI_MAX_TC_VW_GROUPS];
	struct espi_msg_pkt emsg;
	struct espi_resp_pkt ersp;
};

struct espi_hc_response {
	uint16_t status;
	uint8_t resp_byte;
	uint16_t resp_data_len;
	uint16_t resp_buf_len;
	uint8_t *resp_buf;
};

int espi_hc_ctx_emu_init(struct espi_hc_context *hc);

int espi_hc_ctx_emu_ctrl(struct espi_hc_context *hc, uint8_t enable);
int espi_hc_ctx_get_status(struct espi_hc_context *hc);
int espi_hc_ctx_emu_get_config(struct espi_hc_context *hc, uint16_t cfg_offset);
int espi_hc_ctx_emu_set_config(struct espi_hc_context *hc, uint16_t cfg_offset,
			       uint32_t new_config);

/* Set state of a single VWire at specified host index in the context.
 * Does not transmit VWire. If level changed, set the valid bit.
 * Use another API to transmit.
 */
int espi_hc_set_ct_vwire(struct espi_hc_context *hc, uint8_t host_index, uint8_t src,
			 uint8_t level);

/* Send/Get VWires.
 * vws array of struct espi_vwire
 */
int espi_hc_ctx_emu_put_host_index(struct espi_hc_context *hc, uint8_t host_index);

#define ESPI_HC_EMU_PUT_VW_RST_VAL 0x01
int espi_hc_ctx_emu_put_mult_host_index(struct espi_hc_context *hc, uint8_t *hidxs, uint8_t nhidx,
					uint32_t flags);

int espi_hc_ctx_emu_put_vws(struct espi_hc_context *hc, struct espi_hc_vw *vws, uint8_t nvws);
int espi_hc_ctx_emu_get_vws(struct espi_hc_context *hc, struct espi_hc_vw *vws, uint8_t nvws,
			    uint8_t *nrecv);
int espi_hc_ctx_emu_get_vws2(struct espi_hc_context *hc, struct espi_hc_vw *vws, uint8_t nvws,
			     uint8_t *nrecv);

int espi_hc_ctx_emu_update_t2c_vw(struct espi_hc_context *hc, struct espi_hc_vw *vws,
				  uint8_t nvws);

int espi_hc_get_vw_group_data(struct espi_hc_context *hc, uint8_t host_index,
			      struct espi_hc_vw *vwgroup);

int espi_hc_emu_get_status(struct espi_hc_context *hc, uint16_t *espi_status);
int espi_hc_emu_get_config(struct espi_hc_context *hc, uint16_t config_offset,
			   uint32_t *config, uint16_t *cmd_status);
int espi_hc_emu_set_config(struct espi_hc_context *hc, uint16_t config_offset,
			   uint32_t config, uint16_t *cmd_status);

/* Peripheral Channel */
int espi_hc_emu_put_iowr(struct espi_hc_context *hc, uint32_t io_addr_len,
			 uint32_t data, uint16_t *cmd_status);
int espi_hc_emu_put_iord(struct espi_hc_context *hc, uint32_t io_addr_len,
			 uint32_t *data, uint16_t *cmd_status);

/* PC memory read and write 32 */
int espi_hc_emu_put_pc_mem_wr32(struct espi_hc_context *hc, uint32_t mem_addr,
				uint8_t tag, uint8_t *data, uint8_t datasz, uint16_t *cmd_status);

int espi_hc_emu_put_pc_mem_rd32(struct espi_hc_context *hc, uint32_t mem_addr, uint8_t tag,
				uint8_t *data, uint8_t datasz, uint16_t *cmd_status);

int espi_hc_emu_pc_memwr32_short(struct espi_hc_context *hc, uint32_t mem_addr,
				 uint32_t data, uint8_t datasz, uint16_t *cmd_status);

int espi_hc_emu_pc_memrd32_short(struct espi_hc_context *hc, uint32_t mem_addr,
				 uint8_t *data, uint8_t datasz, uint16_t *cmd_status);

int espi_hc_emu_send_get_pc(struct espi_hc_context *hc, bool is_np,
			    uint8_t *data, uint8_t datasz, uint16_t *cmd_status);

/* Flash Access Channel (TAF: Target Attached Flash) */
int espi_hc_emu_flash_read(struct espi_hc_context *hc, uint32_t flash_addr, uint8_t tag,
			   uint8_t *data, uint16_t datalen, uint16_t *cmd_status);

int espi_hc_emu_flash_write(struct espi_hc_context *hc, uint32_t flash_addr, uint8_t tag,
			    const uint8_t *data, uint16_t datalen, uint16_t *cmd_status);

/* eSPI Flash Access Channel Erase length-field encodings, Target Attached
 * Flash Sharing (eSPI Base Spec Table 16). Only these 4 values are valid for
 * TAF; Controller Attached Flash Sharing (CAFS) uses a different encoding
 * (0h resvd, 1h=4KB, 2h=64KB, 4h=128KB, 5h=256KB) not used by this driver
 * since it always negotiates TAF.
 */
#define ESPI_FC_TAF_ERASE_SEL_4KB	0u
#define ESPI_FC_TAF_ERASE_SEL_32KB	1u
#define ESPI_FC_TAF_ERASE_SEL_64KB	2u
#define ESPI_FC_TAF_ERASE_SEL_128KB	3u

/* flash_addr must be aligned to the erase block size selected by erase_size_sel */
int espi_hc_emu_flash_erase(struct espi_hc_context *hc, uint32_t flash_addr, uint8_t tag,
			    uint8_t erase_size_sel, uint16_t *cmd_status);

#endif /* __SAMPLES_BOARDS_MEC_ASSY6941_ESPI_HC_EMU_H_ */
```
