## CMakeLists.txt
```
# SPDX-License-Identifier: Apache-2.0

cmake_minimum_required(VERSION 3.20.0)
find_package(Zephyr REQUIRED HINTS $ENV{ZEPHYR_BASE})
project(mec172x_brd_test)

FILE(GLOB app_sources src/*.c)
target_sources(app PRIVATE ${app_sources})
```

## sample.yaml
```
sample:
  name: MEC172x board SPI LDMA driver test
tests:
  sample.boards.mec172x:
    platform_allow: mec172xevb_assy6906 mec172x_cec1x02_r1
    tags: board spi qspi
    harness: console
    harness_config:
        type: multi_line
        ordered: False
```

## prj.conf
```kconfig
CONFIG_DEBUG=y
CONFIG_SPI=y
CONFIG_SPI_ASYNC=y
CONFIG_SPI_LOG_LEVEL_INF=y
# Log to ARM ITM
#CONFIG_LOG=y
#CONFIG_LOG_BACKEND_UART=n
#CONFIG_LOG_BACKEND_SWO=y
#CONFIG_LOG_BACKEND_SWO_FREQ_HZ=4000000
#CONFIG_LOG_BUFFER_SIZE=4096
#CONFIG_LOG_PROCESS_THREAD_SLEEP_MS=100
#CONFIG_LOG_PROCESS_TRIGGER_THRESHOLD=2

# default
# CONFIG_LOG_MODE_DEFERRED=y
# minimal mode is printk, no timestamps,
# CONFIG_LOG_MODE_MINIMUAL=n
# CONFIG_LOG_BACKEND_UART=y
# CONFIG_LOG_BACKEND_SWO=y
# CONFIG_LOG_BACKEND_SWO_FREQ_HZ=4000000
# CONFIG_LOG_PROCESS_TRIGGER_THRESHOLD=10

CONFIG_LOG=y
CONFIG_LOG_BUFFER_SIZE=4096
CONFIG_LOG_PROCESS_THREAD_SLEEP_MS=100
```

## src/main.c
```c
/*
 * Copyright (c) 2012-2014 Wind River Systems, Inc.
 *
 * SPDX-License-Identifier: Apache-2.0
 */

#include <zephyr.h>
#include <drivers/spi.h>
#include <sys/printk.h>
#include <soc.h>
#include <string.h>
#include "crc8.h"

#define SPI_FREQ_HZ		12000000U
#define W25Q128_JEDEC_ID	0x001840efU
#define SST25PF040C_JEDEC_ID	0x00130662U
#define SPI_DEV			DT_LABEL(DT_NODELABEL(spi0))

#define SPI_RD_JEDEC_ID_OP	0x9fU
#define SPI_RD_1110_OP		0x03U
#define SPI_RD_1118_OP		0x0bU

static const struct device *spi_dev;
static volatile uint32_t spin_val;
static volatile int ret_val;

static struct spi_config spi_cfg;

static struct spi_buf_set ibs;
static struct spi_buf_set obs;

static struct spi_buf bin[8];
static struct spi_buf bout[8];

static uint8_t data_buf1[4096];
static uint8_t data_buf2[4096];

void spin_on(uint32_t id, int rval);
void clean_bufs(void);
int pack_bytes_to_word(uint8_t *pb, size_t pbsz, uint32_t *w);


void main(void)
{
	int ret = 0;
	uint32_t d = 0U;
	uint32_t spi_addr = 0U;
	crc8_t crc8 = 0U;

	printk("Hello World! %s\n", CONFIG_BOARD);

	clean_bufs();

	spi_dev = device_get_binding(SPI_DEV);
	if (!spi_dev) {
		printk("ERROR: Get spi0 device binding failed!");
		spin_on(1, 0);
	}

	/* SPI configuration. We have not enabled CONFIG_SPI_EXTENDED_MODES
	 * If extended modes is enabled then operation becomes 32-bit and
	 * has more fields.
	*/
	spi_cfg.frequency = SPI_FREQ_HZ;
	spi_cfg.operation = SPI_OP_MODE_MASTER | SPI_TRANSFER_MSB |
			    SPI_WORD_SET(8) | SPI_LINES_SINGLE;
	spi_cfg.slave = 0;
	spi_cfg.cs = NULL; /* SPI controller HW handles chip select */

	printk("Read JEDEC ID from SPI flash\n");

	/* SPI input buffer for reading JEDEC ID */
	data_buf1[0] = SPI_RD_JEDEC_ID_OP;
	bin[0].buf = data_buf1;
	bin[0].len = 1;

	ibs.buffers = &bin[0];
	ibs.count = 1;

	/* SPI output buffer 4 byte result */
	bout[0].buf = data_buf2;
	bout[0].len = 4;

	obs.buffers = &bout[0];
	obs.count = 1;

	const struct spi_config *pspi_cfg = (const struct spi_config *)&spi_cfg;

	ret = spi_transceive(spi_dev, pspi_cfg, &ibs, &obs);
	if (ret) {
		printk("ERROR: SPI xfr API returned %d\n", ret);
		spin_on(2, ret);
	}

	pack_bytes_to_word(data_buf2, 4, &d);

	printk("JEDEC ID = 0x%08x\n", d);

	if (d == SST25PF040C_JEDEC_ID) {
		printk("SPI is SST25PF040C\n");
	} else if (d == W25Q128_JEDEC_ID) {
		printk("SPI is W25Q128\n");
	} else {
		printk("SPI is unkown\n");
	}

	/* Read Boot-ROM TAG from its default location at
	 * offset 0 of the SPI flash
	 */

	memset(data_buf2, 0x55, 4);
	spi_addr = 0U;

	printk("Read Boot-ROM TAG 0 SPI flash at offset 0x%08x\n", spi_addr);

	data_buf1[0] = SPI_RD_1110_OP; /* Read 1-1-1 no dummy clocks */
	data_buf1[1] = (spi_addr >> 16) & 0xffu; /* bits[23:16] */
	data_buf1[2] = (spi_addr >> 8) & 0xffu; /* bits[15:8] */
	data_buf1[3] = spi_addr & 0xffu; /* bits[7:0] */

	bin[0].buf = data_buf1;
	bin[0].len = 4;

	ibs.buffers = &bin[0];
	ibs.count = 1;

	/* SPI output buffer 4 byte result */
	bout[0].buf = data_buf2;
	bout[0].len = 4;

	obs.buffers = &bout[0];
	obs.count = 1;

	ret = spi_transceive(spi_dev, pspi_cfg, &ibs, &obs);
	if (ret) {
		printk("ERROR: SPI xfr API returned %d\n", ret);
		spin_on(3, ret);
	}

	pack_bytes_to_word(data_buf2, 4, &d);

	printk("TAG 0 = 0x%08x\n", d);

	crc8 = crc8_init();
	crc8 = crc8_update(crc8, (const unsigned char *)data_buf2, 3U);
	crc8 = crc8_finalize(crc8);

	printk("Calculated CRC-8 of first 3 TAG bytes = 0x%02x\n", crc8);
	if (crc8 == data_buf2[3]) {
		printk("TAG 0 CRC-8 OK\n");
	} else{
		printk("TAG 0 CRC-8 BAD: expected 0x%02x\n", data_buf2[3]);
	}

	spin_on(256, 0);
}

int pack_bytes_to_word(uint8_t *pb, size_t pbsz, uint32_t *w)
{
	if (!pb || !pbsz || !w) {
		return -EINVAL;
	}

	uint32_t d = 0;
	size_t nmax = (pbsz < 4) ? pbsz : 4U;

	for (size_t n = 0; n < nmax; n++) {
		d <<= 8;
		d |= *pb++;
	}

	*w = __builtin_bswap32(d);

	return 0;
}

void clean_bufs(void)
{
	memset(&ibs, 0, sizeof(ibs));
	memset(&obs, 0, sizeof(obs));
	memset(bin, 0, sizeof(bin));
	memset(bout, 0, sizeof(bout));

	memset(data_buf1, 0x55, sizeof(data_buf1));
	memset(data_buf2, 0x55, sizeof(data_buf2));
}

void spin_on(uint32_t id, int rval)
{
	spin_val = id;
	ret_val = rval;

	while (spin_val) {
		;
	}
}
```

## src/crc8.c
```c
/*****************************************************************************
* Copyright 2021 Microchip Technology Inc. and its subsidiaries.
* You may use this software and any derivatives exclusively with
* Microchip products.
* THIS SOFTWARE IS SUPPLIED BY MICROCHIP "AS IS".
* NO WARRANTIES, WHETHER EXPRESS, IMPLIED OR STATUTORY, APPLY TO THIS SOFTWARE,
* INCLUDING ANY IMPLIED WARRANTIES OF NON-INFRINGEMENT, MERCHANTABILITY,
* AND FITNESS FOR A PARTICULAR PURPOSE, OR ITS INTERACTION WITH MICROCHIP
* PRODUCTS, COMBINATION WITH ANY OTHER PRODUCTS, OR USE IN ANY APPLICATION.
* IN NO EVENT WILL MICROCHIP BE LIABLE FOR ANY INDIRECT, SPECIAL, PUNITIVE,
* INCIDENTAL OR CONSEQUENTIAL LOSS, DAMAGE, COST OR EXPENSE OF ANY KIND
* WHATSOEVER RELATED TO THE SOFTWARE, HOWEVER CAUSED, EVEN IF MICROCHIP HAS
* BEEN ADVISED OF THE POSSIBILITY OR THE DAMAGES ARE FORESEEABLE.
* TO THE FULLEST EXTENT ALLOWED BY LAW, MICROCHIP'S TOTAL LIABILITY ON ALL
* CLAIMS IN ANY WAY RELATED TO THIS SOFTWARE WILL NOT EXCEED THE AMOUNT OF
* FEES, IF ANY, THAT YOU HAVE PAID DIRECTLY TO MICROCHIP FOR THIS SOFTWARE.
* MICROCHIP PROVIDES THIS SOFTWARE CONDITIONALLY UPON YOUR ACCEPTANCE
* OF THESE TERMS.
*****************************************************************************/

/*
 * MEC172x Boot ROM CRC8
 * Functions and types for CRC checks.
 *
 * Generated on Mon Apr  2 17:26:27 2012,
 * by pycrc v0.7.10, http://www.tty1.net/pycrc/
 * using the configuration:
 *    Width        = 8
 *    Poly         = 0x07
 *    XorIn        = 0x00
 *    ReflectIn    = False
 *    XorOut       = 0x55
 *    ReflectOut   = False
 *    Algorithm    = table-driven
 *    Test string  = '123456789'
 *    Test CRC     = 0xA1
 */
#include "crc8.h"

/* Static table used for the table_driven implementation. */
static const crc8_t crc8_table[256] = {
	0x00, 0x07, 0x0e, 0x09, 0x1c, 0x1b, 0x12, 0x15,
	0x38, 0x3f, 0x36, 0x31, 0x24, 0x23, 0x2a, 0x2d,
	0x70, 0x77, 0x7e, 0x79, 0x6c, 0x6b, 0x62, 0x65,
	0x48, 0x4f, 0x46, 0x41, 0x54, 0x53, 0x5a, 0x5d,
	0xe0, 0xe7, 0xee, 0xe9, 0xfc, 0xfb, 0xf2, 0xf5,
	0xd8, 0xdf, 0xd6, 0xd1, 0xc4, 0xc3, 0xca, 0xcd,
	0x90, 0x97, 0x9e, 0x99, 0x8c, 0x8b, 0x82, 0x85,
	0xa8, 0xaf, 0xa6, 0xa1, 0xb4, 0xb3, 0xba, 0xbd,
	0xc7, 0xc0, 0xc9, 0xce, 0xdb, 0xdc, 0xd5, 0xd2,
	0xff, 0xf8, 0xf1, 0xf6, 0xe3, 0xe4, 0xed, 0xea,
	0xb7, 0xb0, 0xb9, 0xbe, 0xab, 0xac, 0xa5, 0xa2,
	0x8f, 0x88, 0x81, 0x86, 0x93, 0x94, 0x9d, 0x9a,
	0x27, 0x20, 0x29, 0x2e, 0x3b, 0x3c, 0x35, 0x32,
	0x1f, 0x18, 0x11, 0x16, 0x03, 0x04, 0x0d, 0x0a,
	0x57, 0x50, 0x59, 0x5e, 0x4b, 0x4c, 0x45, 0x42,
	0x6f, 0x68, 0x61, 0x66, 0x73, 0x74, 0x7d, 0x7a,
	0x89, 0x8e, 0x87, 0x80, 0x95, 0x92, 0x9b, 0x9c,
	0xb1, 0xb6, 0xbf, 0xb8, 0xad, 0xaa, 0xa3, 0xa4,
	0xf9, 0xfe, 0xf7, 0xf0, 0xe5, 0xe2, 0xeb, 0xec,
	0xc1, 0xc6, 0xcf, 0xc8, 0xdd, 0xda, 0xd3, 0xd4,
	0x69, 0x6e, 0x67, 0x60, 0x75, 0x72, 0x7b, 0x7c,
	0x51, 0x56, 0x5f, 0x58, 0x4d, 0x4a, 0x43, 0x44,
	0x19, 0x1e, 0x17, 0x10, 0x05, 0x02, 0x0b, 0x0c,
	0x21, 0x26, 0x2f, 0x28, 0x3d, 0x3a, 0x33, 0x34,
	0x4e, 0x49, 0x40, 0x47, 0x52, 0x55, 0x5c, 0x5b,
	0x76, 0x71, 0x78, 0x7f, 0x6a, 0x6d, 0x64, 0x63,
	0x3e, 0x39, 0x30, 0x37, 0x22, 0x25, 0x2c, 0x2b,
	0x06, 0x01, 0x08, 0x0f, 0x1a, 0x1d, 0x14, 0x13,
	0xae, 0xa9, 0xa0, 0xa7, 0xb2, 0xb5, 0xbc, 0xbb,
	0x96, 0x91, 0x98, 0x9f, 0x8a, 0x8d, 0x84, 0x83,
	0xde, 0xd9, 0xd0, 0xd7, 0xc2, 0xc5, 0xcc, 0xcb,
	0xe6, 0xe1, 0xe8, 0xef, 0xfa, 0xfd, 0xf4, 0xf3
};

/**
 * Update the crc value with new data.
 *
 * \param crc      The current crc value.
 * \param data     Pointer to a buffer of \a data_len bytes.
 * \param data_len Number of bytes in the \a data buffer.
 * \return         The updated crc value.
 *****************************************************************************/
crc8_t crc8_update(crc8_t crc, const unsigned char *data, size_t data_len)
{
	unsigned int tbl_idx = 0;

	if (!data) {
		return crc & 0xff;
	}

	while (data_len--) {
		tbl_idx = ((crc >> 0) ^ *data) & 0xff;
		crc = (crc8_table[tbl_idx] ^ (crc << 8)) & 0xff;

		data++;
	}
	return crc & 0xff;
}
/* end crc8.c */
```

## src/crc8.h
```c
/**
 * \file crc8.h
 * Functions and types for CRC checks.
 *
 * Generated on Mon Apr  2 17:26:19 2012,
 * by pycrc v0.7.10, http://www.tty1.net/pycrc/
 * using the configuration:
 *    Width        = 8
 *    Poly         = 0x07
 *    XorIn        = 0x00
 *    ReflectIn    = False
 *    XorOut       = 0x55
 *    ReflectOut   = False
 *    Algorithm    = table-driven
 *****************************************************************************/
#ifndef __CRC8_H__
#define __CRC8_H__

#include <stdint.h>
#include <stddef.h>

#ifdef __cplusplus
extern "C" {
#endif

/**
 * The definition of the used algorithm.
 *****************************************************************************/
#define CRC_ALGO_TABLE_DRIVEN 1


/**
 * The type of the CRC values.
 *
 * This type must be big enough to contain at least 8 bits.
 *****************************************************************************/
typedef uint8_t crc8_t;


/**
 * Calculate the initial crc value.
 *
 * \return     The initial crc value.
 *****************************************************************************/
static inline crc8_t crc8_init(void)
{
	return 0x00;
}


/**
 * Update the crc value with new data.
 *
 * \param crc      The current crc value.
 * \param data     Pointer to a buffer of \a data_len bytes.
 * \param data_len Number of bytes in the \a data buffer.
 * \return         The updated crc value.
 *****************************************************************************/
crc8_t crc8_update(crc8_t crc, const unsigned char *data, size_t data_len);


/**
 * Calculate the final crc value.
 *
 * \param crc  The current crc value.
 * \return     The final crc value.
 *****************************************************************************/
static inline crc8_t crc8_finalize(crc8_t crc)
{
	return crc ^ 0x55;
}


#ifdef __cplusplus
}
#endif

#endif      /* __CRC8_H__ */
/* end crc8.h */
```
