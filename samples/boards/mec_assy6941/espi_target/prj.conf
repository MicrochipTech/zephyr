## prj.conf
```kconfig
CONFIG_LOG=y
CONFIG_LOG_MODE_IMMEDIATE=y
#CONFIG_LOG_MODE_MINIMAL=y
# !!! WARNING: deferred and buffer size not working.
# !!! log_panic() does not output messages.
#CONFIG_LOG_MODE_DEFERRED=y
#CONFIG_LOG_BUFFER_SIZE=4096
CONFIG_LOG_BACKEND_UART=y
#CONFIG_LOG_BACKEND_SWO=y
#CONFIG_LOG_BACKEND_SWO_REF_FREQ_HZ=96000000
#CONFIG_LOG_BACKEND_SWO_FREQ_HZ=4000000

CONFIG_GPIO=y
CONFIG_PINCTRL=y
CONFIG_LED=y
CONFIG_SPI=y
CONFIG_SPI_EXTENDED_MODES=y
# CONFIG_SPI_MEC5_QSPI_INTERRUPT=y
CONFIG_SERIAL=y
CONFIG_CONSOLE=y
CONFIG_UART_CONSOLE=y
CONFIG_I2C=y
CONFIG_ESPI=y
CONFIG_ESPI_MEC5=y
CONFIG_ESPI_PERIPHERAL_8042_KBC=y
CONFIG_ESPI_PERIPHERAL_EC_HOST_CMD=y
CONFIG_ESPI_PERIPHERAL_ACPI_SHM_REGION=y
CONFIG_ESPI_PERIPHERAL_CUSTOM_OPCODE=y
CONFIG_ESPI_AUTOMATIC_WARNING_ACKNOWLEDGE=n
CONFIG_ESPI_AUTOMATIC_BOOT_DONE_ACKNOWLEDGE=y
CONFIG_ESPI_LOG_LEVEL_DBG=y

CONFIG_PM=n

# CONFIG_APP_INVERT_ESPI_CS_N=y

# Help debug new code
# CONFIG_DEBUG_COREDUMP=y
# CONFIG_TRAP_UNALIGNED_ACCESS=y
# CONFIG_SOC_MEC5_DEBUG_AND_TRACING=y
# CONFIG_SOC_MEC5_DEBUG_AND_SWV_TRACING=y
# CONFIG_DEBUG=y

# Boot up test
CONFIG_ESPI_PERIPHERAL_ACPI_EC_IBF_EVT_DATA=y
```

## src/main.c
```c
/*
 * Copyright (c) 2023 Microchip Technology, Inc.
 *
 * SPDX-License-Identifier: Apache-2.0
 */

#include <errno.h>
#include <stdint.h>
#include <string.h>
#include <soc.h>
#include <mec_espi_api.h>
#include <mec_pcr_api.h>

#include <zephyr/device.h>
#include <zephyr/devicetree.h>
#include <zephyr/kernel.h>
#include <zephyr/drivers/espi.h>
#include <zephyr/drivers/gpio.h>
#include <zephyr/drivers/led.h>
#include <zephyr/drivers/pinctrl.h>
#include <zephyr/sys/sys_io.h>

#include <zephyr/logging/log_ctrl.h>
#include <zephyr/logging/log.h>
LOG_MODULE_REGISTER(app, CONFIG_LOG_DEFAULT_LEVEL);

#include "espi_debug.h"

PINCTRL_DT_DEFINE(DT_PATH(zephyr_user));

const struct pinctrl_dev_config *app_pinctrl_cfg = PINCTRL_DT_DEV_CONFIG_GET(DT_PATH(zephyr_user));

static const struct device *espi_dev = DEVICE_DT_GET(DT_NODELABEL(espi0));

#define ESPI0_NODE DT_NODELABEL(espi0)

struct espi_io_regs *const espi_iobase = (struct espi_io_regs *)DT_REG_ADDR_BY_NAME(ESPI0_NODE, io);

static volatile uint32_t spin_val;
static volatile int ret_val;
static volatile int app_main_exit;

struct espi_cfg ecfg;
struct espi_callback espi_cb_reset;
struct espi_callback espi_cb_chan_ready;
struct espi_callback espi_cb_vw;

#define ESPI_CHAN_READY_PC_IDX 0
#define ESPI_CHAN_READY_VW_IDX 1
#define ESPI_CHAN_READY_OOB_IDX 2
#define ESPI_CHAN_READY_FC_IDX 3
volatile uint8_t chan_ready[4];

#define MAX_ESPI_EVENTS 64
static size_t espi_ev_idx;
static struct espi_event espi_evs[MAX_ESPI_EVENTS];

static void spin_on(uint32_t id, int rval);

static int init_espi_events(struct espi_event *evs, size_t nevents);

static void espi_reset_cb(const struct device *dev,
			  struct espi_callback *cb,
			  struct espi_event ev);

static void espi_chan_ready_cb(const struct device *dev,
			       struct espi_callback *cb,
			       struct espi_event ev);

static void espi_vw_received_cb(const struct device *dev,
			        struct espi_callback *cb,
				struct espi_event ev);

//static void print_espi_events(void);
//static void print_last_espi_events(uint32_t last_n_events);

#if 1
#include <mec_gpio_api.h>
#define MCHP_XEC_GPIO_BASE DT_REG_ADDR(DT_NODELABEL(gpio_000_036))
#define MCHP_XEC_GPIO_CTRL_REG_ADDR(pin) ((uint32_t)MCHP_XEC_GPIO_BASE + ((uint32_t)(pin) * 4u))
#endif

#if 1
/* PC call back */
struct espi_callback espi_cb_pc;
static void espi_pc_received_cb(const struct device *dev,
			    struct espi_callback *cb,
				struct espi_event ev);

#include "ESPI_PC_Hal.h"
#include "ESPI_KBC_Hal.h"

extern unsigned char espi_acpi_ec_space[]; 
#endif 

int main(void)
{
	int ret = 0;
//	size_t n = 0;
//	unsigned short int i;

	LOG_INF("MEC5 eSPI Target sample application for board: %s", DT_N_COMPAT_MODEL_IDX_0);

#if 0
// init space[]
	/* clear ACPI EC space */
	for(i = 0; i < 256; i++)
	{
		espi_acpi_ec_space[i] = 0x00;
	}
#endif 

	ret = pinctrl_apply_state(app_pinctrl_cfg, PINCTRL_STATE_DEFAULT);
	if (ret) {
		LOG_ERR("App pin control state apply: %d", ret);
		spin_on(1, ret);
	}

	/* let pins settle */
	k_sleep(K_MSEC(10));

	LOG_INF("Releasing SoC internal RESET_VCC. Unblocks VCC_PWRGD input");
	mec_pcr_release_reset_vcc(1);

	LOG_INF("Platform configuration: Select nPLTRST = eSPI nPLTRST VWire");
	mec_pcr_host_reset_select(MEC_PCR_PLATFORM_RST_IS_ESPI_PLTRST);

#if 0
	LOG_INF("Poll VCC_PWRGD");
	n = 1000u;
	ret = mec_pcr_is_vcc_pwrgd();
	while (!ret) {
		if (n == 0) {
			LOG_ERR("VCC_PWRGD not present!");
			spin_on(1u, -1);
			goto app_exit;
		}
		--n;
		k_sleep(K_MSEC(2));
		ret = mec_pcr_is_vcc_pwrgd();
	}
#endif

	LOG_INF("VCC_PWRGD OK");
	mec_pcr_release_reset_vcc(1);

	init_espi_events(espi_evs, MAX_ESPI_EVENTS);

	if (!device_is_ready(espi_dev)) {
		LOG_ERR("eSPI device is not ready! (%d)", -1);
		spin_on(3u, -1);
		goto app_exit;
	}

	LOG_INF("eSPI driver is ready");

	LOG_INF("Call eSPI driver config API");
	ecfg.io_caps = ESPI_IO_MODE_SINGLE_LINE;
	ecfg.channel_caps = (ESPI_CHANNEL_PERIPHERAL | ESPI_CHANNEL_VWIRE
			     | ESPI_CHANNEL_OOB | ESPI_CHANNEL_FLASH);
	ecfg.max_freq = 20u;

	ret = espi_config(espi_dev, &ecfg);
	if (ret) {
		LOG_ERR("eSPI configuration API error (%d)", ret);
		spin_on(5u, ret);
		goto app_exit;
	}

	LOG_INF("eSPI after config");
	espi_debug_print_config();
	/* espi_debug_print_io_bars(); */
	/* espi_debug_print_mem_bars(); */

	espi_cb_reset.handler = espi_reset_cb;
	espi_cb_reset.evt_type = ESPI_BUS_RESET;
	ret = espi_add_callback(espi_dev, &espi_cb_reset);
	if (ret) {
		LOG_ERR("API error add callback for eSPI Reset (%d)", ret);
		spin_on(6u, ret);
		goto app_exit;
	}

	espi_cb_chan_ready.handler = espi_chan_ready_cb;
	espi_cb_chan_ready.evt_type = ESPI_BUS_EVENT_CHANNEL_READY;
	ret = espi_add_callback(espi_dev, &espi_cb_chan_ready);
	if (ret) {
		LOG_ERR("API error add callback for VW ChanEn (%d)", ret);
		spin_on(7u, ret);
		goto app_exit;
	}

	espi_cb_vw.handler = espi_vw_received_cb;
	espi_cb_vw.evt_type = ESPI_BUS_EVENT_VWIRE_RECEIVED;
	ret = espi_add_callback(espi_dev, &espi_cb_vw);
	if (ret) {
		LOG_ERR("API error add callback for VW received (%d)", ret);
		spin_on(8u, ret);
		goto app_exit;
	}

#if 1
/* PC call back */
	espi_cb_pc.handler = espi_pc_received_cb;
	espi_cb_pc.evt_type = ESPI_BUS_PERIPHERAL_NOTIFICATION;
	ret = espi_add_callback(espi_dev, &espi_cb_pc);
	if (ret) {
		LOG_ERR("API error add callback for PC received (%d)", ret);
		spin_on(8u, ret);
		goto app_exit;
	}
#endif 
	/* Release board RSMRST# allowing Host eSPI controller to exit reset state
	 * and begin eSPI link training.
	 * TODO - we need pin uses as RSMRST#
	 */

#if 1
/* KF support */
	LOG_INF("main: eSPI init done, and cfg gpio0242 as PWRGD input##");
	uint32_t temp = 0;
	temp = 0x3041;
	sys_write32(temp, MEC_GPIO_CTRL_REG_ADDR(MEC_PIN_0242));
#endif

#if 1
	LOG_INF("main: eSPI init done, and release RSMRST# high####");
	//uint32_t temp = 0;
	temp = 0x10240;
	sys_write32(temp, MEC_GPIO_CTRL_REG_ADDR(MEC_PIN_0054));
#endif

	/* TODO - Poll driver for channel enables or use callbacks to know when channels
	 * are enabled.
	 */

//	LOG_INF("Print all eSPI events");
//	print_espi_events();

do{
	temp = sys_read32(MEC_GPIO_CTRL_REG_ADDR(MEC_PIN_0242));
}
while((temp & 0x01000000) == 0);
//k_busy_wait(5000);

#if 1
/* KF support */
	LOG_INF("main: RSMRST# high, then VR_ON high####");
	temp = 0x10240;
	sys_write32(temp, MEC_GPIO_CTRL_REG_ADDR(MEC_PIN_0106));
#endif

	LOG_INF("ADone");
#if 1
/* support kbcec cmd process */
	while(1)
	{
		;
	}
#endif 

	spin_on(256, 0);

app_exit:
	LOG_INF("App Exit");
	log_panic();
	app_main_exit = 1;

	return 0;
}

static void spin_on(uint32_t id, int rval)
{
	spin_val = id;
	ret_val = rval;

	LOG_INF("spin_on %u", id);
	log_panic(); /* flush log buffers */

	while (spin_val) {
		;
	}
}

static int init_espi_events(struct espi_event *evs, size_t nevents)
{
	if (!evs) {
		return -EINVAL;
	}

	espi_ev_idx = 0;
	memset(evs, 0, sizeof(struct espi_event) * nevents);

	return 0;
}

/* eSPI driver callbacks */
static void espi_reset_cb(const struct device *dev,
			  struct espi_callback *cb,
			  struct espi_event ev)
{
//	LOG_INF("eSPI CB: eSPI_nReset");
//	LOG_INF("eSPI RESET# ISR CallBack: eSPI_nReset#");
}

static void espi_chan_ready_cb(const struct device *dev,
			       struct espi_callback *cb,
			       struct espi_event ev)
{
//	LOG_INF("espi_chan_ready_cb: eSPI CB: channel ready: %u 0x%x 0x%x",
//		ev.evt_type, ev.evt_data, ev.evt_details);

	if (ev.evt_details == ESPI_CHANNEL_VWIRE) {
		if (ev.evt_data == 1) {
			chan_ready[ESPI_CHAN_READY_VW_IDX] = 1;
		} else {
			chan_ready[ESPI_CHAN_READY_VW_IDX] = 0;
		}
	}

	if (ev.evt_details == ESPI_CHANNEL_PERIPHERAL) {
		if (ev.evt_data == 1) {
			chan_ready[ESPI_CHAN_READY_PC_IDX] = 1;
		} else {
			chan_ready[ESPI_CHAN_READY_PC_IDX] = 0;
		}
	}

	if (ev.evt_details == ESPI_CHANNEL_OOB) {
		if (ev.evt_data == 1) {
			chan_ready[ESPI_CHAN_READY_OOB_IDX] = 1;
		} else {
			chan_ready[ESPI_CHAN_READY_OOB_IDX] = 0;
		}
	}

	if (ev.evt_details == ESPI_CHANNEL_FLASH) {
		if (ev.evt_data == 1) {
			chan_ready[ESPI_CHAN_READY_FC_IDX] = 1;
		} else {
			chan_ready[ESPI_CHAN_READY_FC_IDX] = 0;
		}
	}
}

static void espi_vw_received_cb(const struct device *dev,
			       struct espi_callback *cb,
			       struct espi_event ev)
{
//	LOG_INF("eSPI CB: VW received: type= data= detail(vw enum)=: %u 0x%x 0x%x",
//		ev.evt_type, ev.evt_data, ev.evt_details);

	if (espi_ev_idx < MAX_ESPI_EVENTS) {
		espi_evs[espi_ev_idx].evt_type = ev.evt_type;
		espi_evs[espi_ev_idx].evt_data = ev.evt_data;
		espi_evs[espi_ev_idx].evt_details = ev.evt_details;
		espi_ev_idx++;
	}

#if 1
	/* dispatch individual VW ISR */
	if(ev.evt_details == ESPI_VWIRE_SIGNAL_SUS_WARN)
	{
		//LOG_INF("eSPI Event: Host-to-Target VW ESPI_VWIRE_SIGNAL_SUS_WARN##");
		/* ACK SUS_WARN# */
		espi_send_vwire(dev, ESPI_VWIRE_SIGNAL_SUS_ACK, ev.evt_data);
	}
#endif
}

struct espi_vw_znames {
	enum espi_vwire_signal signal;
	const char *name_cstr;
};

const struct espi_vw_znames vw_names[] = {
	{ ESPI_VWIRE_SIGNAL_SLP_S3, "SLP_S3#" },
	{ ESPI_VWIRE_SIGNAL_SLP_S4, "SLP_S4#" },
	{ ESPI_VWIRE_SIGNAL_SLP_S5, "SLP_S5#" },
	{ ESPI_VWIRE_SIGNAL_OOB_RST_WARN, "OOB_RST_WARN" },
	{ ESPI_VWIRE_SIGNAL_PLTRST, "PLTRST#" },
	{ ESPI_VWIRE_SIGNAL_SUS_STAT, "SUS_STAT#" },
	{ ESPI_VWIRE_SIGNAL_NMIOUT, "NMIOUT#" },
	{ ESPI_VWIRE_SIGNAL_SMIOUT, "SMIOUT#" },
	{ ESPI_VWIRE_SIGNAL_HOST_RST_WARN, "HOST_RST_WARN" },
	{ ESPI_VWIRE_SIGNAL_SLP_A, "SLP_A#" },
	{ ESPI_VWIRE_SIGNAL_SUS_PWRDN_ACK, "SUS_PWRDN_ACK" },
	{ ESPI_VWIRE_SIGNAL_SUS_WARN, "SUS_WARN#" },
	{ ESPI_VWIRE_SIGNAL_SLP_WLAN, "SLP_WLAN#" },
	{ ESPI_VWIRE_SIGNAL_SLP_LAN, "SLP_LAN#" },
	{ ESPI_VWIRE_SIGNAL_HOST_C10, "HOST_C10" },
	{ ESPI_VWIRE_SIGNAL_DNX_WARN, "DNX_WARN" },
	{ ESPI_VWIRE_SIGNAL_PME, "PME#" },
	{ ESPI_VWIRE_SIGNAL_WAKE, "WAKE#" },
	{ ESPI_VWIRE_SIGNAL_OOB_RST_ACK, "OOB_RST_ACK" },
	{ ESPI_VWIRE_SIGNAL_TARGET_BOOT_STS, "TARGET_BOOT_STS" },
	{ ESPI_VWIRE_SIGNAL_ERR_NON_FATAL, "ERR_NON_FATAL" },
	{ ESPI_VWIRE_SIGNAL_ERR_FATAL, "ERR_FATAL" },
	{ ESPI_VWIRE_SIGNAL_TARGET_BOOT_DONE, "TARGET_BOOT_DONE" },
	{ ESPI_VWIRE_SIGNAL_HOST_RST_ACK, "HOST_RST_ACK" },
	{ ESPI_VWIRE_SIGNAL_RST_CPU_INIT, "RST_CPU_INIT" },
	{ ESPI_VWIRE_SIGNAL_SMI, "SMI#" },
	{ ESPI_VWIRE_SIGNAL_SCI, "SCI#" },
	{ ESPI_VWIRE_SIGNAL_DNX_ACK, "DNX_ACK" },
	{ ESPI_VWIRE_SIGNAL_SUS_ACK, "SUS_ACK#" },
	{ ESPI_VWIRE_SIGNAL_TARGET_GPIO_0, "TARGET_GPIO_0" },
	{ ESPI_VWIRE_SIGNAL_TARGET_GPIO_1, "TARGET_GPIO_1" },
	{ ESPI_VWIRE_SIGNAL_TARGET_GPIO_2, "TARGET_GPIO_2" },
	{ ESPI_VWIRE_SIGNAL_TARGET_GPIO_3, "TARGET_GPIO_3" },
	{ ESPI_VWIRE_SIGNAL_TARGET_GPIO_4, "TARGET_GPIO_4" },
	{ ESPI_VWIRE_SIGNAL_TARGET_GPIO_5, "TARGET_GPIO_5" },
	{ ESPI_VWIRE_SIGNAL_TARGET_GPIO_6, "TARGET_GPIO_6" },
	{ ESPI_VWIRE_SIGNAL_TARGET_GPIO_7, "TARGET_GPIO_7" },
	{ ESPI_VWIRE_SIGNAL_TARGET_GPIO_8, "TARGET_GPIO_8" },
	{ ESPI_VWIRE_SIGNAL_TARGET_GPIO_9, "TARGET_GPIO_9" },
	{ ESPI_VWIRE_SIGNAL_TARGET_GPIO_10, "TARGET_GPIO_10" },
	{ ESPI_VWIRE_SIGNAL_TARGET_GPIO_11, "TARGET_GPIO_11" },
};

const char *unkown_vwire = "Unknown VWire";

#if 0
static const char * get_vw_name(uint32_t vwire_enum_val)
{
	for (size_t n = 0; n < ARRAY_SIZE(vw_names); n++) {
		const struct espi_vw_znames *vwn = &vw_names[n];

		if (vwn->signal == (enum espi_vwire_signal)vwire_enum_val) {
			return vwn->name_cstr;
		}
	}

	return unkown_vwire;
}

static void pr_decode_espi_event(uint32_t evt_type, uint32_t evt_data, uint32_t evt_details)
{
	switch (evt_type) {
	case ESPI_BUS_RESET:
		LOG_INF("eSPI Event: Bus Reset: data=0x%0x details=0x%0x", evt_data, evt_details);
		break;
	case ESPI_BUS_EVENT_CHANNEL_READY:
		LOG_INF("eSPI Event: Channel Ready: data=0x%0x details=0x%0x",
			evt_data, evt_details);
		break;
	case ESPI_BUS_EVENT_VWIRE_RECEIVED:
		const char *vwname = get_vw_name(evt_details);
		LOG_INF("eSPI Event: Host-to-Target VW Received: data=0x%0x details=0x%0x VW=%s",
			evt_data, evt_details, vwname);
		break;
	case ESPI_BUS_EVENT_OOB_RECEIVED:
		LOG_INF("eSPI Event: OOB Received: data=0x%0x details=0x%0x",
			evt_data, evt_details);
		break;
	case ESPI_BUS_PERIPHERAL_NOTIFICATION:
		LOG_INF("eSPI Event: Peripheral Notification: data=0x%0x details=0x%0x",
			evt_data, evt_details);
		break;
	case ESPI_BUS_SAF_NOTIFICATION:
		LOG_INF("eSPI Event: SAF Notification: data=0x%0x details=0x%0x",
			evt_data, evt_details);
		break;
	default:
		LOG_INF("eSPI Event: Unknown type=%u, data=0x%0x details=0x%0x",
			evt_type, evt_data, evt_details);
		break;
	}
}

static void print_espi_events(void)
{
	if (espi_ev_idx) {
		for (size_t n = 0; n < espi_ev_idx; n++) {
			uint32_t t = espi_evs[n].evt_type;
			uint32_t dat = espi_evs[n].evt_data;
			uint32_t det = espi_evs[n].evt_details;

			LOG_INF("eSPI event number %u", n);
			pr_decode_espi_event(t, dat, det);
		}
	} else {
		LOG_INF("No eSPI Event have been received");
	}
}

static void print_last_espi_events(uint32_t last_n_events)
{
	if (last_n_events && espi_ev_idx) {
		for (size_t n = espi_ev_idx; n >= 1; n--) {
			struct espi_event *ev = &espi_evs[n-1];

			LOG_INF("eSPI event %u", n);
			pr_decode_espi_event(ev->evt_type, ev->evt_data, ev->evt_details);
			if (--last_n_events == 0) {
				break;
			}
		}
	}
}
#endif

#if 1
/* PC call back */
static void espi_pc_received_cb(const struct device *dev,
			    struct espi_callback *cb,
				struct espi_event ev)
{
	unsigned char ec_rx;
//	LOG_INF("eSPI CB: PC received: type= data= detail=: %u 0x%x 0x%x",
//		ev.evt_type, ev.evt_data, ev.evt_details);

	/* 1: process ACPI EC0 */
	if(ev.evt_type == ESPI_BUS_PERIPHERAL_NOTIFICATION)
	{	/* PC event */
		if(ev.evt_details == ESPI_PERIPHERAL_HOST_IO)
		{	/* ACPI EC0 */
			ec_rx = (unsigned char)((ev.evt_data >> 8) & 0xFF);
			if((ev.evt_data & 0xFF) == 0)
			{	/* cmd */
				LOG_INF("ACPIEC0 C=0x%02x", ec_rx);
				ESPI_ACPI_Cmd(ec_rx);
			} else if((ev.evt_data & 0xFF) == 1)
			{	/* data */
				LOG_INF("ACPIEC0 D#=0x%02x", ec_rx);
				ESPI_Srvc_Pcdat2(ec_rx);
			} else
			{	/* 4-bye mode */
				LOG_ERR("espi_pc_received_cb: ACPI 4-byte mode??? (0x%08x)", ev.evt_data);
			}
		} else if(ev.evt_details == ESPI_PERIPHERAL_8042_KBC)
		{	/* KBC 8042 */
			ec_rx = (unsigned char)((ev.evt_data >> 8) & 0xFF);
			if((ev.evt_data & 0xFF) == 1)
			{	/* cmd */
				LOG_INF("KBC C=0x%02x", ec_rx);
				ESPI_KBC_Cmd(ec_rx);
			} else if((ev.evt_data & 0xFF) == 0)
			{	/* data */
				LOG_INF("KBC D#=0x%02x", ec_rx);
				ESPI_Srvc_Kbcdat1(ec_rx);
			} else
			{	/* 4-bye mode */
				LOG_ERR("espi_pc_received_cb: ACPI 4-byte mode??? (0x%08x)", ev.evt_data);
			}
		}
	}
}
#endif 
```

## src/ESPI_KBC_Hal.c
```c
/****************************************************************************
* 2014 Microchip Technology Inc. and its subsidiaries.
* You may use this software and any derivatives exclusively with
* Microchip products.
* THIS SOFTWARE IS SUPPLIED BY MICROCHIP "AS IS".
* NO WARRANTIES, WHETHER EXPRESS, IMPLIED OR STATUTORY, APPLY TO THIS SOFTWARE,
* INCLUDING ANY IMPLIED WARRANTIES OF NON-INFRINGEMENT, MERCHANTABILITY,
* AND FITNESS FOR A PARTICULAR PURPOSE, OR ITS INTERACTION WITH MICROCHIP
* PRODUCTS, COMBINATION WITH ANY OTHER PRODUCTS, OR USE IN ANY APPLICATION.
* IN NO EVENT WILL MICROCHIP BE LIABLE FOR ANY INDIRECT, SPECIAL, PUNITIVE,
* INCIDENTAL OR CONSEQUENTIAL LOSS, DAMAGE, COST OR EXPENSE OF ANY KIND
* WHATSOEVER RELATED TO THE SOFTWARE, HOWEVER CAUSED, EVEN IF MICROCHIP HAS
* BEEN ADVISED OF THE POSSIBILITY OR THE DAMAGES ARE FORESEEABLE.
* TO THE FULLEST EXTENT ALLOWED BY LAW, MICROCHIP'S TOTAL LIABILITY ON ALL
* CLAIMS IN ANY WAY RELATED TO THIS SOFTWARE WILL NOT EXCEED THE AMOUNT OF
* FEES, IF ANY, THAT YOU HAVE PAID DIRECTLY TO MICROCHIP FOR THIS SOFTWARE.
* MICROCHIP PROVIDES THIS SOFTWARE CONDITIONALLY UPON YOUR ACCEPTANCE
* OF THESE TERMS.
*/

/*
 **********************************************************************************
 *  ESPI_PC_Hal.C
 *      This is the ESPI service file: Peripheral channel process
 **********************************************************************************
 */

/******************************************************************************/
/** @defgroup ESPI_PC ESPI_PC
 *  @{
 */

/** @file ESPI_PC.c
* \brief ESPI_PC source file
* \author KBCEC Team
*
******************************************************************************/

/* for global */
#include <zephyr/kernel.h>
#include <soc.h>
//#include <soc_espi.h>
#include <errno.h>
#include <zephyr/arch/common/ffs.h>
#include <zephyr/device.h>
#include <zephyr/devicetree.h>
#include <zephyr/drivers/espi.h>
#include <zephyr/drivers/pinctrl.h>
#include <zephyr/dt-bindings/espi/mchp-mec5-espi.h>
#include <zephyr/logging/log.h>
#include <zephyr/sys/sys_io.h>
#include <zephyr/sys/util.h>
#include <zephyr/irq.h>
/* TODO #include "espi_utils.h" */
//#include "espi_mchp_mec5_private.h"

/* MEC5 HAL */
#include <device_mec5.h>
#include <mec_retval.h>
#include <mec_pcr_api.h>
#include <mec_espi_api.h>
#include <mec_kbc_api.h>

//LOG_MODULE_REGISTER(espi_acpi_ec, CONFIG_ESPI_LOG_LEVEL);

/* get KBC0 / 8042 register struct from device tree */
#define KBC0_8042_NODE DT_NODELABEL(kbc0)
struct kbc_regs *const kbc0_8042_regs = (struct kbc_regs *)DT_REG_ADDR(KBC0_8042_NODE);

/* for local */
#include "ESPI_KBC_Hal.h"

/* global variables */
unsigned char Cmd_Byte = 0;
unsigned char Cmd_D4h_AUX_Cmd = 0;
unsigned char AUX_F3h_dat = 0;
unsigned char AUX_E8h_dat = 0;

unsigned char Cmd_KBD = 0;
unsigned char Ccb42_byte = 0;
unsigned char KBD_EDh_dat = 0;

/* support kbc / 8042 cmd & data process */
/* tx KBC/KBD data to KBC */
void Data_To_Host(unsigned char value)
{
	unsigned char sts_byte;
	/* set status properly */
	sts_byte = mec_kbc_status(kbc0_8042_regs);
	sts_byte &=  ~(MEC_KBC_STS_UD2_B1  | /* Parity error bits. */
                   MEC_KBC_STS_UD2_B0  | /* General time out error bits. */
                   MEC_KBC_STS_AUXOBF  | /* Send time out error bits for AT. */
                   MEC_KBC_STS_AUXOBF);  /* Aux device bits for PS/2. */
	mec_kbc_status_wr(kbc0_8042_regs, sts_byte, 0x00);

	mec_kbc_wr_data(kbc0_8042_regs, value, MEC_KBC_DATA_KB);
}

/* tx AUX data to KBC */
void Data_To_Host_AUX(unsigned char value)
{
	unsigned char sts_byte;
	/* set status properly */
	sts_byte = mec_kbc_status(kbc0_8042_regs);
	sts_byte = (sts_byte & ~(MEC_KBC_STS_UD2_B1  | /* Parity error bits. */
                   			MEC_KBC_STS_UD2_B0   | /* General time out error bits. */
                   			MEC_KBC_STS_AUXOBF))   /* Send time out error bits for AT. */
                   			| MEC_KBC_STS_AUXOBF;  /* Aux device bits for PS/2. */
	mec_kbc_status_wr(kbc0_8042_regs, sts_byte, 0x00);

	mec_kbc_wr_data(kbc0_8042_regs, value, MEC_KBC_DATA_AUX);
}

unsigned char Output_Buffer_Full(void)
{
	unsigned char ret;
	ret = mec_kbc_status(kbc0_8042_regs) & MEC_KBC_STS_OBF;
	return ret;
}

/******************************************************************************/
/** ESPI_Srvc_Kbcdat1
 * Process KBC commands...
 *
 * @param None
 *
 * @return None
 *
 ******************************************************************************/
void ESPI_Srvc_Kbcdat1(unsigned char value)
{
	unsigned char value_tmp;

	if(Cmd_Byte == 0)
	{	/* this is KBD cmd, host writes 60h / data register directly */

		if(Cmd_KBD == 0)
		{	/* first kbd cmd */
			switch(value)
			{
				case 0xED:
					/* AUX cmd - ack FAh to host */
	        		while(Output_Buffer_Full())
					{
					}
					/* ACK */
					value_tmp = 0xFA;
            		Data_To_Host(value_tmp);
					Cmd_KBD = 0xED;
					break;


      			default:
			    	break;
			} /* switch(Cmd_Byte) */
		}
		else
		{
			switch(Cmd_KBD)
			{
				case 0xED:
					KBD_EDh_dat = value;
					/* AUX cmd - ack FAh to host */
	        		while(Output_Buffer_Full())
					{
					}
					/* ACK */
					value_tmp = 0xFA;
            		Data_To_Host(value_tmp);
					Cmd_KBD = 0;
					break;

      			default:
			    	break;
			} /* switch(Cmd_Byte) */
		}

	}
	else
	{
		switch(Cmd_Byte)
		{
			case 0xD4:
				/* 0xD4 - following cmd or data to AUX device */
				if(Cmd_D4h_AUX_Cmd == 0)
				{
				switch(value)
				{
					case 0xE8:
						/* AUX cmd - ack FAh to host */
	        			while(Output_Buffer_Full())
						{
						}
						/* ACK */
            			Data_To_Host_AUX(0xFA);
						Cmd_Byte = 0;
						Cmd_D4h_AUX_Cmd = 0xE8;
						break;

					case 0xF3:
						/* AUX cmd - ack FAh to host */
	        			while(Output_Buffer_Full())
						{
						}
						/* ACK */
            			Data_To_Host_AUX(0xFA);
						Cmd_Byte = 0;
						Cmd_D4h_AUX_Cmd = 0xF3;
						break;

					case 0xE6:
						/* AUX cmd - ack FAh to host */
	        			while(Output_Buffer_Full())
						{
						}
						/* ACK */
						//value_tmp = 0xFA;
            			Data_To_Host_AUX(0xFA);
						Cmd_Byte = 0;
						break;

					case 0xF4:
						/* AUX cmd - ack FAh to host */
	        			while(Output_Buffer_Full())
						{
						}
						/* ACK */
						value_tmp = 0xFA;
            			Data_To_Host_AUX(value_tmp);
						Cmd_Byte = 0;
						break;

					case 0xFF:
						/* AUX cmd - reset AUX */
	        			while(Output_Buffer_Full())
						{
						}
						/* ACK */
						//value_tmp = 0xFA;
            			Data_To_Host_AUX(0xFA);

	        			while(Output_Buffer_Full())
						{
						}
						/* ACK */
            			Data_To_Host_AUX(0xAA);

	        			while(Output_Buffer_Full())
						{
						}
						/* ACK */
            			Data_To_Host_AUX(0x00);

						Cmd_Byte = 0;
						break;

					default:
						break;
				} /* switch(value) */
				}
				else
				{	/* has previous AUX cmd */
					switch(Cmd_D4h_AUX_Cmd)
					{
						case 0xE8:
							/* AUX cmd - ack FAh to host */
	        				while(Output_Buffer_Full())
							{
							}
							/* ACK */
							//value_tmp = 0xFA;
            				Data_To_Host_AUX(0xFA);

							/* grab data of E8h */
							AUX_E8h_dat = value;
							Cmd_Byte = 0;
							Cmd_D4h_AUX_Cmd = 0;
							break;

						case 0xF3:
							/* AUX cmd - ack FAh to host */
	        				while(Output_Buffer_Full())
							{
							}
							/* ACK */
							value_tmp = 0xFA;
            				Data_To_Host_AUX(value_tmp);

							/* grab data of F3h */
							AUX_F3h_dat = value;
							Cmd_Byte = 0;
							Cmd_D4h_AUX_Cmd = 0;
							break;

						default:
							break;
					}
				}
				break;

			case 0x60:
				/* 0x60 - following one data */
				Ccb42_byte = value;
				Cmd_Byte = 0;
				break;


      		default:
			    break;
		} /* switch(Cmd_Byte) */
	}
}


/******************************************************************************/
/** ESPI_KBC_Cmd
 * Process KBC commands...
 *
 * @param None
 *
 * @return None
 *
 ******************************************************************************/
void ESPI_KBC_Cmd(unsigned char command_num)
{
	unsigned char value_tmp;

	switch(command_num)
	{
		case 0xAA:
	        while(Output_Buffer_Full())
			{
			}
			/* self test */
			value_tmp = 0x55;
            Data_To_Host(value_tmp);
			break;

		case 0xD4:
			/* 0xD4 - following cmd or data to AUX device */
			/* will rx one data byte */
			Cmd_Byte = command_num;   /* Save command number and wait for value byte. */
			break;

		case 0x60:
			/* 0x60 - following one data */
			Cmd_Byte = command_num;   /* Save command number and wait for value byte. */
			break;

		case 0x20:
	        while(Output_Buffer_Full())
			{
			}
			/* read */
            Data_To_Host(Ccb42_byte);
			break;

		case 0xAD:     
			break;

		case 0xA7:     
			break;

		case 0xA8:     
			break;

      	default:
			trace1(0, ESPI_PC, 0, "ESPI_KBC_Cmd: oop??? unsupported cmd, command_num  = %02Xh", command_num);
            break;
	} /* switch(command_num) */
}

/**   @}
 */
```

## src/ESPI_PC_Hal.c
```c
/****************************************************************************
* 2014 Microchip Technology Inc. and its subsidiaries.
* You may use this software and any derivatives exclusively with
* Microchip products.
* THIS SOFTWARE IS SUPPLIED BY MICROCHIP "AS IS".
* NO WARRANTIES, WHETHER EXPRESS, IMPLIED OR STATUTORY, APPLY TO THIS SOFTWARE,
* INCLUDING ANY IMPLIED WARRANTIES OF NON-INFRINGEMENT, MERCHANTABILITY,
* AND FITNESS FOR A PARTICULAR PURPOSE, OR ITS INTERACTION WITH MICROCHIP
* PRODUCTS, COMBINATION WITH ANY OTHER PRODUCTS, OR USE IN ANY APPLICATION.
* IN NO EVENT WILL MICROCHIP BE LIABLE FOR ANY INDIRECT, SPECIAL, PUNITIVE,
* INCIDENTAL OR CONSEQUENTIAL LOSS, DAMAGE, COST OR EXPENSE OF ANY KIND
* WHATSOEVER RELATED TO THE SOFTWARE, HOWEVER CAUSED, EVEN IF MICROCHIP HAS
* BEEN ADVISED OF THE POSSIBILITY OR THE DAMAGES ARE FORESEEABLE.
* TO THE FULLEST EXTENT ALLOWED BY LAW, MICROCHIP'S TOTAL LIABILITY ON ALL
* CLAIMS IN ANY WAY RELATED TO THIS SOFTWARE WILL NOT EXCEED THE AMOUNT OF
* FEES, IF ANY, THAT YOU HAVE PAID DIRECTLY TO MICROCHIP FOR THIS SOFTWARE.
* MICROCHIP PROVIDES THIS SOFTWARE CONDITIONALLY UPON YOUR ACCEPTANCE
* OF THESE TERMS.
*/

/*
 **********************************************************************************
 *  ESPI_PC_Hal.C
 *      This is the ESPI service file: Peripheral channel process
 **********************************************************************************
 */

/******************************************************************************/
/** @defgroup ESPI_PC ESPI_PC
 *  @{
 */

/** @file ESPI_PC.c
* \brief ESPI_PC source file
* \author KBCEC Team
*
******************************************************************************/

/* for global */
#include <zephyr/kernel.h>
#include <soc.h>
//#include <soc_espi.h>
#include <errno.h>
#include <zephyr/arch/common/ffs.h>
#include <zephyr/device.h>
#include <zephyr/devicetree.h>
#include <zephyr/drivers/espi.h>
#include <zephyr/drivers/pinctrl.h>
#include <zephyr/dt-bindings/espi/mchp-mec5-espi.h>
#include <zephyr/logging/log.h>
#include <zephyr/sys/sys_io.h>
#include <zephyr/sys/util.h>
#include <zephyr/irq.h>
/* TODO #include "espi_utils.h" */
//#include "espi_mchp_mec5_private.h"

/* MEC5 HAL */
#include <device_mec5.h>
#include <mec_retval.h>
#include <mec_pcr_api.h>
#include <mec_espi_api.h>
#include <mec_acpi_ec_api.h>

//LOG_MODULE_REGISTER(espi_acpi_ec, CONFIG_ESPI_LOG_LEVEL);

/* get ACPI EC0 register struct from device tree */
#define ACPI_EC0_NODE DT_NODELABEL(acpi_ec0)
struct acpi_ec_regs *const acpi_ec0_regs = (struct acpi_ec_regs *)DT_REG_ADDR(ACPI_EC0_NODE);

/* get ESPI device - only one instance */
static const struct device *const espi_dev = DEVICE_DT_GET(DT_NODELABEL(espi0));

/* for local */
#include "ESPI_PC_Hal.h"

#define ON  1
#define OFF 0
/* ON: support KabyLake platform; OFF: Skylake platform */
#define KBL_SUPPORTED	        ON
#define ESPI_OOB_FC_TEST		OFF

/* global variables */
unsigned char Cmd_Byte2 = 0;
unsigned char Tmp_Load2 = 0;    /* Increment value byte counter. */
unsigned char EC_Addr;         	/* Store address byte. */
unsigned char Ext_Cb3_ACPI_ENABLED = 0;
unsigned char espi_acpi_ec_space[256] = {
    // 0     1     2     3     4     5     6     7     8     9     A     B     C     D     E     F
    0x00, 0x00, 0x00, 0x40, 0x00, 0x00, 0x00, 0x00, 0x00, 0x00, 0x00, 0x00, 0x00, 0x00, 0x00, 0x00, // 00h-0Fh
    0x00, 0x00, 0x00, 0x00, 0x00, 0x00, 0x00, 0x00, 0x00, 0x00, 0x00, 0x00, 0x00, 0x00, 0x00, 0x00, // 10h-1Fh
    0x00, 0x00, 0x00, 0x00, 0x00, 0x00, 0x00, 0x00, 0x00, 0x00, 0x00, 0x00, 0x00, 0x00, 0x00, 0x00, // 20h-2Fh
    0x99, 0x00, 0x0A, 0x00, 0x00, 0x00, 0x00, 0x00, 0x00, 0x00, 0x00, 0x00, 0x00, 0x00, 0x00, 0x00, // 30h-3Fh
    0x00, 0x00, 0x00, 0x00, 0x00, 0x00, 0x00, 0x00, 0x00, 0x00, 0x00, 0x00, 0x00, 0x00, 0x00, 0x00, // 40h-4Fh
    0x00, 0x00, 0x00, 0x00, 0x00, 0x00, 0x00, 0x62, 0x11, 0x9F, 0x0E, 0x96, 0x11, 0x8B, 0x1F, 0x00, // 50h-5Fh
    0x00, 0xA3, 0x08, 0x00, 0x00, 0x00, 0x00, 0x00, 0x00, 0x00, 0x00, 0x00, 0x00, 0x00, 0x00, 0x00, // 60h-6Fh
    0x00, 0x00, 0x00, 0x00, 0x00, 0x00, 0x00, 0x00, 0x02, 0x01, 0x00, 0x00, 0x00, 0x00, 0x00, 0x00, // 70h-7Fh
    0x00, 0x00, 0x00, 0x00, 0x00, 0x00, 0x00, 0x00, 0x00, 0x00, 0x00, 0x00, 0x00, 0x00, 0x00, 0x00, // 80h-8Fh
    0x00, 0x00, 0x00, 0x00, 0x00, 0x00, 0x00, 0x00, 0x00, 0x00, 0x00, 0x00, 0x00, 0x00, 0x00, 0x00, // 90h-9Fh
    0x00, 0x00, 0x00, 0x00, 0x00, 0x00, 0x00, 0x00, 0x00, 0x00, 0x00, 0x00, 0x00, 0x00, 0x00, 0x00, // A0h-AFh
    0x00, 0x00, 0x00, 0x00, 0x00, 0x00, 0x00, 0x00, 0x00, 0x00, 0x00, 0x00, 0x00, 0x00, 0x00, 0x00, // B0h-BFh
    0x00, 0x00, 0x00, 0x00, 0x00, 0x00, 0x00, 0x00, 0x00, 0x1F, 0x00, 0x00, 0x00, 0x00, 0x00, 0x00, // C0h-CFh
    0x00, 0x00, 0x00, 0xB0, 0x1D, 0x00, 0x00, 0x00, 0x00, 0x00, 0x00, 0x00, 0x00, 0x00, 0x00, 0x00, // D0h-DFh
    0x00, 0x00, 0x00, 0x00, 0x00, 0x00, 0x00, 0x00, 0x00, 0x00, 0x00, 0x00, 0x00, 0x00, 0x00, 0x00, // E0h-EFh
    0x00, 0x00, 0x00, 0x00, 0x00, 0x00, 0x00, 0x00, 0x00, 0x00, 0x03, 0x07, 0x00, 0x00, 0x00, 0x00  // F0h-FFh
};


/* Generate SCI to host*/
void ACPI_Gen_Int(void)
{
	/* check if system is in acpi mode */
	if(Ext_Cb3_ACPI_ENABLED == 1)
	{
		espi_send_vwire(espi_dev, ESPI_VWIRE_SIGNAL_SCI, 0);
		k_busy_wait(100);
		espi_send_vwire(espi_dev, ESPI_VWIRE_SIGNAL_SCI, 1);
	}
}

/* tx data to EC0 */
void Data_To_Host2(unsigned char value)
{
	//mec_acpi_ec_host_to_ec_data_wr8(acpi_ec0_regs, 0x00, value);
	mec_acpi_ec_e2h_data_wr8(acpi_ec0_regs, 0x00, value);
}

unsigned char Output_Buffer2_Full(void)
{
	unsigned char ret;
	ret = mec_acpi_ec_status_obf(acpi_ec0_regs);
	return ret;
}

/******************************************************************************/
/** ESPI_ACPI_Cmd
 * Process ACPI commands...
 *
 * @param None
 *
 * @return None
 *
 ******************************************************************************/
void ESPI_ACPI_Cmd(BYTE command_num)
{
	BYTE value_tmp;
    unsigned short value2;

	trace1(0, ESPI_PC, 0, "ESPI_ACPI_Cmd: command_num  = %02Xh", command_num);
	switch(command_num)
	{
		case 0x04:     
			break;

		case 0x05:     
			break;

		case 0x06:                
	        while(Output_Buffer2_Full())
			{
			}
			/* Query system status */
			/* bit5=0, undocked; bit4=1, AC powered; bit[3:0]=0, CPU thermal state */
			value_tmp = 0x10;
            Data_To_Host2(value_tmp);
			//ACPI_Gen_Int();
			break;

		case 0x09:                
	        while(Output_Buffer2_Full())
			{
			}
			/* 1st byte: "K" */
            Data_To_Host2(0x4b);
			//ACPI_Gen_Int();
	        trace1(0, ESPI_PC, 0, "ESPI_ACPI_Cmd: TGL 0x09 return K = %02Xh", 0x4B);

	        while(Output_Buffer2_Full())
			{
			}
			/* 2nd byte: "S" */
            Data_To_Host2(0x53);
			//ACPI_Gen_Int();
	        trace1(0, ESPI_PC, 0, "ESPI_ACPI_Cmd: TGL 0x09 return S = %02Xh", 0x53);

	        while(Output_Buffer2_Full())
			{
			}
			/* 3rd byte: "C" */
            Data_To_Host2(0x43);
			//ACPI_Gen_Int();
	        trace1(0, ESPI_PC, 0, "ESPI_ACPI_Cmd: TGL 0x09 return C = %02Xh", 0x43);

	        while(Output_Buffer2_Full())
			{
			}
#if 1
/* TGL porting */

			/* 4th byte: 0 */
            Data_To_Host2(0x94);
#else
            Data_To_Host2(0x00);
#endif
			//ACPI_Gen_Int();
			/* case: 0x09: */
	        trace1(0, ESPI_PC, 0, "ESPI_ACPI_Cmd: TGL 0x09 return 4th Byte = %02Xh", 0x94);
			break;

		case 0x0A:                
	        while(Output_Buffer2_Full())
			{
			}
			/* Get switch status */
			/* bit5=0, undocked; bit4=1, AC powered; bit2=0, NMI jumpr is ON; bit1=0, virtual batt status; bit0=0, lid switch is open */
			value_tmp = 0x10;
            Data_To_Host2(value_tmp);
			//ACPI_Gen_Int();
			break;

		case 0x0D:                
	        while(Output_Buffer2_Full())
			{
			}
#if 1
/* TGL porting */

            Data_To_Host2(0xF8);
            //Data_To_Host2(0x01);
	        trace1(0, ESPI_PC, 0, "ESPI_ACPI_Cmd: TGL 0x0D return FAB ID = %02Xh", 0xF8);
#else
#if (KBL_SUPPORTED == ON)
/* ON: support KabyLake platform */

            Data_To_Host2(0xC0);
#else
/* Skylake platform */

            Data_To_Host2(0x02);
#endif
#endif
			//ACPI_Gen_Int();

	        while(Output_Buffer2_Full())
			{
			}
#if 1
/* TGL porting */

            Data_To_Host2(0x01);
	        trace1(0, ESPI_PC, 0, "ESPI_ACPI_Cmd: TGL 0x0D return BRD ID = %02Xh", 0x01);
#else
            Data_To_Host2(0x04);
#endif
			//ACPI_Gen_Int();
			break;

		case 0x0E:     
			/* have one parameter */
			Cmd_Byte2 = command_num;  /* Signal to wait for value from Host. */
			break;

#if 1
/* TGL porting */

		case 0x13:     
			/* have one parameter */
			Cmd_Byte2 = command_num;  /* Signal to wait for value from Host. */
			break;
#endif

#if (KBL_SUPPORTED == ON)
/* ON: support KabyLake platform */

		case 0x1A:      
            /* PWMUpdate: PWM value is in EC space */
	        /* need to do here to process PWM update */
	        trace1(0, ESPI_PC, 0, "ESPI_ACPI_Cmd: KBL 0x1A PWMUpdate = %02Xh", command_num);
			break;

		case 0x1B:      
            /* get PMIC vendor ID */
	        while(Output_Buffer2_Full())
			{
			}
            Data_To_Host2(0x1F);
	        trace1(0, ESPI_PC, 0, "ESPI_ACPI_Cmd: KBL 0x1B return PMIC Vendor ID to host = %02Xh", 0x1F);
			break;

		case 0x1C:     
			/* have one parameter */
			Cmd_Byte2 = command_num;  /* Signal to wait for value from Host. */
	        trace1(0, ESPI_PC, 0, "ESPI_ACPI_Cmd: KBL 0x1C, a parameter from host, Cmd_Byte2 = %02Xh", Cmd_Byte2);
			break;

		case 0xB0:               
            /* BIOS guard cmd */
	        while(Output_Buffer2_Full())
			{
			}
            Data_To_Host2(0x00);
	        trace1(0, ESPI_PC, 0, "ESPI_ACPI_Cmd: KBL 0xB0 return (can be disabled from BIOS menu) = %02Xh", 0x00);
			break;
#endif

		case 0x23:     
			break;

		case 0x27:     
			/* have one parameter */
			Cmd_Byte2 = command_num;  /* Signal to wait for value from Host. */
			break;

		case 0x29:     
			/* have one parameter */
			Cmd_Byte2 = command_num;  /* Signal to wait for value from Host. */
			break;

		case 0x2D:     
#if 0
/* TGL porting */

	        while(Output_Buffer2_Full())
			{
			}
			/* 1st byte: "K" */
            Data_To_Host2(0x4b);
			//ACPI_Gen_Int();
	        trace1(0, ESPI_PC, 0, "ESPI_ACPI_Cmd: TGL 0x2D return K = %02Xh", 0x4B);

	        while(Output_Buffer2_Full())
			{
			}
			/* 2nd byte: "S" */
            Data_To_Host2(0x53);
			//ACPI_Gen_Int();
	        trace1(0, ESPI_PC, 0, "ESPI_ACPI_Cmd: TGL 0x2D return S = %02Xh", 0x53);

	        while(Output_Buffer2_Full())
			{
			}
			/* 3rd byte: "C" */
            Data_To_Host2(0x43);
			//ACPI_Gen_Int();
	        trace1(0, ESPI_PC, 0, "ESPI_ACPI_Cmd: TGL 0x2D return C = %02Xh", 0x43);

	        while(Output_Buffer2_Full())
			{
			}
			/* 4th byte: 0 */
            Data_To_Host2(0x94);
			//ACPI_Gen_Int();
	        trace1(0, ESPI_PC, 0, "ESPI_ACPI_Cmd: TGL 0x2D return 4th Byte = %02Xh", 0x94);
			/* case: 0x2D: */
#endif
			break;

		case 0x2E:     
			break;

		case 0x2F:     
			break;

#if 1
/* TGL porting */

		case 0x39:     
			/* have one parameter */
			Cmd_Byte2 = command_num;  /* Signal to wait for value from Host. */
			break;
#endif

		case 0x46:     
			break;

		case 0x4B:     
			break;

		case 0x4D:     
			/* have one parameter */
			Cmd_Byte2 = command_num;  /* Signal to wait for value from Host. */
			break;

		case 0x58:     
			/* have one parameter */
			Cmd_Byte2 = command_num;  /* Signal to wait for value from Host. */
			break;

		case 0x64:     
			break;

		case 0x70:     
			/* SMI Query */
//			value2 = Pc_Cmd8(0x92);
			value2 = 0;
			trace1(0, ESPI_PC, 0, "ESPI_ACPI_Cmd: SMI cause code  = %04Xh", value2);
			if(value2 != (WORD) ~0)
			{
				while(Output_Buffer2_Full())
				{
				}
				/* send SMI cause code to host */
				Data_To_Host2((BYTE)value2);
			}
			break;

#if 1
/* processed in Insyde ACPI cmd/data */
		case 0x80:     
			/* Generate interrupt to signal the Host that the
            command has been taken and more value can be sent. */
			ACPI_Gen_Int();

			/* have one parameter */
			Cmd_Byte2 = command_num;  /* Signal to wait for value from Host. */
			break;

		case 0x81:     
			/* Generate interrupt to signal the Host that the
            command has been taken and more value can be sent. */
			ACPI_Gen_Int();

			/* have 2 parameter2 */
			Cmd_Byte2 = command_num;  /* Signal to wait for value from Host. */
			break;

		case 0x82:     
			/* Set Burst bit in secondary Host interface status register. */
//			Write_Host_Status_Reg2(Read_Host_Status_Reg2() |
//								   maskSTATUS_PORT2_BURST);
			while(Output_Buffer2_Full())
			{
			}
			/* enable burst mode */
			value_tmp = 0x90;
            Data_To_Host2(value_tmp);
			ACPI_Gen_Int();
			break;

		case 0x83:     
			/* Clear Burst bit in secondary Host interface status register. */
//			Write_Host_Status_Reg2(Read_Host_Status_Reg2() &
//                                   ~maskSTATUS_PORT2_BURST);
			/* disable burst mode */
			ACPI_Gen_Int();
			break;
#endif

		case 0x8A:     
	        while(Output_Buffer2_Full())
			{
			}
			/* Get switch status - dock status, =1, docked; =0, undocked */
			value_tmp = 0x00;
            Data_To_Host2(value_tmp);
	        trace1(0, ESPI_PC, 0, "ESPI_ACPI_Cmd: TGL 0x8A return SW sts - undocked = %02Xh", value_tmp);
			//ACPI_Gen_Int();
			break;
			
		case 0x90:                
	        while(Output_Buffer2_Full())
			{
			}
#if 1
/* TGL porting */

			/* 1st byte: FW revision - major */
            Data_To_Host2(0x01);
#else
            Data_To_Host2(BUILDNUMBER >> 8);
#endif
	        trace1(0, ESPI_PC, 0, "ESPI_ACPI_Cmd: TGL 0x90 return FW Rev major = %02Xh", 0x01);
			//ACPI_Gen_Int();

	        while(Output_Buffer2_Full())
			{
			}
			/* 2nd byte: FW revision - minor */
#if 1
/* TGL porting */

            Data_To_Host2(0x10);
#else
            Data_To_Host2(BUILDNUMBER & 0x00FF);
#endif
	        trace1(0, ESPI_PC, 0, "ESPI_ACPI_Cmd: TGL 0x90 return FW Rev minor = %02Xh", 0x10);
			//ACPI_Gen_Int();
			/* case: 0x90: */
			break;

		case 0xAA:     
			/* enable ACPI mode */
			Ext_Cb3_ACPI_ENABLED = 1;
			break;

		case 0xAB:     
			/* disable ACPI mode, back to APM mode */
			Ext_Cb3_ACPI_ENABLED = 0;
			break;

		case 0xBC:     
			/* disable SMIs */
			break;
			
 		case 0xBD:     
			/* enable SMIs */
			break;

#if 1
/* TGL porting */

		case 0xDF:     
			/* have one parameter */
			Cmd_Byte2 = command_num;  /* Signal to wait for value from Host. */
			break;

		case 0xE1:     
			break;

		case 0xF3:     
			/* have one parameter */
			Cmd_Byte2 = command_num;  /* Signal to wait for value from Host. */
			break;
#endif

#if (ESPI_OOB_FC_TEST == ON)
/* Support MEC14xx ESPI OOB & FC TX & RX */

		case 0xF1:     
			trace0(0, ESPI_PC, 0, "ESPI_ACPI_Cmd: rx MCHP PE command 0xF1.");
			/* write memory: have 9 parameters */
			Cmd_Byte2 = command_num;  /* Signal to wait for value from Host. */
			break;

		case 0xF2:     
			trace0(0, ESPI_PC, 0, "ESPI_ACPI_Cmd: rx MCHP PE command 0xF2.");
			/* read memory: have 5 parameters */
			Cmd_Byte2 = command_num;  /* Signal to wait for value from Host. */
			break;
#endif

       default:
			trace1(0, ESPI_PC, 0, "ESPI_ACPI_Cmd: oop??? unsupported cmd, command_num  = %02Xh", command_num);
			//while(1);
            break;
	} /* switch(command_num) */
}

/******************************************************************************/
/** ESPI_Srvc_Pcdat2
 * Process ACPI commands with parameters
 *
 * @param None
 *
 * @return None
 *
 ******************************************************************************/
void ESPI_Srvc_Pcdat2(BYTE value)
{
	BYTE value_tmp;

	trace1(0, ESPI_PC, 0, "ESPI_Srvc_Pcdat2: command: Cmd_Byte2 = %02Xh", Cmd_Byte2);
	trace1(0, ESPI_PC, 0, "ESPI_Srvc_Pcdat2: data: value = %02Xh", value);
	switch(Cmd_Byte2)
	{
		case 0x0E:     
			/* value is to select AON or ALS */
			/* need to add app code here... */
			value_tmp = value;
			Cmd_Byte2 = 0;
			break;

#if 1
/* TGL porting */

		case 0x13:     
			/* value is the set deep sleep mode */
			/* need to add app code here... */
			value_tmp = value;
	        trace1(0, ESPI_PC, 0, "ESPI_Srvc_Pcdat2: TGL CMD 0x13 data: value_tmp = %02Xh", value_tmp);
			Cmd_Byte2 = 0;
			break;
#endif

#if (KBL_SUPPORTED == ON)
/* ON: support KabyLake platform */

		case 0x1C:     
			/* value is ??? not in spec. */
			/* need to add app code here... */
			value_tmp = value;
	        trace1(0, ESPI_PC, 0, "ESPI_ACPI_Cmd: KBL 0x1C's parameter from host = %02Xh", value_tmp);
			Cmd_Byte2 = 0;
			break;
#endif

		case 0x27:     
			/* value is to enable low power mode: =1, enable; =0, disable */
			/* need to add app code here... */
			value_tmp = value;
			Cmd_Byte2 = 0;
			break;

		case 0x29:     
			/* value is the set deep sleep mode */
			/* need to add app code here... */
			value_tmp = value;
			Cmd_Byte2 = 0;
			break;

#if 1
/* TGL porting */

		case 0x39:     
			/* value is the set deep sleep mode */
			/* need to add app code here... */
			value_tmp = value;
	        trace1(0, ESPI_PC, 0, "ESPI_Srvc_Pcdat2: TGL CMD 0x39 data: value_tmp = %02Xh", value_tmp);
			Cmd_Byte2 = 0;
			break;
#endif

		case 0x58:     
			/* value is the vritical temperature threshold */
			/* need to add app code here... */
			value_tmp = value;
			Cmd_Byte2 = 0;
			break;

		case 0x4D:     
			/* value is the set PECI injected temperature */
			/* need to add app code here... */
			value_tmp = value;
			Cmd_Byte2 = 0;
			break;

#if 1
/* processed in Insyde ACPI cmd/data */
		case 0x80:     // read
			/* Generate interrupt to signal the Host that the
            data has been taken and more value can be sent. */
			ACPI_Gen_Int();
			/* value is the ACPI space index */
			value_tmp = espi_acpi_ec_space[value];
	        while(Output_Buffer2_Full())
			{
			}
            Data_To_Host2(value_tmp);
			ACPI_Gen_Int();
			Cmd_Byte2 = 0;
			break;

		case 0x81:     // wr
			/* Generate interrupt to signal the Host that the
            data has been taken and more value can be sent. */
			ACPI_Gen_Int();
			/* process 2 parameters */
			if(Tmp_Load2 == 0) 
			{
				/* Just received 1st address byte (index) from Host. */
				Tmp_Load2++;             /* Increment value byte counter. */
				EC_Addr = value;         /* Store address byte. */
			}
			else if(Tmp_Load2 == 1) 
			{
				/* Just received 2nd data byte from Host. */
				/* need to add app code here... */
				espi_acpi_ec_space[EC_Addr] = value;     
				Cmd_Byte2 = 0;
				Tmp_Load2 = 0;
			}
			break;
#endif

#if (ESPI_OOB_FC_TEST == ON)
/* Support MEC14xx ESPI OOB & FC TX & RX */

		case 0xF1:     
			trace0(0, ESPI_PC, 0, "ESPI_Srvc_Pcdat2: rx MCHP PE command 0xF1's data.");
			/* write memory: have 9 parameters */
			ESPI_write_mem_0xF1(value);
			break;

		case 0xF2:     
			trace0(0, ESPI_PC, 0, "ESPI_Srvc_Pcdat2: rx MCHP PE command 0xF2's data.");
			/* read memory: have 5 parameters */
			ESPI_read_mem_0xF2(value);
			break;
#endif

#if 1
/* TGL porting */

		case 0xDF:     
			/* function is ... */
			/* need to add app code here... */
			value_tmp = value;
	        trace1(0, ESPI_PC, 0, "ESPI_Srvc_Pcdat2: TGL CMD 0xDF data: value_tmp = %02Xh", value_tmp);
			Cmd_Byte2 = 0;
			break;

		case 0xF3:     
			/* function is ... */
			/* need to add app code here... */
			value_tmp = value;
	        trace1(0, ESPI_PC, 0, "ESPI_Srvc_Pcdat2: TGL CMD 0xF3 data: value_tmp = %02Xh", value_tmp);
			Cmd_Byte2 = 0;
			break;
#endif

        default:
			trace1(0, ESPI_PC, 0, "ESPI_Srvc_Pcdat2: oop??? unsupported cmd with parameter, Cmd_Byte2  = %02Xh", Cmd_Byte2);
			//LOG_INF("Dat2, unsupported Cmd_Byte2=0x%02x", Cmd_Byte2);
			//while(1);
            break;
	} /* switch(Cmd_Byte2) */
}

/**   @}
 */
```
