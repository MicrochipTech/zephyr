## CMakeLists.txt
```
# SPDX-License-Identifier: Apache-2.0

cmake_minimum_required(VERSION 3.13.1)
find_package(Zephyr REQUIRED HINTS $ENV{ZEPHYR_BASE})
project(saf_demo)

FILE(GLOB app_sources src/*.c)
target_sources(app PRIVATE ${app_sources})

#zephyr_compile_options(-Werror)
```

## sample.yaml
```
sample:
  name: MEC15xx modular board sample saf demo
tests:
  sample.board.mec1501modular_assy6885:
    platform_whitelist: mec1501modular_assy6885
    tags: board
```

## prj.conf
```kconfig
# Enable config log
CONFIG_LOG=y
CONFIG_LOG_PRINTK=y
CONFIG_SPI=y
CONFIG_ESPI_SAF=y
CONFIG_ESPI_FLASH_CHANNEL=y
CONFIG_SPI_LOG_LEVEL_DBG=y
CONFIG_ESPI_LOG_LEVEL_DBG=y
CONFIG_LOG_BUFFER_SIZE=8096

# Logging thread frequency higher than CONFIG_SYS_PM_MIN_RESIDENCY_DEEP_SLEEP_1
CONFIG_LOG_PROCESS_THREAD_SLEEP_MS=100

CONFIG_THREAD_NAME=y
```

## boards/mec1501modular_assy6885.overlay
```dts
/*
 * Copyright (c) 2020 Intel Corporation
 *
 * SPDX-License-Identifier: Apache-2.0
 */

/ {
	resources {
		compatible = "microchip,mec15xx-saf";
		/* MCHP_GPIO_012 */
		pwrg-gpios = <&gpio_000_036 10 GPIO_ACTIVE_HIGH>;
		/* MCHP_GPIO_0054 */
		rsm-gpios = <&gpio_040_076 12 GPIO_ACTIVE_HIGH>;
	};
};
```

## dts/bindings/mec15xx-saf.yaml
```yaml
# Copyright (c) 2020, Intel Corporation
# SPDX-License-Identifier: Apache-2.0

compatible: "microchip,mec15xx-saf"

description: |
    This binding provides MEC15xx board gpio power rails resources to
    build and run samples/board/mec15xx/saf in Zephyr.
    It does describe GPIOs required before performing a host-slave handshake
    and all SAF related parameters

properties:
   pwrg-gpios:
        type: phandle-array
        required: true
        description: |
          Board GPIO input used to detect that power rails are stable.

   rsm-gpios:
        type: phandle-array
        required: true
        description: |
          Board GPIO output used to notify eSPI master to ackwnowledge
          power has stabilized and bare minimum initialization in eSPI slave
          is complete so eSPI master can proceed with eSPI handshake.
```

## src/main.c
```c
/*
 * Copyright (c) 2020 Intel Corporation
 *
 * SPDX-License-Identifier: Apache-2.0
 */

#include <errno.h>
#include <zephyr.h>
#include <device.h>
#include <soc.h>
#include <drivers/gpio.h>
#include <drivers/espi.h>
#include <drivers/espi_saf.h>
#include <logging/log_ctrl.h>
#include <logging/log.h>
/* TODO: Add its own log level */
LOG_MODULE_REGISTER(saf_demo, CONFIG_ESPI_LOG_LEVEL);
#include "spi_flash_config.h"

/* SPI flash parameters */
#define MAX_TEST_BUF_SIZE     1024u
#define MAX_FLASH_REQUEST     64u
#define TARGET_FLASH_REGION   0x72000ul

/* 20 MHz */
#define MIN_ESPI_FREQ         20u
#define MAX_ESPI_FREQ         66u

/* 24 MHz */
#define WIN_SPI_FREQ          24u

#define K_WAIT_DELAY          100u

/* eSPI event */
#define EVENT_MASK            0x0000FFFFu
#define EVENT_DETAILS_MASK    0xFFFF0000u
#define EVENT_DETAILS_POS     16u
#define EVENT_TYPE(x)         (x & EVENT_MASK)
#define EVENT_DETAILS(x)      ((x & EVENT_DETAILS_MASK) >> EVENT_DETAILS_POS)

#define PWR_SEQ_TIMEOUT    3000u

/* The devicetree node identifier for the board power rails pins. */
#define SAF_CFG_NODE DT_INST(0, microchip_mec15xx_saf)

#if DT_NODE_HAS_STATUS(SAF_CFG_NODE, okay)
#define SAF_CFG_PWRGD           DT_GPIO_LABEL(SAF_CFG_NODE, pwrg_gpios)
#define SAF_CFG_RSMRST          DT_GPIO_LABEL(SAF_CFG_NODE, rsm_gpios)
#define SAF_CFG_RSMRST_PIN      DT_GPIO_PIN(SAF_CFG_NODE, rsm_gpios)
#define SAF_CFG_PWRGD_PIN       DT_GPIO_PIN(SAF_CFG_NODE, pwrg_gpios)

static struct device *pwrgd_dev;
static struct device *rsm_dev;
#endif

#define ESPI_DEVNAME      DT_LABEL(DT_NODELABEL(espi0))
#define SAF_DEVNAME       DT_LABEL(DT_NODELABEL(espi_saf0))

static struct device *espi_dev;
static struct espi_callback espi_bus_cb;
static struct espi_callback vw_rdy_cb;
static struct espi_callback vw_cb;
static struct espi_callback p80_cb;

#ifdef CONFIG_ESPI_SAF
static struct device *saf_dev;
#endif

static uint8_t espi_rst_sts;

#ifdef CONFIG_ESPI_FLASH_CHANNEL
static uint8_t flash_write_buf[MAX_TEST_BUF_SIZE];
static uint8_t flash_read_buf[MAX_TEST_BUF_SIZE];
#endif

/* TODO: Use espihub */
static void host_warn_handler(uint32_t signal, uint32_t status)
{
	switch (signal) {
	case ESPI_VWIRE_SIGNAL_HOST_RST_WARN:
		LOG_INF("Host reset warning %d", status);
		if (!IS_ENABLED(CONFIG_ESPI_AUTOMATIC_WARNING_ACKNOWLEDGE)) {
			LOG_INF("HOST RST ACK %d", status);
			espi_send_vwire(espi_dev,
					ESPI_VWIRE_SIGNAL_HOST_RST_ACK,
					status);
		}
		break;
	case ESPI_VWIRE_SIGNAL_SUS_WARN:
		LOG_INF("Host suspend warning %d", status);
		if (!IS_ENABLED(CONFIG_ESPI_AUTOMATIC_WARNING_ACKNOWLEDGE)) {
			LOG_INF("SUS ACK %d", status);
			espi_send_vwire(espi_dev, ESPI_VWIRE_SIGNAL_SUS_ACK,
					status);
		}
		break;
	default:
		break;
	}
}

/* eSPI bus event handler */
static void espi_reset_handler(struct device *dev,
			       struct espi_callback *cb,
			       struct espi_event event)
{
	if (event.evt_type == ESPI_BUS_RESET) {
		espi_rst_sts = event.evt_data;
		LOG_INF("eSPI BUS reset %d", event.evt_data);
	}
}

/* eSPI logical channels enable/disable event handler */
static void espi_ch_handler(struct device *dev, struct espi_callback *cb,
			    struct espi_event event)
{
	if (event.evt_type == ESPI_BUS_EVENT_CHANNEL_READY) {
		if (event.evt_details == ESPI_CHANNEL_VWIRE) {
			LOG_INF("VW channel is ready");
		} else if (event.evt_details == ESPI_CHANNEL_FLASH) {
			LOG_INF("Flash channel is ready");
		}
	}
}

/* eSPI vwire received event handler */
static void vwire_handler(struct device *dev, struct espi_callback *cb,
			  struct espi_event event)
{
	if (event.evt_type == ESPI_BUS_EVENT_VWIRE_RECEIVED) {
		switch (event.evt_details) {
		case ESPI_VWIRE_SIGNAL_PLTRST:
			LOG_INF("PLT_RST changed %d", event.evt_data);
			break;
		case ESPI_VWIRE_SIGNAL_SLP_S3:
		case ESPI_VWIRE_SIGNAL_SLP_S4:
		case ESPI_VWIRE_SIGNAL_SLP_S5:
			LOG_INF("SLP signal changed %d", event.evt_data);
			break;
		case ESPI_VWIRE_SIGNAL_SUS_WARN:
		case ESPI_VWIRE_SIGNAL_HOST_RST_WARN:
			host_warn_handler(event.evt_details,
					      event.evt_data);
			break;
		}
	}
}

/* eSPI peripheral channel notifications handler */
static void periph_handler(struct device *dev, struct espi_callback *cb,
			   struct espi_event event)
{
	uint8_t periph_type;
	uint8_t periph_index;

	periph_type = EVENT_TYPE(event.evt_details);
	periph_index = EVENT_DETAILS(event.evt_details);

	switch (periph_type) {
	case ESPI_PERIPHERAL_DEBUG_PORT80:
		LOG_INF("Postcode %x", event.evt_data);
		break;
	case ESPI_PERIPHERAL_HOST_IO:
		LOG_INF("ACPI %x", event.evt_data);
		espi_remove_callback(espi_dev, &p80_cb);
		break;
	default:
		LOG_INF("%s periph 0x%x [%x]", __func__, periph_type,
			event.evt_data);
	}
}

int espi_init(void)
{
	int ret;
	/* Indicate to eSPI master simplest configuration: Single line,
	 * 20MHz frequency and only logical channel 0 and 1 are supported
	 */
	struct espi_cfg cfg = {
		ESPI_IO_MODE_QUAD_LINES,
		ESPI_CHANNEL_VWIRE | ESPI_CHANNEL_PERIPHERAL,
		MAX_ESPI_FREQ,
	};

	/* If eSPI driver supports additional capabilities use them */
#ifdef CONFIG_ESPI_OOB_CHANNEL
	cfg.channel_caps |= ESPI_CHANNEL_OOB;
	LOG_DBG("Request OOB channel");
#endif
#ifdef CONFIG_ESPI_FLASH_CHANNEL
	cfg.channel_caps |= ESPI_CHANNEL_FLASH;
	LOG_DBG("Request flash channel");
#endif

	ret = espi_config(espi_dev, &cfg);
	if (ret) {
		LOG_ERR("Failed to configure eSPI slave channels:%x err: %d",
			cfg.channel_caps, ret);
		return ret;
	}

	LOG_INF("eSPI slave configured successfully!");

	LOG_INF("eSPI test - callbacks initialization... ");
	espi_init_callback(&espi_bus_cb, espi_reset_handler, ESPI_BUS_RESET);
	espi_init_callback(&vw_rdy_cb, espi_ch_handler,
			   ESPI_BUS_EVENT_CHANNEL_READY);
	espi_init_callback(&vw_cb, vwire_handler,
			   ESPI_BUS_EVENT_VWIRE_RECEIVED);
	espi_init_callback(&p80_cb, periph_handler,
			   ESPI_BUS_PERIPHERAL_NOTIFICATION);
	LOG_INF("complete");

	LOG_INF("eSPI test - callbacks registration... ");
	espi_add_callback(espi_dev, &espi_bus_cb);
	espi_add_callback(espi_dev, &vw_rdy_cb);
	espi_add_callback(espi_dev, &vw_cb);
	espi_add_callback(espi_dev, &p80_cb);
	LOG_INF("complete");

	return ret;
}

#if DT_NODE_HAS_STATUS(SAF_CFG_NODE, okay)
static int wait_for_pin(struct device *dev, uint8_t pin, uint16_t timeout,
			int exp_level)
{
	uint16_t loop_cnt = timeout;
	int level;

	do {
		level = gpio_pin_get(dev, pin);
		if (level < 0) {
			LOG_ERR("Failed to read %x %d", pin, level);
			return -EIO;
		}

		if (exp_level == level) {
			LOG_DBG("PIN %x = %x", pin, exp_level);
			break;
		}

		k_usleep(K_WAIT_DELAY);
		loop_cnt--;
	} while (loop_cnt > 0);

	if (loop_cnt == 0) {
		LOG_ERR("Timeout for %x %x", pin, level);
		return -ETIMEDOUT;
	}

	return 0;
}
#endif

static int wait_for_vwire(struct device *espi_dev,
			  enum espi_vwire_signal signal,
			  uint16_t timeout, uint8_t exp_level)
{
	int ret;
	uint8_t level;
	uint16_t loop_cnt = timeout;

	do {
		ret = espi_receive_vwire(espi_dev, signal, &level);
		if (ret) {
			LOG_ERR("Failed to read %x %d", signal, ret);
			return -EIO;
		}

		if (exp_level == level) {
			break;
		}

		k_usleep(K_WAIT_DELAY);
		loop_cnt--;
	} while (loop_cnt > 0);

	if (loop_cnt == 0) {
		LOG_ERR("VWIRE %d is %x", signal, level);
		return -ETIMEDOUT;
	}

	return 0;
}

static int wait_for_espi_reset(uint8_t exp_sts)
{
	uint16_t loop_cnt = CONFIG_ESPI_VIRTUAL_WIRE_TIMEOUT;

	do {
		if (exp_sts == espi_rst_sts) {
			break;
		}
		k_usleep(K_WAIT_DELAY);
		loop_cnt--;
	} while (loop_cnt > 0);

	if (loop_cnt == 0) {
		return -ETIMEDOUT;
	}

	return 0;
}

int espi_handshake(void)
{
	int ret;

	LOG_INF("eSPI test - Handshake with eSPI master...");
	ret = wait_for_vwire(espi_dev, ESPI_VWIRE_SIGNAL_SUS_WARN,
			     CONFIG_ESPI_VIRTUAL_WIRE_TIMEOUT, 1);
	if (ret) {
		LOG_ERR("SUS_WARN Timeout");
		return ret;
	}

	LOG_INF("1st phase completed");
	ret = wait_for_vwire(espi_dev, ESPI_VWIRE_SIGNAL_SLP_S5,
			     CONFIG_ESPI_VIRTUAL_WIRE_TIMEOUT, 1);
	if (ret) {
		LOG_ERR("SLP_S5 Timeout");
		return ret;
	}

	ret = wait_for_vwire(espi_dev, ESPI_VWIRE_SIGNAL_SLP_S4,
			     CONFIG_ESPI_VIRTUAL_WIRE_TIMEOUT, 1);
	if (ret) {
		LOG_ERR("SLP_S4 Timeout");
		return ret;
	}

	ret = wait_for_vwire(espi_dev, ESPI_VWIRE_SIGNAL_SLP_S3,
			     CONFIG_ESPI_VIRTUAL_WIRE_TIMEOUT, 1);
	if (ret) {
		LOG_ERR("SLP_S3 Timeout");
		return ret;
	}

	LOG_INF("2nd phase completed");

	ret = wait_for_vwire(espi_dev, ESPI_VWIRE_SIGNAL_PLTRST,
			     CONFIG_ESPI_VIRTUAL_WIRE_TIMEOUT, 1);
	if (ret) {
		LOG_ERR("PLT_RST Timeout");
		return ret;
	}

	LOG_INF("3rd phase completed");

	return 0;
}

#ifdef CONFIG_ESPI_FLASH_CHANNEL
int read_test_block(uint8_t *buf, uint32_t start_flash_adr, uint16_t block_len)
{
	uint8_t i = 0;
	uint32_t flash_addr = start_flash_adr;
	uint16_t transactions = block_len/MAX_FLASH_REQUEST;
	int ret = 0;
#ifdef CONFIG_ESPI_SAF
	struct espi_saf_packet pckt;
#else
	struct espi_flash_packet pckt;
#endif

	for (i = 0; i < transactions; i++) {
		pckt.buf = buf;
		pckt.flash_addr = flash_addr;
		pckt.len = MAX_FLASH_REQUEST;
#ifdef CONFIG_ESPI_SAF
		ret = espi_saf_flash_read(saf_dev, &pckt);
#else
		ret = espi_read_flash(espi_dev, &pckt);
#endif
		if (ret) {
			LOG_ERR("espi_read_flash failed: %d", ret);
			return ret;
		}

		buf += MAX_FLASH_REQUEST;
		flash_addr += MAX_FLASH_REQUEST;
	}

	LOG_INF("%d read flash transactions completed", transactions);
	return 0;
}

int write_test_block(uint8_t *buf, uint32_t start_flash_adr, uint16_t block_len)
{
	uint8_t i = 0;
	uint32_t flash_addr = start_flash_adr;
	uint16_t transactions = block_len/MAX_FLASH_REQUEST;
	int ret = 0;
	struct espi_flash_packet pckt;

	/* Split operation in multiple MAX_FLASH_REQ transactions */
	for (i = 0; i < transactions; i++) {
		pckt.buf = buf;
		pckt.flash_addr = flash_addr;
		pckt.len = MAX_FLASH_REQUEST;

#ifdef CONFIG_ESPI_SAF
		ret = espi_saf_flash_write(saf_dev, &pckt);
#else
		ret = espi_write_flash(espi_dev, &pckt);
#endif
		if (ret) {
			LOG_ERR("espi_write_flash failed: %d", ret);
			return ret;
		}

		buf += MAX_FLASH_REQUEST;
		flash_addr += MAX_FLASH_REQUEST;
	}

	LOG_INF("%d write flash transactions completed", transactions);
	return 0;
}

static int espi_flash_test(uint32_t start_flash_addr, uint8_t blocks)
{
	uint8_t i;
	uint8_t pattern;
	uint32_t flash_addr;
	int ret = 0;

	LOG_INF("Test eSPI write flash");
	flash_addr = start_flash_addr;
	pattern = 0x99;
	for (i = 0; i <= blocks; i++) {
		memset(flash_write_buf, pattern++, sizeof(flash_write_buf));
		ret = write_test_block(flash_write_buf, flash_addr,
				       sizeof(flash_write_buf));
		if (ret) {
			LOG_ERR("Failed to write to eSPI");
			return ret;
		}

		flash_addr += sizeof(flash_write_buf);
	}

	LOG_INF("Test eSPI read flash");
	flash_addr = start_flash_addr;
	pattern = 0x99;
	for (i = 0; i <= blocks; i++) {
		/* Set expected content */
		memset(flash_write_buf, pattern, sizeof(flash_write_buf));
		/* Clear last read content */
		memset(flash_read_buf, 0, sizeof(flash_read_buf));
		ret = read_test_block(flash_read_buf, flash_addr,
				      sizeof(flash_read_buf));
		if (ret) {
			LOG_ERR("Failed to read from eSPI");
			return ret;
		}

		/* Compare buffers  */
		int cmp = memcmp(flash_write_buf, flash_read_buf,
				 sizeof(flash_write_buf));

		if (cmp != 0) {
			LOG_ERR("eSPI read mismmatch at %d expected %x",
				cmp, pattern);
		}

		flash_addr += sizeof(flash_read_buf);
		pattern++;
	}

	return 0;
}
#endif /* CONFIG_ESPI_FLASH_CHANNEL */

int saf_demo(void)
{
	int ret;

	/* Account for the time serial port is detected so log messages can
	 * be seen
	 */
	k_sleep(K_SECONDS(2));
	LOG_DBG("Helow");

#if DT_NODE_HAS_STATUS(SAF_CFG_NODE, okay)
	pwrgd_dev = device_get_binding(SAF_CFG_PWRGD);
	if (!pwrgd_dev) {
		LOG_WRN("%s not found", SAF_CFG_PWRGD);
		return -1;
	}

	LOG_DBG("%s ", SAF_CFG_PWRGD);

	rsm_dev = device_get_binding(SAF_CFG_RSMRST);
	if (!rsm_dev) {
		LOG_WRN("%s not found", SAF_CFG_RSMRST);
		return -1;
	}

	LOG_DBG("%s ", SAF_CFG_RSMRST);
#endif

#ifdef CONFIG_ESPI_SAF
	saf_dev = device_get_binding(SAF_DEVNAME);
	if (!saf_dev) {
		LOG_WRN("Fail to find %s", SAF_DEVNAME);
		return -1;
	}
	LOG_DBG("SAF binding %s", SAF_DEVNAME);
#endif

	espi_dev = device_get_binding(ESPI_DEVNAME);
	if (!espi_dev) {
		LOG_WRN("Fail to find %s", ESPI_DEVNAME);
		return -1;
	}

	LOG_INF("SAF demo %s", CONFIG_BOARD);

#if DT_NODE_HAS_STATUS(SAF_CFG_NODE, okay)
	ret = gpio_pin_configure(pwrgd_dev, SAF_CFG_PWRGD_PIN,
				 GPIO_INPUT | GPIO_ACTIVE_HIGH);
	if (ret) {
		LOG_ERR("Unable to configure %d:%d",
			SAF_CFG_PWRGD_PIN, ret);
		return ret;
	}

	ret = gpio_pin_configure(rsm_dev, SAF_CFG_RSMRST_PIN,
				 GPIO_OUTPUT | GPIO_ACTIVE_HIGH);
	if (ret) {
		LOG_ERR("Unable to config %d: %d",
			SAF_CFG_RSMRST_PIN, ret);
		return ret;
	}

	ret = gpio_pin_set(rsm_dev, SAF_CFG_RSMRST_PIN, 0);
	if (ret) {
		LOG_ERR("Unable to initialize %d",
			SAF_CFG_RSMRST_PIN);
		return -1;
	}
#endif

	espi_init();

#if DT_NODE_HAS_STATUS(SAF_CFG_NODE, okay)
	ret = wait_for_pin(pwrgd_dev, SAF_CFG_PWRGD_PIN,
			   PWR_SEQ_TIMEOUT, 1);
	if (ret) {
		LOG_ERR("RSMRST_PWRGD timeout");
		return ret;
	}
#endif

#ifdef CONFIG_ESPI_SAF
	/* TODO: On new driver version
	 * need to set tags, descriptors, opcode, etc
	 */
	bool saf_ready;

	struct espi_saf_cfg cfg = {
		.spi_freq = WIN_SPI_FREQ,
	};

	/* Before RSMRST is de-asserted need to initialize SPI in Quad */
	ret = qspi_init();
	if (ret) {
		LOG_ERR("Fail to init SPI flash device: %d", ret);
		return ret;
	}

	uint8_t x[2];
	uint8_t sts1[] = { 0x05, 0xFF };
	uint8_t sts2[] = { 0x35, 0xFF };
	uint8_t rst[] = { 0x66, 0x98, 0x17 };
#ifdef ENABLE_RESET
	uint8_t rst_e[] = { 0xAB };
#endif
	uint8_t sp_sts[] = { 0x5A, 0, 0, 0xc, 0xff, 0xff };

	qspi_send(sts1, 2);
	qspi_rcv(x, 2);
	qspi_send(sts2, 2);
	qspi_rcv(x, 2);
	qspi_send(rst, 3);
	qspi_clear_status();

	qspi_send(sts1, 2);
	qspi_rcv(x, 2);
	qspi_send(sts1, 2);
	qspi_rcv(x, 2);

	qspi_send(sp_sts, 6);
	qspi_clear_status();
	qspi_exit_continuous_mode(0);
	qspi_exit_continuous_mode(0);
	ret = qspi_reset_spi_flash_device(0);
	if (ret) {
		LOG_ERR("Fail to reset SPI flash device: %d", ret);
		return ret;
	}

	k_sleep(K_SECONDS(1));

	ret = espi_saf_config(saf_dev, &cfg);
	if (ret) {
		LOG_ERR("SAF configuration failed: %d", ret);
		return ret;
	}

	LOG_WRN("SAF configuration successful");
#endif

#ifdef CONFIG_ESPI_SAF
	espi_saf_activate(saf_dev);
#endif

#if DT_NODE_HAS_STATUS(SAF_CFG_NODE, okay)
	LOG_DBG("Set pin %x", SAF_CFG_RSMRST_PIN);
	ret = gpio_pin_set(rsm_dev, SAF_CFG_RSMRST_PIN, 1);
	if (ret) {
		LOG_ERR("Failed to set rsm err: %d", ret);
		return ret;
	}
#endif
	ret = wait_for_espi_reset(1);
	if (ret) {
		LOG_INF("ESPI_RESET timeout");
		return ret;
	}

	/* Flash operation need to be perform before VW handshake or
	 * after eSPI host completes full initialization.
	 * This sample code can't assume a full initialized eSPI host
	 * so flash operations are perform here.
	 */
	bool flash_sts;

	do {
		flash_sts = espi_get_channel_status(espi_dev,
						    ESPI_CHANNEL_FLASH);
		k_busy_wait(100);
	} while (!flash_sts);

#ifdef CONFIG_ESPI_SAF
	LOG_DBG("Check if SAF channel is getting disabled");
	saf_ready = espi_saf_get_channel_status(saf_dev);
	if (!saf_ready) {
		LOG_ERR("SAF channel not ready");
	} else {
		LOG_DBG("SAF channel ready");
	}
	/* read_test_block(flash_read_buf, 0x10, 0x64); */
#endif

	/* Showcase VW channel by exchanging virtual wires with eSPI host */
	ret = espi_handshake();
	if (ret) {
		LOG_ERR("eSPI VW handshake failed %d", ret);
		return ret;
	}

	/* Cleanup */
	k_sleep(K_SECONDS(1));
	espi_remove_callback(espi_dev, &espi_bus_cb);
	espi_remove_callback(espi_dev, &vw_rdy_cb);
	espi_remove_callback(espi_dev, &vw_cb);

	LOG_INF("eSPI sample completed err: %d", ret);

	return ret;
}

void main(void)
{
	saf_demo();
}
```

## src/spi_flash_config.c
```c
/*
 * Copyright (c) 2020 Intel Corporation
 *
 * SPDX-License-Identifier: Apache-2.0
 */

#include <zephyr.h>
#include <device.h>
#include <drivers/spi.h>
#include <soc.h>
#include "spi_flash_config.h"
#include <logging/log.h>
LOG_MODULE_DECLARE(saf_demo, CONFIG_ESPI_LOG_LEVEL);

/* TODO: Remove if identified that all operations are done by QMSPI or SAF
 * drivers
 */
static QMSPI_Type *regs = (QMSPI_Type *)QMSPI_BASE;

/* TODO: Remove since it's already part of saf_qmspi_init */
#define SPI_24MHZ_CLK_DIVIDE  2

#define SPI_DEV      DT_LABEL(DT_NODELABEL(spi0))

static struct device *spi_dev;
static struct spi_config spi_cfg;
#ifdef CONFIG_SPI_USING_DRIVER
static struct spi_buf rx;
const static struct spi_buf_set rx_bufs = {
	.buffers = &rx,
	.count = 1,
};

static struct spi_buf tx;
const static struct spi_buf_set tx_bufs = {
	.buffers = &tx,
	.count = 1,
};
#endif

int qspi_init(void)
{
	LOG_DBG("%s", __func__);
	spi_dev = device_get_binding(SPI_DEV);
	if (!spi_dev) {
		LOG_ERR("Failed to bind %s", SPI_DEV);
		return -1;
	};

	spi_cfg.operation = SPI_WORD_SET(8) | SPI_OP_MODE_MASTER |
			    SPI_LINES_QUAD;
	spi_cfg.frequency = 24000000U;

	return 0;
}

/* Porting of MEC14xx to MEC15xx access HW registers directly */

void qspi_clear_status(void)
{
	LOG_DBG("%s", __func__);
	/* TODO: Can this be done through Zephyr SPI API ? */
	regs->STS = 0xfffffffful;
	regs->MODE =  MCHP_QMSPI_EXE_CLR_FIFOS;
}

void qspi_send(uint8_t *data, uint8_t l)
{
	/* Reset module */
	LOG_DBG("QMSPI mode %x", regs->MODE);
	regs->MODE = MCHP_QMSPI_M_SRST;

	/* Wait until HW clears the bit */
	while (regs->MODE & MCHP_QMSPI_M_SRST) {
	};

	/* Configure SPI clock and SPI slave */
	regs->MODE = SPI_24MHZ_CLK_DIVIDE << MCHP_QMSPI_M_FDIV_POS|
		     0 << MCHP_QMSPI_M_CS_POS | MCHP_QMSPI_M_ACTIVATE;
	LOG_DBG("QMSPI mode %x", regs->MODE);

	regs->CTRL = MCHP_QMSPI_C_XFR_NUNITS(l) |
		     (0 << MCHP_QMSPI_C_DESCR_EN_POS) |
		     MCHP_QMSPI_C_XFR_UNITS_1 |
		     MCHP_QMSPI_C_CLOSE |
		     MCHP_QMSPI_C_RX_EN |
		     MCHP_QMSPI_C_TX_DATA;

	LOG_DBG("QMSPI CTRL %x", regs->CTRL);
	for (int i = 0; i < l; i++) {
		REG8(&regs->TX_FIFO) = data[i];
	}

	/* Finally perform a dummy? operation in quad */
	regs->EXE = 1;
	while (regs->STS & MCHP_QMSPI_STS_TXBF_RO) {
	}

	LOG_DBG("Exit %s", __func__);

}

void qspi_rcv(uint8_t *data, uint8_t len)
{
	for (int i = 0; i < len; i++) {
		data[i] = REG8(&regs->RX_FIFO);
	}
}

void qspi_exit_continuous_mode(uint8_t slave_index)
{
	/* no need to reconfigure gpios in mec15xx baseline */
	LOG_DBG("%s", __func__);

	LOG_DBG("%s CS0 pin control %x", __func__, GPIO_CTRL_REGS->CTRL_0055);
	LOG_DBG("%s CLK pin control %x", __func__, GPIO_CTRL_REGS->CTRL_0056);
	LOG_DBG("%s IO1 pin control %x", __func__, GPIO_CTRL_REGS->CTRL_0224);
	LOG_DBG("%s IO3 pin control %x", __func__, GPIO_CTRL_REGS->CTRL_0016);
	LOG_DBG("%s IO2 pin control %x", __func__, GPIO_CTRL_REGS->CTRL_0227);
	LOG_DBG("%s IO2 pin control %x", __func__, GPIO_CTRL_REGS->CTRL_0223);

	/* Reset module */
	LOG_DBG("QMSPI mode %x", regs->MODE);
	regs->MODE = MCHP_QMSPI_M_SRST;

	/* Wait until HW clears the bit */
	while (regs->MODE & MCHP_QMSPI_M_SRST) {
	};

	/* Configure SPI clock and SPI slave */
	regs->MODE = SPI_24MHZ_CLK_DIVIDE << MCHP_QMSPI_M_FDIV_POS|
		     slave_index << MCHP_QMSPI_M_CS_POS | MCHP_QMSPI_M_ACTIVATE;

	LOG_DBG("QMSPI mode %x", regs->MODE);
	/* Indicate we want to use buffer #12 */
	regs->CTRL = MCHP_QMSPI_C_DESCR_EN | (12 << MCHP_QMSPI_BUF_PTR_POS);
	LOG_DBG("QMSPI CTRL %x", regs->CTRL);

	regs->DESCR[12] = MCHP_QMSPI_C_XFR_NUNITS(1) |
			 MCHP_QMSPI_C_NEXT_DESCR(13) |
			 MCHP_QMSPI_C_XFR_UNITS_1 |
			 MCHP_QMSPI_C_NO_CLOSE |
			 MCHP_QMSPI_C_TX_ONES |
			 MCHP_QMSPI_C_IFM_4X;

	regs->DESCR[13] = MCHP_QMSPI_C_XFR_NUNITS(9) |
			 MCHP_QMSPI_C_DESCR_LAST |
			 MCHP_QMSPI_C_NEXT_DESCR(12) |
			 MCHP_QMSPI_C_XFR_UNITS_1 |
			 MCHP_QMSPI_C_CLOSE |
			 MCHP_QMSPI_C_TX_DIS |
			 MCHP_QMSPI_C_IFM_4X;
	LOG_DBG("QMSPI DESCR[12] %p=%x", &regs->DESCR[12], regs->DESCR[12]);
	LOG_DBG("QMSPI DESCR[13] %p=%x", &regs->DESCR[13], regs->DESCR[13]);
	REG32(&regs->TX_FIFO) = 0xFF;
	regs->EXE = MCHP_QMSPI_EXE_START;

	while (regs->STS & MCHP_QMSPI_STS_TXBF_RO) {
	}

	LOG_DBG("Exit %s", __func__);
}

#define ENABLE_RESET_OPCODE            0x66U
#define RESET_OPCODE                   0x99U
#define FOUR_BYTE_ADDRESS_MODE_OPCODE  0xB7U

int qspi_reset_spi_flash_device(uint8_t slave_index)
{
	/* int ret; */
	uint8_t cmds[] = {
		ENABLE_RESET_OPCODE,
		RESET_OPCODE,
	};

	LOG_DBG("%s", __func__);
	/* TODO: How do we access the second device
	 * Need to check samples to control CS
	 */

#ifdef CONFIG_SPI_USING_DRIVER
	switch (slave_index) {
	case 0:
		spi_cfg.operation = spi_cfg.operation;
		break;
	case 1:
		spi_cfg.operation = spi_cfg.operation;
		break;
	default:
		return -EINVAL;
	}

	for (int i = 0; i < sizeof(cmds); i++) {
		tx.buf = &cmds[i];
		tx.len = 1;

		LOG_DBG("Sending cmd %x", cmds[i]);
		ret = spi_transceive(spi_dev, &spi_cfg, &tx_bufs, &rx_bufs);
		if (ret < 0) {
			LOG_ERR("SPI transceive error: %d", ret);
			return ret;
		}
		qspi_send(cmds[i]);
	}
#endif

	qspi_send(&cmds[0], 1);
	qspi_send(&cmds[1], 1);

	return 0;
}
```

## src/spi_flash_config.h
```c
/*
 * Copyright (c) 2020 Intel Corporation
 *
 * SPDX-License-Identifier: Apache-2.0
 */

#ifndef __SPI_FLASH_CONFIG_H__
#define __SPI_FLASH_CONFIG_H__

/* Need to move these values to MCHP HAL */
#define MCHP_QMSPI_BUF_PTR_POS  12u

int qspi_init(void);
int qspi_reset_spi_flash_device(uint8_t slave_index);

void qspi_send(uint8_t *data, uint8_t l);
void qspi_rcv(uint8_t *data, uint8_t len);

void qspi_clear_status(void);
void qspi_exit_continuous_mode(uint8_t slave_index);

#endif /* __SPI_FLASH_CONFIG_H__ */
```
