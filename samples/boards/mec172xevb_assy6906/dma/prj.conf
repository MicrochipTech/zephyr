## CMakeLists.txt
```
# SPDX-License-Identifier: Apache-2.0

cmake_minimum_required(VERSION 3.20.0)

find_package(Zephyr REQUIRED HINTS $ENV{ZEPHYR_BASE})
project(dma)

target_sources(app PRIVATE src/main.c src/crc8.c)
```

## prj.conf
```kconfig
CONFIG_DMA=y
CONFIG_I2C=y
CONFIG_HAS_MEC_HAL=y
# CONFIG_ZTEST=y
# CONFIG_TEST_USERSPACE=y
```

## boards/mec172xevb_assy6906.overlay
```dts
/*
 * Copyright (c) 2020 Intel Corporation
 *
 * SPDX-License-Identifier: Apache-2.0
 */

&dmac0 {
        status = "okay";
};
```

## src/main.c
```c
/*
 * Copyright (c) 2012-2014 Wind River Systems, Inc.
 * Copyright (c) 2022 Microchip Technology, Inc.
 *
 * SPDX-License-Identifier: Apache-2.0
 */

#include <zephyr.h>
#include <drivers/dma.h>
#include <drivers/i2c.h>
#include <sys/printk.h>
#include <soc.h>
#include <string.h>
#include "mec_crypt.h"
#include "crc8.h"

#define DMA_DEV DT_LABEL(DT_NODELABEL(dmac0))
#define I2C_DEV DT_LABEL(DT_ALIAS(i2c0))

static const struct device *dma_dev;
static const struct device *i2c_dev;
static volatile uint32_t spin_val;
static volatile int ret_val;

static volatile void *dma_cb_arg;
static volatile uint32_t dma_cb_id;
static volatile uint32_t dma_error;

static uint8_t data_buf1[1024];
static uint8_t data_buf2[1024];

void spin_on(uint32_t id, int rval);
void clean_bufs(void);
void fill_buf(uint8_t *b, size_t bsz, size_t fillsz, uint8_t fill_val, int flags);

static void dma_test_done(const struct device *dev, void *arg,
			  uint32_t id, int error_code)
{
	ARG_UNUSED(dev);

	dma_cb_arg = arg;
	dma_cb_id = id;
	dma_error = (uint32_t)error_code;

	if (error_code == 0) {
		printk("DMA transfer done\n");
	} else {
		printk("DMA transfer error: 0x%08x\n", (uint32_t)error_code);
	}
}

void main(void)
{
	int ret = 0;
	uint32_t chan_id = 0U;
	uint32_t dma_wait_count = 0U;
	struct dma_config dma_cfg = { 0 };
	struct dma_block_config dma_block_cfg = { 0 };
	struct i2c_msg imsg[4] = { 0 };

	printk("MCHP DMA driver test! %s\n", CONFIG_BOARD);

	ret = mec_crypto_init(MEC_CRYPTO_INIT_AESH | MEC_CRYPTO_INIT_AESH_SRST,
			      NULL);
	if (ret) {
		printk("ERROR: MEC crypto init error: %d\n", ret);
		spin_on(1, 0);
	}

	clean_bufs();

	dma_dev = device_get_binding(DMA_DEV);
	if (!dma_dev) {
		printk("ERROR: Get dmac0 device binding failed!");
		spin_on(2, 0);
	}

	i2c_dev = device_get_binding(I2C_DEV);
	if (!i2c_dev) {
		printk("ERROR: Get i2c0 device binding failed!");
		spin_on(2, 0);
	}

	fill_buf(data_buf1, sizeof(data_buf1), 64U, 0, BIT(0));
	fill_buf(data_buf2, sizeof(data_buf2), 64U, 0x55, 0);

	dma_cfg.channel_direction = MEMORY_TO_MEMORY;
	dma_cfg.source_data_size = 1U;
	dma_cfg.dest_data_size = 1U;
	dma_cfg.dma_callback = dma_test_done;
	dma_cfg.complete_callback_en = 1U;
	dma_cfg.error_callback_en = 1U;
	dma_cfg.block_count = 1U;
	dma_cfg.head_block = &dma_block_cfg;

	dma_block_cfg.dest_addr_adj = DMA_ADDR_ADJ_INCREMENT;
	dma_block_cfg.source_addr_adj = DMA_ADDR_ADJ_INCREMENT;
	dma_block_cfg.block_size = 64U;
	dma_block_cfg.source_address = (uint32_t)data_buf1;
	dma_block_cfg.dest_address = (uint32_t)data_buf2;

	dma_cb_arg = NULL;
	dma_cb_id = 0xA5U;
	dma_error = 0xDEADBEEFU;

	ret = dma_config(dma_dev, chan_id, &dma_cfg);
	if (ret) {
		printk("DMA API config: error %d\n", ret);
		spin_on(10, ret);
	}

	ret = dma_start(dma_dev, chan_id);
	if (ret) {
		printk("DMA API start: error %d\n", ret);
		spin_on(11, ret);
	}

	while (dma_cb_id == 0xA5U) {
		k_busy_wait(5);
		dma_wait_count++;
	}

	printk("DMA callback occurred\n");
	printk("DMA wait count = %u\n", dma_wait_count);
	printk("callback arg = %p\n", dma_cb_arg);
	printk("callback id = %u\n", dma_cb_id);
	printk("callback error code = 0x%08x\n", dma_error);

	/* I2C-DMA test */
	data_buf1[0] = 0x02u;
	data_buf1[1] = 0xa5u;
	data_buf1[2] = 0x5au;

	imsg[0].buf = data_buf1;
	imsg[0].len = 3u;
	imsg[0].flags = (I2C_MSG_WRITE | I2C_MSG_STOP);

	ret = i2c_transfer(i2c_dev, imsg, 1u, 0x26u);
	if (ret == 0) {
		printk("I2C xfr OK\n");
	} else {
		printk("I2C xfr error: %d\n", ret);
	}

	/* try breaking up same transaction into multiple write buffers.
	 * Probably will not work due to I2C NL HW state machine.
	 */
	data_buf1[0] = 0x02u;
	data_buf1[1] = 0xa5u;
	data_buf1[2] = 0x5au;

	imsg[0].buf = &data_buf1[0];
	imsg[0].len = 1u;
	imsg[0].flags = I2C_MSG_WRITE;
	imsg[1].buf = &data_buf1[1];
	imsg[1].len = 2u;
	imsg[1].flags = I2C_MSG_WRITE | I2C_MSG_STOP;

	ret = i2c_transfer(i2c_dev, imsg, 1u, 0x26u);
	if (ret == 0) {
		printk("I2C xfr 2.1 OK\n");
	} else {
		printk("I2C xfr 2.1 error: %d\n", ret);
	}

	ret = i2c_transfer(i2c_dev, &imsg[1], 1u, 0x26u);
	if (ret == 0) {
		printk("I2C xfr 2.2 OK\n");
	} else {
		printk("I2C xfr 2.2 error: %d\n", ret);
	}

	/* try again, make sequence works multiple times */
	data_buf1[0] = 0x02u;
	data_buf1[1] = 0xa5u;
	data_buf1[2] = 0x5au;

	imsg[0].buf = &data_buf1[0];
	imsg[0].len = 1u;
	imsg[0].flags = I2C_MSG_WRITE;
	imsg[1].buf = &data_buf1[1];
	imsg[1].len = 2u;
	imsg[1].flags = I2C_MSG_WRITE | I2C_MSG_STOP;

	ret = i2c_transfer(i2c_dev, imsg, 1u, 0x26u);
	if (ret == 0) {
		printk("I2C xfr 3.1 OK\n");
	} else {
		printk("I2C xfr 3.1 error: %d\n", ret);
	}

	ret = i2c_transfer(i2c_dev, &imsg[1], 1u, 0x26u);
	if (ret == 0) {
		printk("I2C xfr 3.2 OK\n");
	} else {
		printk("I2C xfr 3.2 error: %d\n", ret);
	}

	/* try one API call with two buffers */
	data_buf1[0] = 0x02u;
	data_buf1[1] = 0xa5u;
	data_buf1[2] = 0x5au;

	imsg[0].buf = &data_buf1[0];
	imsg[0].len = 1u;
	imsg[0].flags = I2C_MSG_WRITE;
	imsg[1].buf = &data_buf1[1];
	imsg[1].len = 2u;
	imsg[1].flags = I2C_MSG_WRITE | I2C_MSG_STOP;

	ret = i2c_transfer(i2c_dev, imsg, 2u, 0x26u);
	if (ret == 0) {
		printk("I2C xfr 4.1 OK\n");
	} else {
		printk("I2C xfr 4.1 error: %d\n", ret);
	}

	/* try a read from the PCA9555. Sequence is
	 * START, write-addr, cmd-byte, Rpt-START, read-addr, data0, data1, STOP
	 */
	data_buf1[0] = 0x01u; /* input port 1 */
	data_buf2[0] = 0x55u;
	data_buf2[1] = 0x55u;

	imsg[0].buf = &data_buf1[0];
	imsg[0].len = 1u;
	imsg[0].flags = I2C_MSG_WRITE;
	imsg[1].buf = &data_buf2[0];
	imsg[1].len = 2u;
	imsg[1].flags = I2C_MSG_READ | I2C_MSG_RESTART | I2C_MSG_STOP;

	ret = i2c_transfer(i2c_dev, imsg, 2u, 0x26u);
	if (ret == 0) {
		printk("I2C xfr 5.1 OK\n");
	} else {
		printk("I2C xfr 5.1 error: %d\n", ret);
	}

	/* split read into two messages */
	data_buf1[0] = 0x00u; /* input port 0 */
	data_buf2[0] = 0x55u;
	data_buf2[1] = 0x55u;

	imsg[0].buf = &data_buf1[0];
	imsg[0].len = 1u;
	imsg[0].flags = I2C_MSG_WRITE;
	imsg[1].buf = &data_buf2[0];
	imsg[1].len = 1u;
	imsg[1].flags = I2C_MSG_READ | I2C_MSG_RESTART;
	imsg[2].buf = &data_buf2[1];
	imsg[2].len = 1u;
	imsg[2].flags = I2C_MSG_READ | I2C_MSG_STOP;

	ret = i2c_transfer(i2c_dev, imsg, 3u, 0x26u);
	if (ret == 0) {
		printk("I2C xfr 6.1 OK\n");
	} else {
		printk("I2C xfr 6.1 error: %d\n", ret);
	}

	spin_on(256, 0);
}


void clean_bufs(void)
{
	memset(data_buf1, 0x55, sizeof(data_buf1));
	memset(data_buf2, 0x55, sizeof(data_buf2));
}

void fill_buf(uint8_t *b, size_t bsz, size_t fillsz, uint8_t fill_val,
	      int flags)
{
	size_t flen, n;

	if (!b || !bsz) {
		return;
	}

	flen = fillsz;
	if (flen > bsz) {
		flen = bsz;
	}

	for (n = 0; n < flen; n++) {
		if (flags & BIT(0)) {
			b[n] = n % 255U;
		} else {
			b[n] = fill_val;
		}
	}
}

void spin_on(uint32_t id, int rval)
{
	spin_val = id;
	ret_val = rval;

	while (spin_val) {
		;
	}
}
```

## src/crc8.c
```c
/*
 * Copyright (c) 2022 Microchip Technology, Inc.
 *
 * SPDX-License-Identifier: Apache-2.0
 */

/*
 * MEC172x CRC8
 * Functions and types for CRC checks.
 *
 * Generated on Mon Apr  2 17:26:27 2012,
 * by pycrc v0.7.10, http://www.tty1.net/pycrc/
 * using the configuration:
 *    Width        = 8
 *    Poly         = 0x07
 *    XorIn        = 0x00
 *    ReflectIn    = False
 *    XorOut       = 0x55
 *    ReflectOut   = False
 *    Algorithm    = table-driven
 *    Test string  = '123456789'
 *    Test CRC     = 0xA1
 */
#include "crc8.h"

/* Static table used for the table_driven implementation. */
static const crc8_t crc8_table[256] = {
	0x00, 0x07, 0x0e, 0x09, 0x1c, 0x1b, 0x12, 0x15,
	0x38, 0x3f, 0x36, 0x31, 0x24, 0x23, 0x2a, 0x2d,
	0x70, 0x77, 0x7e, 0x79, 0x6c, 0x6b, 0x62, 0x65,
	0x48, 0x4f, 0x46, 0x41, 0x54, 0x53, 0x5a, 0x5d,
	0xe0, 0xe7, 0xee, 0xe9, 0xfc, 0xfb, 0xf2, 0xf5,
	0xd8, 0xdf, 0xd6, 0xd1, 0xc4, 0xc3, 0xca, 0xcd,
	0x90, 0x97, 0x9e, 0x99, 0x8c, 0x8b, 0x82, 0x85,
	0xa8, 0xaf, 0xa6, 0xa1, 0xb4, 0xb3, 0xba, 0xbd,
	0xc7, 0xc0, 0xc9, 0xce, 0xdb, 0xdc, 0xd5, 0xd2,
	0xff, 0xf8, 0xf1, 0xf6, 0xe3, 0xe4, 0xed, 0xea,
	0xb7, 0xb0, 0xb9, 0xbe, 0xab, 0xac, 0xa5, 0xa2,
	0x8f, 0x88, 0x81, 0x86, 0x93, 0x94, 0x9d, 0x9a,
	0x27, 0x20, 0x29, 0x2e, 0x3b, 0x3c, 0x35, 0x32,
	0x1f, 0x18, 0x11, 0x16, 0x03, 0x04, 0x0d, 0x0a,
	0x57, 0x50, 0x59, 0x5e, 0x4b, 0x4c, 0x45, 0x42,
	0x6f, 0x68, 0x61, 0x66, 0x73, 0x74, 0x7d, 0x7a,
	0x89, 0x8e, 0x87, 0x80, 0x95, 0x92, 0x9b, 0x9c,
	0xb1, 0xb6, 0xbf, 0xb8, 0xad, 0xaa, 0xa3, 0xa4,
	0xf9, 0xfe, 0xf7, 0xf0, 0xe5, 0xe2, 0xeb, 0xec,
	0xc1, 0xc6, 0xcf, 0xc8, 0xdd, 0xda, 0xd3, 0xd4,
	0x69, 0x6e, 0x67, 0x60, 0x75, 0x72, 0x7b, 0x7c,
	0x51, 0x56, 0x5f, 0x58, 0x4d, 0x4a, 0x43, 0x44,
	0x19, 0x1e, 0x17, 0x10, 0x05, 0x02, 0x0b, 0x0c,
	0x21, 0x26, 0x2f, 0x28, 0x3d, 0x3a, 0x33, 0x34,
	0x4e, 0x49, 0x40, 0x47, 0x52, 0x55, 0x5c, 0x5b,
	0x76, 0x71, 0x78, 0x7f, 0x6a, 0x6d, 0x64, 0x63,
	0x3e, 0x39, 0x30, 0x37, 0x22, 0x25, 0x2c, 0x2b,
	0x06, 0x01, 0x08, 0x0f, 0x1a, 0x1d, 0x14, 0x13,
	0xae, 0xa9, 0xa0, 0xa7, 0xb2, 0xb5, 0xbc, 0xbb,
	0x96, 0x91, 0x98, 0x9f, 0x8a, 0x8d, 0x84, 0x83,
	0xde, 0xd9, 0xd0, 0xd7, 0xc2, 0xc5, 0xcc, 0xcb,
	0xe6, 0xe1, 0xe8, 0xef, 0xfa, 0xfd, 0xf4, 0xf3
};

/**
 * Update the crc value with new data.
 *
 * \param crc      The current crc value.
 * \param data     Pointer to a buffer of \a data_len bytes.
 * \param data_len Number of bytes in the \a data buffer.
 * \return         The updated crc value.
 *****************************************************************************/
crc8_t crc8_update(crc8_t crc, const unsigned char *data, size_t data_len)
{
	unsigned int tbl_idx = 0;

	if (!data) {
		return crc & 0xff;
	}

	while (data_len--) {
		tbl_idx = ((crc >> 0) ^ *data) & 0xff;
		crc = (crc8_table[tbl_idx] ^ (crc << 8)) & 0xff;

		data++;
	}
	return crc & 0xff;
}
/* end crc8.c */
```

## src/crc8.h
```c
/*
 * Copyright (c) 2022 Microchip Technology, Inc.
 *
 * SPDX-License-Identifier: Apache-2.0
 */

/**
 * \file crc8.h
 * Functions and types for CRC checks.
 *
 * Generated on Mon Apr  2 17:26:19 2012,
 * by pycrc v0.7.10, http://www.tty1.net/pycrc/
 * using the configuration:
 *    Width        = 8
 *    Poly         = 0x07
 *    XorIn        = 0x00
 *    ReflectIn    = False
 *    XorOut       = 0x55
 *    ReflectOut   = False
 *    Algorithm    = table-driven
 *****************************************************************************/
#ifndef __CRC8_H__
#define __CRC8_H__

#include <stdint.h>
#include <stddef.h>

#ifdef __cplusplus
extern "C" {
#endif

/**
 * The definition of the used algorithm.
 *****************************************************************************/
#define CRC_ALGO_TABLE_DRIVEN 1


/**
 * The type of the CRC values.
 *
 * This type must be big enough to contain at least 8 bits.
 *****************************************************************************/
typedef uint8_t crc8_t;


/**
 * Calculate the initial crc value.
 *
 * \return     The initial crc value.
 *****************************************************************************/
static inline crc8_t crc8_init(void)
{
	return 0x00;
}


/**
 * Update the crc value with new data.
 *
 * \param crc      The current crc value.
 * \param data     Pointer to a buffer of \a data_len bytes.
 * \param data_len Number of bytes in the \a data buffer.
 * \return         The updated crc value.
 *****************************************************************************/
crc8_t crc8_update(crc8_t crc, const unsigned char *data, size_t data_len);


/**
 * Calculate the final crc value.
 *
 * \param crc  The current crc value.
 * \return     The final crc value.
 *****************************************************************************/
static inline crc8_t crc8_finalize(crc8_t crc)
{
	return crc ^ 0x55;
}


#ifdef __cplusplus
}
#endif

#endif      /* __CRC8_H__ */
/* end crc8.h */
```
