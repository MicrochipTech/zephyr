## prj.conf
```kconfig
# Enable config log
CONFIG_LOG=y
CONFIG_LOG_MODE_MINIMAL=y

# eSPI
CONFIG_ESPI=y
# board sample code does not handle notifications
CONFIG_ESPI_AUTOMATIC_WARNING_ACKNOWLEDGE=n
# board sample code does not handle ACPI host communication
CONFIG_ESPI_PERIPHERAL_HOST_IO=n
# Enable SAF
CONFIG_ESPI_SAF=y
CONFIG_ESPI_SAF_XEC_V2=y
CONFIG_ESPI_SAF_RPMC=y
# SAF requires SPI
CONFIG_SPI=y
CONFIG_SPI_XEC_QMSPI_LDMA=y

# tinycrypt external library
#CONFIG_TINYCRYPT=y
#CONFIG_TINYCRYPT_SHA256=y
#CONFIG_TINYCRYPT_SHA256_HMAC=y
#CONFIG_TINYCRYPT_SHA256_HMAC_PRNG=y

CONFIG_HAS_MEC_HAL=y
CONFIG_MEC_MEC172X_MCRYPT=y
```

## mec172xevb_assy6906.overlay
```dts
/*
 * Copyright (c) 2022 Microchip Technology Inc.
 *
 * SPDX-License-Identifier: Apache-2.0
 */

/ {
	board_power: resources {
		compatible = "microchip,mec172x-board-power";
		/* MCHP_GPIO_0054 */
		rsm-gpios = <&gpio_040_076 12 GPIO_ACTIVE_HIGH>;
	};
};

&espi_saf0 {
	status = "okay";
};

&spi0 {
	status = "okay";
	clock-frequency = <4000000>;
	lines = <4>;
	chip-select = <0>;
	port-sel = <0>; /* Shared SPI */

	pinctrl-0 = <&shd_cs0_n_gpio055
		     &shd_clk_gpio056
		     &shd_io0_gpio223
		     &shd_io1_gpio224
		     &shd_io2_gpio227
		     &shd_io3_gpio016 >;
	pinctrl-names = "default";
};
```

## dts/bindings/mec172x-board-power.yaml
```yaml
# Copyright (c) 2022, Microchip Technology Inc.
# SPDX-License-Identifier: Apache-2.0

compatible: "microchip,mec172x-board-power"

description: |
    This binding provides MEC172x board gpio power rails resources to
    build and run samples/boards/espi_saf in Zephyr.
    GPIOs required before performing a eSPI host-slave handshake

properties:
   pwrg-gpios:
        type: phandle-array
        required: false
        description: |
          Board GPIO input used to detect that power rails are stable.

   rsm-gpios:
        type: phandle-array
        required: true
        description: |
          Board GPIO output used to notify eSPI master to ackwnowledge
          power has stabilized and bare minimum initialization in eSPI slave
          is complete so eSPI master can proceed with eSPI handshake.
```

## src/app_hmac.c
```c
/*
 * Copyright (c) 2022 Microchip Technology Inc.
 *
 * SPDX-License-Identifier: Apache-2.0
 */

#include <errno.h>
#include <soc.h>
#include <string.h>
#include <zephyr/kernel.h>
#include <zephyr/logging/log_ctrl.h>
#include <zephyr/logging/log.h>

LOG_MODULE_DECLARE(espi, CONFIG_ESPI_LOG_LEVEL);

#include "app_hmac.h"

#if defined(CONFIG_HAS_MEC_HAL)
/* mec172x HAL crypto */
#include <mec_crypt/mec_crypt.h>
#elif defined(CONFIG_TINYCRYPT)
#include <tinycrypt/constants.h>
#include <tinycrypt/hmac.h>
#include <tinycrypt/hmac_prng.h>
#else
#error "BUILD ERROR: No crypto library defined in project!"
#endif

static const uint8_t hmac_key4[25] = {
	0x01, 0x02, 0x03, 0x04, 0x05, 0x06, 0x07, 0x08,
	0x09, 0x0a, 0x0b, 0x0c, 0x0d, 0x0e, 0x0f, 0x10,
	0x11, 0x12, 0x13, 0x14, 0x15, 0x16, 0x17, 0x18,
	0x19
};
static const uint8_t hmac_msg4[50] = {
	0xcd, 0xcd, 0xcd, 0xcd, 0xcd, 0xcd, 0xcd, 0xcd,
	0xcd, 0xcd, 0xcd, 0xcd, 0xcd, 0xcd, 0xcd, 0xcd,
	0xcd, 0xcd, 0xcd, 0xcd, 0xcd, 0xcd, 0xcd, 0xcd,
	0xcd, 0xcd, 0xcd, 0xcd, 0xcd, 0xcd, 0xcd, 0xcd,
	0xcd, 0xcd, 0xcd, 0xcd, 0xcd, 0xcd, 0xcd, 0xcd,
	0xcd, 0xcd, 0xcd, 0xcd, 0xcd, 0xcd, 0xcd, 0xcd,
	0xcd, 0xcd
};
static const uint8_t hmac_digest4[32] = {
	0x82, 0x55, 0x8a, 0x38, 0x9a, 0x44, 0x3c, 0x0e,
	0xa4, 0xcc, 0x81, 0x98, 0x99, 0xf2, 0x08, 0x3a,
	0x85, 0xf0, 0xfa, 0xa3, 0xe5, 0x78, 0xf8, 0x07,
	0x7a, 0x2e, 0x3f, 0xf4, 0x67, 0x29, 0x66, 0x5b
};

static const uint8_t key131[] = {
	0xaa, 0xaa, 0xaa, 0xaa, 0xaa, 0xaa, 0xaa, 0xaa,
	0xaa, 0xaa, 0xaa, 0xaa, 0xaa, 0xaa, 0xaa, 0xaa,
	0xaa, 0xaa, 0xaa, 0xaa, 0xaa, 0xaa, 0xaa, 0xaa,
	0xaa, 0xaa, 0xaa, 0xaa, 0xaa, 0xaa, 0xaa, 0xaa,
	0xaa, 0xaa, 0xaa, 0xaa, 0xaa, 0xaa, 0xaa, 0xaa,
	0xaa, 0xaa, 0xaa, 0xaa, 0xaa, 0xaa, 0xaa, 0xaa,
	0xaa, 0xaa, 0xaa, 0xaa, 0xaa, 0xaa, 0xaa, 0xaa,
	0xaa, 0xaa, 0xaa, 0xaa, 0xaa, 0xaa, 0xaa, 0xaa,
	0xaa, 0xaa, 0xaa, 0xaa, 0xaa, 0xaa, 0xaa, 0xaa,
	0xaa, 0xaa, 0xaa, 0xaa, 0xaa, 0xaa, 0xaa, 0xaa,
	0xaa, 0xaa, 0xaa, 0xaa, 0xaa, 0xaa, 0xaa, 0xaa,
	0xaa, 0xaa, 0xaa, 0xaa, 0xaa, 0xaa, 0xaa, 0xaa,
	0xaa, 0xaa, 0xaa, 0xaa, 0xaa, 0xaa, 0xaa, 0xaa,
	0xaa, 0xaa, 0xaa, 0xaa, 0xaa, 0xaa, 0xaa, 0xaa,
	0xaa, 0xaa, 0xaa, 0xaa, 0xaa, 0xaa, 0xaa, 0xaa,
	0xaa, 0xaa, 0xaa, 0xaa, 0xaa, 0xaa, 0xaa, 0xaa,
	0xaa, 0xaa, 0xaa };

static const uint8_t msg54[] = {
	0x54, 0x65, 0x73, 0x74, 0x20, 0x55, 0x73, 0x69,
	0x6e, 0x67, 0x20, 0x4c, 0x61, 0x72, 0x67, 0x65,
	0x72, 0x20, 0x54, 0x68, 0x61, 0x6e, 0x20, 0x42,
	0x6c, 0x6f, 0x63, 0x6b, 0x2d, 0x53, 0x69, 0x7a,
	0x65, 0x20, 0x4b, 0x65, 0x79, 0x20, 0x2d, 0x20,
	0x48, 0x61, 0x73, 0x68, 0x20, 0x4b, 0x65, 0x79,
	0x20, 0x46, 0x69, 0x72, 0x73, 0x74 };

static const uint8_t msg54_k131_hmac_sha256[] = {
	0x60, 0xe4, 0x31, 0x59, 0x1e, 0xe0, 0xb6, 0x7f,
	0x0d, 0x8a, 0x26, 0xaa, 0xcb, 0xf5, 0xb7, 0x7f,
	0x8e, 0x0b, 0xc6, 0x21, 0x37, 0x28, 0xc5, 0x14,
	0x05, 0x46, 0x04, 0x0f, 0x0e, 0xe3, 0x7f, 0x54 };

static int hmac_test(void)
{
	uint8_t result[32] = {0};

	int ret = app_hmac_sha256_mesg(hmac_key4, sizeof(hmac_key4),
				       hmac_msg4, sizeof(hmac_msg4),
				       result, sizeof(result));
	if (ret) {
		return ret;
	}

	ret = memcmp(result, hmac_digest4, sizeof(hmac_digest4));
	if (ret) {
		return ret;
	}

	memset(result, 0, sizeof(result));
	ret = app_hmac_sha256_mesg(key131, sizeof(key131),
				   msg54, sizeof(msg54),
				   result, sizeof(result));
	if (ret) {
		return ret;
	}

	ret = memcmp(result, msg54_k131_hmac_sha256, sizeof(msg54_k131_hmac_sha256));

	return ret;
}

#ifdef CONFIG_HAS_MEC_HAL
int app_crypto_init(void)
{
	uint32_t crflags = MEC_CRYPTO_INIT_AESH | MEC_CRYPTO_INIT_AESH_SRST | MEC_CRYPTO_INIT_RNG;
	int ret = mec_crypto_init(crflags, NULL);

	if (ret) {
		LOG_ERR("MEC crypto init error %d\n", ret);
	}

	return ret;
}

int app_get_rand(uint8_t *dest, size_t destsz, size_t req_nbytes)
{
	int ret;
	uint32_t nr;

	if (destsz < req_nbytes) {
		return -EINVAL;
	}

	nr = 0;
	ret = mec_ndrng_get_bytes(dest, (uint32_t)req_nbytes, 256U, &nr);
	if (ret || (nr < req_nbytes)) {
		return -EIO;
	}

	return 0;
}

int app_hmac_sha256_mesg(const uint8_t *key, size_t keysz,
			 const uint8_t *msg, size_t msgsz,
			 uint8_t *result, size_t resultsz)
{
	return mhmac_message(MHASH_ALG_SHA256, key, keysz, msg, msgsz,
			     result, resultsz);
}

int app_hmac_test(void)
{
	return hmac_test();
}

#elif CONFIG_TINYCRYPT_SHA256_HMAC

static const char tc_hprng0_ps[] = "TC HPRNG0 PS";
/* TinyCrypt HMAC PRNG minimum seed length is 32 bytes */
static const char tc_hprng0_seed[] = "TC SEED minimum Length is 32 bytes";
static const char tc_hprng0_addin[] = "TC ADDITIONAL INPUT0";

struct tc_hmac_prng_struct tc_hprng0;

int app_crypto_init(void)
{
	int ret = tc_hmac_prng_init(&tc_hprng0, tc_hprng0_ps, sizeof(tc_hprng0_ps));

	if (ret == TC_CRYPTO_SUCCESS) {
		return 0;
	}

	return -EIO;
}

int app_get_rand(uint8_t *dest, size_t destsz, size_t req_nbytes)
{
	int ret;

	if (destsz < req_nbytes) {
		return -EINVAL;
	}

	ret = tc_hmac_prng_generate(dest, (unsigned int)req_nbytes, &tc_hprng0);
	if (ret == TC_CRYPTO_SUCCESS) {
		ret = 0;
	} else if (ret == TC_HMAC_PRNG_RESEED_REQ) {
		ret = tc_hmac_prng_reseed(&tc_hprng0, tc_hprng0_seed, sizeof(tc_hprng0_seed),
					  tc_hprng0_addin, sizeof(tc_hprng0_addin));
		if (ret == TC_CRYPTO_SUCCESS) {
			ret = tc_hmac_prng_generate(dest, (unsigned int)req_nbytes, &tc_hprng0);
			if (ret == TC_CRYPTO_SUCCESS) {
				ret = 0;
			} else {
				ret = -EIO;
			}
		} else {
			ret = -EIO;
		}
	} else {
		ret = -EIO;
	}

	return ret;
}

int app_hmac_sha256_mesg(const uint8_t *key, size_t keysz,
			 const uint8_t *msg, size_t msgsz,
			 uint8_t *result, size_t resultsz)
{
	struct tc_hmac_state_struct hctx;
	int ret = tc_hmac_set_key(&hctx, key, keysz);

	if (ret != TC_CRYPTO_SUCCESS) {
		return -EINVAL;
	}

	ret = tc_hmac_init(&hctx);
	if (ret != TC_CRYPTO_SUCCESS) {
		return -EINVAL;
	}

	ret = tc_hmac_update(&hctx, msg, msgsz);
	if (ret != TC_CRYPTO_SUCCESS) {
		return -EINVAL;
	}

	ret = tc_hmac_final(result, resultsz, &hctx);
	if (ret != TC_CRYPTO_SUCCESS) {
		return -EINVAL;
	}

	return 0;
}

int app_hmac_test(void)
{
	return hmac_test();
}

#else

int app_crypto_init(void)
{
	return -ENOSYS;
}

int app_hmac_sha256_mesg(const uint8_t *key, size_t keysz,
			 const uint8_t *msg, size_t msgsz,
			 uint8_t *result, size_t resultsz)
{
	return -ENOSYS;
}

int app_hmac_test(void)
{
	return -ENOSYS;
}
#endif
```

## src/app_hmac.h
```c
/*
 * Copyright (c) 2022 Microchip Technology Inc.
 *
 * SPDX-License-Identifier: Apache-2.0
 */

#ifndef __TEST_HMAC_H__
#define __TEST_HMAC_H__

int app_crypto_init(void);

int app_get_rand(uint8_t *dest, size_t destsz, size_t req_nbytes);

int app_hmac_sha256_mesg(const uint8_t *key, size_t keysz,
			 const uint8_t *msg, size_t msgsz,
			 uint8_t *result, size_t resultsz);

int app_hmac_test(void);

#endif /* __TEST_HMAC_H__ */
```

## src/saf_rpmc.h
```c
/*
 * Copyright (c) 2022 Microchip Technology Inc.
 *
 * SPDX-License-Identifier: Apache-2.0
 */

#ifndef __SAF_RPMC_H__
#define __SAF_RPMC_H__

#include <zephyr/drivers/espi.h>
#include <zephyr/drivers/espi_saf.h>

#define SAF_TEST_FLAG_FLASH_KNOWN	BIT(0)
#define SAF_TEST_FLAG_FLASH_HAS_RPMC	BIT(1)

#define SAF_CB_ECP_DONE 1
#define SAF_CB_BUS_MON  2

#define SAF_RPMC_OP1_CMD_SET_ROOT_KEY		0x00
#define SAF_RPMC_OP1_CMD_UPDATE_HMAC_KEY	0x01
#define SAF_RPMC_OP1_CMD_INCR_COUNTER		0x02
#define SAF_RPMC_OP1_CMD_REQUEST_COUNTER	0x03

#define SAF_RPMC_OP1_CMD_SET_ROOT_KEY_SIZE	64u
#define SAF_RPMC_OP1_CMD_UPDATE_HMAC_KEY_SIZE	40u
#define SAF_RPMC_OP1_CMD_INCR_COUNTER_SIZE	40u
#define SAF_RPMC_OP1_CMD_REQ_COUNTER_SIZE	48u

#define SAF_RPMC_OP2_CMD_READ_STS_DATA_SIZE	49u

/* RPMC flash extended status values. Complicated, refer to spec. */
#define SAF_RPMC_EXT_STATUS_PWR_ON_STATE	0x00U
#define SAF_RPMC_EXT_STATUS_PWR_ON_STATE_MSK	0xffU

#define SAF_RPMC_EXT_STATUS_OP1_SUCCESS		BIT(7)

#define SAF_RPMC_EXT_STATUS_BUSY		BIT(0)

/* Root Key overwrite error: OP1 Set Root Key
 * Monotonic counter uninitialize: OP1 Update HMAC key
 */
#define SAF_RPMC_EXT_STATUS_RK_INIT_ERROR	BIT(1)

/* Signature mis-match, counter address out of range,
 * truncated signature mis-match, bad command type,
 * or incorrect payload size.
 */
#define SAF_RPMC_EXT_STATUS_BAD_PARAM_ERROR	BIT(2)

/* HMAC key or monotonic counter unitialized */
#define SAF_RPMC_EXT_STATUS_HK_INIT_ERROR	BIT(3)

/* Counter data mis-match error */
#define SAF_RPMC_EXT_STATUS_CNTR_DATA_ERROR	BIT(4)

#define SAF_RPMC_EXT_STATUS_FATAL_ERROR		BIT(5)

/* from main.c */
extern const struct device *espi_saf_dev;
extern volatile uint32_t espi_saf_cb_sts;
extern volatile uint8_t espi_saf_cb_val;

/* initialize RPMC keys used by the application. Must be called before
 * any RPMC operations.
 */
int rpmc_init_keys(void);

int saf_rpmc_spi_check_root_key(const struct device *qspi_dev, uint8_t counter_id);

/* for all counters */
int saf_rpmc_spi_check_root_keys(const struct device *spi_dev);

struct espi_saf_cfg *get_saf_rpmc_flash_config(void);
struct espi_saf_protection *get_saf_rpmc_flash_pr(void);

int espi_saf_rpmc_test1(void);

#endif /* __SAF_RPMC_H__ */
```

## src/utils.c
```c
/*
 * Copyright (c) 2022 Microchip Technology Inc.
 *
 * SPDX-License-Identifier: Apache-2.0
 */

#include <soc.h>
#include <zephyr/kernel.h>
#include <zephyr/device.h>
#include <zephyr/logging/log_ctrl.h>
#include <zephyr/logging/log.h>
LOG_MODULE_DECLARE(espi, CONFIG_ESPI_LOG_LEVEL);

#include "utils.h"

void pr_byte_buffer(const uint8_t *buf, size_t bufsz)
{
	size_t n = 0;

	if (!buf) {
		return;
	}

	while (n < bufsz) {
		LOG_PRINTK("0x%02x, ", buf[n]);
		n++;
		if (!(n & 0x7)) {
			LOG_PRINTK("\n");
		}
	}
	LOG_PRINTK("\n");
}

void pr_espi_regs(void)
{
	struct espi_iom_regs * const iom =
		(struct espi_iom_regs *)DT_REG_ADDR(DT_NODELABEL(espi0));

	LOG_PRINTK("eSPI IOM registers\n");
	LOG_PRINTK("CAP0   @ 0x%x = 0x%x\n", (uint32_t)&iom->CAP0, iom->CAP0);
	LOG_PRINTK("CAP1   @ 0x%x = 0x%x\n", (uint32_t)&iom->CAP1, iom->CAP1);
	LOG_PRINTK("CAPPC  @ 0x%x = 0x%x\n", (uint32_t)&iom->CAPPC, iom->CAPPC);
	LOG_PRINTK("CAPVW  @ 0x%x = 0x%x\n", (uint32_t)&iom->CAPVW, iom->CAPVW);
	LOG_PRINTK("CAPOOB @ 0x%x = 0x%x\n", (uint32_t)&iom->CAPOOB, iom->CAPOOB);
	LOG_PRINTK("CAPFC  @ 0x%x = 0x%x\n", (uint32_t)&iom->CAPFC, iom->CAPFC);
	LOG_PRINTK("ERIS   @ 0x%x = 0x%x\n", (uint32_t)&iom->ERIS, iom->ERIS);
	LOG_PRINTK("ERIE   @ 0x%x = 0x%x\n", (uint32_t)&iom->ERIE, iom->ERIE);
	LOG_PRINTK("PLTSRC @ 0x%x = 0x%x\n", (uint32_t)&iom->PLTSRC, iom->PLTSRC);
	LOG_PRINTK("ACTV   @ 0x%x = 0x%x\n", (uint32_t)&iom->ACTV, iom->ACTV);
	LOG_PRINTK("SAFEBS @ 0x%x = 0x%x\n", (uint32_t)&iom->SAFEBS, iom->SAFEBS);
	LOG_PRINTK("RPMC_OP1_ODC    @ 0x%x = 0x%x\n",
		   (uint32_t)&iom->RPMC_OP1_ODC, iom->RPMC_OP1_ODC);
	LOG_PRINTK("RPMC_OP1_NC     @ 0x%x = 0x%x\n",
		   (uint32_t)&iom->RPMC_OP1_NC, iom->RPMC_OP1_NC);
	LOG_PRINTK("RPMC_OP1_NC_IMG @ 0x%x = 0x%x\n",
		   (uint32_t)&iom->RPMC_OP1_NC_IMG, iom->RPMC_OP1_NC_IMG);
}

void pr_espi_saf_regs(void)
{
	struct mchp_espi_saf * const saf =
		(struct mchp_espi_saf *)DT_REG_ADDR(DT_NODELABEL(espi_saf0));
	int i;

	LOG_PRINTK("eSPI SAF registers\n");
	LOG_PRINTK("SAF_ECP_STATUS @ 0x%x = 0x%x\n",
		   (uint32_t)&saf->SAF_ECP_STATUS, saf->SAF_ECP_STATUS);
	LOG_PRINTK("SAF_ECP_INTEN  @ 0x%x = 0x%x\n",
		   (uint32_t)&saf->SAF_ECP_INTEN, saf->SAF_ECP_INTEN);
	LOG_PRINTK("SAF_FL_CFG_SIZE_LIM @ 0x%x = 0x%x\n",
		   (uint32_t)&saf->SAF_FL_CFG_SIZE_LIM, saf->SAF_FL_CFG_SIZE_LIM);
	LOG_PRINTK("SAF_FL_CFG_THRH @ 0x%x = 0x%x\n",
		   (uint32_t)&saf->SAF_FL_CFG_THRH, saf->SAF_FL_CFG_THRH);
	LOG_PRINTK("SAF_FL_CFG_MISC @ 0x%x = 0x%x\n",
		   (uint32_t)&saf->SAF_FL_CFG_MISC, saf->SAF_FL_CFG_MISC);
	LOG_PRINTK("SAF_ESPI_MON_STATUS @ 0x%x = 0x%x\n",
		   (uint32_t)&saf->SAF_ESPI_MON_STATUS, saf->SAF_ESPI_MON_STATUS);
	LOG_PRINTK("SAF_ESPI_MON_INTEN @ 0x%x = 0x%x\n",
		   (uint32_t)&saf->SAF_ESPI_MON_INTEN, saf->SAF_ESPI_MON_INTEN);
	LOG_PRINTK("SAF_ECP_BUSY @ 0x%x = 0x%x\n",
		   (uint32_t)&saf->SAF_ECP_BUSY, saf->SAF_ECP_BUSY);
	for (i = 0; i < 2; i++) {
		LOG_PRINTK("SAF_CS_OPA[%d] @ 0x%x = 0x%x\n",
			   i, (uint32_t)&saf->SAF_CS_OP[i].OPA, saf->SAF_CS_OP[i].OPA);
		LOG_PRINTK("SAF_CS_OPB[%d] @ 0x%x = 0x%x\n",
			   i, (uint32_t)&saf->SAF_CS_OP[i].OPB, saf->SAF_CS_OP[i].OPB);
		LOG_PRINTK("SAF_CS_OPC[%d] @ 0x%x = 0x%x\n",
			   i, (uint32_t)&saf->SAF_CS_OP[i].OPC, saf->SAF_CS_OP[i].OPC);
		LOG_PRINTK("SAF_CS_OP_DESCR[%d] @ 0x%x = 0x%x\n",
			   i, (uint32_t)&saf->SAF_CS_OP[i].OP_DESCR, saf->SAF_CS_OP[i].OP_DESCR);
	}
	LOG_PRINTK("SAF_FL_CFG_GEN_DESCR @ 0x%x = 0x%x\n",
		   (uint32_t)&saf->SAF_FL_CFG_GEN_DESCR, saf->SAF_FL_CFG_GEN_DESCR);
	LOG_PRINTK("SAF_PROT_LOCK @ 0x%x = 0x%x\n",
		   (uint32_t)&saf->SAF_PROT_LOCK, saf->SAF_PROT_LOCK);
	LOG_PRINTK("SAF_PROT_DIRTY @ 0x%x = 0x%x\n",
		   (uint32_t)&saf->SAF_PROT_DIRTY, saf->SAF_PROT_DIRTY);
	for (i = 0; i < 3; i++) {
		LOG_PRINTK("SAF_TAG_MAP[%d] @ 0x%x = 0x%x\n",
			   i, (uint32_t)&saf->SAF_TAG_MAP[i], saf->SAF_TAG_MAP[i]);
	}
	for (i = 0; i < 17; i++) {
		LOG_PRINTK("SAF_PROT_RG[%d].START @ 0x%x = 0x%x\n",
			   i, (uint32_t)&saf->SAF_PROT_RG[i].START, saf->SAF_PROT_RG[i].START);
		LOG_PRINTK("SAF_PROT_RG[%d].LIMIT @ 0x%x = 0x%x\n",
			   i, (uint32_t)&saf->SAF_PROT_RG[i].LIMIT, saf->SAF_PROT_RG[i].LIMIT);
		LOG_PRINTK("SAF_PROT_RG[%d].WEBM  @ 0x%x = 0x%x\n",
			   i, (uint32_t)&saf->SAF_PROT_RG[i].WEBM, saf->SAF_PROT_RG[i].WEBM);
		LOG_PRINTK("SAF_PROT_RG[%d].RDBM  @ 0x%x = 0x%x\n",
			   i, (uint32_t)&saf->SAF_PROT_RG[i].RDBM, saf->SAF_PROT_RG[i].RDBM);
	}
	LOG_PRINTK("SAF_POLL_TMOUT @ 0x%x = 0x%x\n",
		   (uint32_t)&saf->SAF_POLL_TMOUT, saf->SAF_POLL_TMOUT);
	LOG_PRINTK("SAF_POLL_INTRVL @ 0x%x = 0x%x\n",
		   (uint32_t)&saf->SAF_POLL_INTRVL, saf->SAF_POLL_INTRVL);
	LOG_PRINTK("SAF_SUS_RSM_INTRVL @ 0x%x = 0x%x\n",
		   (uint32_t)&saf->SAF_SUS_RSM_INTRVL, saf->SAF_SUS_RSM_INTRVL);
	LOG_PRINTK("SAF_CONSEC_RD_TMOUT @ 0x%x = 0x%x\n",
		   (uint32_t)&saf->SAF_CONSEC_RD_TMOUT, saf->SAF_CONSEC_RD_TMOUT);
	LOG_PRINTK("SAF_CS0_CFG_P2M @ 0x%x = 0x%x\n",
		   (uint32_t)&saf->SAF_CS0_CFG_P2M, saf->SAF_CS0_CFG_P2M);
	LOG_PRINTK("SAF_CS1_CFG_P2M @ 0x%x = 0x%x\n",
		   (uint32_t)&saf->SAF_CS1_CFG_P2M, saf->SAF_CS1_CFG_P2M);
	LOG_PRINTK("SAF_FL_CFG_SPM @ 0x%x = 0x%x\n",
		   (uint32_t)&saf->SAF_FL_CFG_SPM, saf->SAF_FL_CFG_SPM);
	LOG_PRINTK("SAF_SUS_CHK_DLY @ 0x%x = 0x%x\n",
		   (uint32_t)&saf->SAF_SUS_CHK_DLY, saf->SAF_SUS_CHK_DLY);
	LOG_PRINTK("SAF_CS0_CM_PRF @ 0x%x = 0x%x\n",
		   (uint32_t)&saf->SAF_CS0_CM_PRF, saf->SAF_CS0_CM_PRF);
	LOG_PRINTK("SAF_CS1_CM_PRF @ 0x%x = 0x%x\n",
		   (uint32_t)&saf->SAF_CS1_CM_PRF, saf->SAF_CS1_CM_PRF);
	LOG_PRINTK("SAF_DNX_PROT_BYP @ 0x%x = 0x%x\n",
		   (uint32_t)&saf->SAF_DNX_PROT_BYP, saf->SAF_DNX_PROT_BYP);
	LOG_PRINTK("SAF_AC_RELOAD @ 0x%x = 0x%x\n",
		   (uint32_t)&saf->SAF_AC_RELOAD, saf->SAF_AC_RELOAD);
	LOG_PRINTK("SAF_PWRDN_CTRL @ 0x%x = 0x%x\n",
		   (uint32_t)&saf->SAF_PWRDN_CTRL, saf->SAF_PWRDN_CTRL);
	LOG_PRINTK("SAF_MEM_PWR_STS @ 0x%x = 0x%x\n",
		   (uint32_t)&saf->SAF_MEM_PWR_STS, saf->SAF_MEM_PWR_STS);
	LOG_PRINTK("SAF_CFG_CS0_OPD @ 0x%x = 0x%x\n",
		   (uint32_t)&saf->SAF_CFG_CS0_OPD, saf->SAF_CFG_CS0_OPD);
	LOG_PRINTK("SAF_CFG_CS1_OPD @ 0x%x = 0x%x\n",
		   (uint32_t)&saf->SAF_CFG_CS1_OPD, saf->SAF_CFG_CS1_OPD);
	LOG_PRINTK("SAF_CLKDIV_CS0 @ 0x%x = 0x%x\n",
		   (uint32_t)&saf->SAF_CLKDIV_CS0, saf->SAF_CLKDIV_CS0);
	LOG_PRINTK("SAF_CLKDIV_CS1 @ 0x%x = 0x%x\n",
		   (uint32_t)&saf->SAF_CLKDIV_CS1, saf->SAF_CLKDIV_CS1);
	LOG_PRINTK("SAF_FL_PWR_TMOUT @ 0x%x = 0x%x\n",
		   (uint32_t)&saf->SAF_FL_PWR_TMOUT, saf->SAF_FL_PWR_TMOUT);
	LOG_PRINTK("SAF_RPMC_OP2_ESPI_RES @ 0x%x = 0x%x\n",
		   (uint32_t)&saf->SAF_RPMC_OP2_ESPI_RES, saf->SAF_RPMC_OP2_ESPI_RES);
	LOG_PRINTK("SAF_RPMC_OP2_EC0_RES @ 0x%x = 0x%x\n",
		   (uint32_t)&saf->SAF_RPMC_OP2_EC0_RES, saf->SAF_RPMC_OP2_EC0_RES);
	LOG_PRINTK("SAF_RPMC_OP2_EC1_RES @ 0x%x = 0x%x\n",
		   (uint32_t)&saf->SAF_RPMC_OP2_EC1_RES, saf->SAF_RPMC_OP2_EC1_RES);
}
```

## src/utils.h
```c
/*
 * Copyright (c) 2022 Microchip Technology Inc.
 *
 * SPDX-License-Identifier: Apache-2.0
 */

#ifndef __UTILS_H__
#define __UTILS_H__

#include <stdint.h>

void pr_espi_regs(void);
void pr_espi_saf_regs(void);
void pr_byte_buffer(const uint8_t *buf, size_t bufsz);

#endif /* __UTILS_H__ */
```
