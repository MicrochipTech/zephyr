## sample.yaml
```
sample:
  name: Counter RTC Driver Sample
common:
  tags:
    - drivers
    - counter
  harness: console
  harness_config:
    type: multi_line
    ordered: true
    regex:
      - "Counter alarm sample"
      - "Set alarm in 2 sec"
      - "!!! Alarm !!!"
      - "Now: [2|3]"
  depends_on: counter
tests:
  sample.drivers.counter.alarm:
    platform_allow:
      - nucleo_f746zg
      - nrf51dk/nrf51822
      - nrf52dk/nrf52832
      - nrf52840dk/nrf52840
      - nrf54h20dk/nrf54h20/cpuapp
      - nrf54h20dk/nrf54h20/cpuflpr
      - nrf54h20dk/nrf54h20/cpuppr
      - nrf54h20dk/nrf54h20/cpurad
      - nrf54l15dk/nrf54l15/cpuapp
      - nrf54l15dk/nrf54l15/cpuflpr
      - nrf54lm20dk/nrf54lm20a/cpuapp
      - nrf9160dk/nrf9160
      - samd20_xpro
      - bl5340_dvk/nrf5340/cpuapp
      - gd32e103v_eval
      - gd32e507z_eval
      - gd32f403z_eval
      - gd32f450i_eval
      - gd32f450z_eval
      - gd32e507v_start
      - gd32f407v_start
      - gd32f450v_start
      - gd32f470i_eval
      - mec_assy6941/mec1753_qlj
      - stm32h735g_disco
      - stm32h573i_dk
      - rpi_pico
      - mr_canhubk3
      - s32z2xxdc2/s32z270/rtu0
      - s32z2xxdc2/s32z270/rtu1
      - s32z2xxdc2@D/s32z270/rtu0
      - s32z2xxdc2@D/s32z270/rtu1
      - lp_em_cc2340r5
    integration_platforms:
      - nucleo_f746zg
  sample.drivers.counter.alarm.stm32_rtc:
    # This test case is needed because when Timer Counter is available,
    # RTC Counter will never be selected in the test.
    # CONFIG_COUNTER_RTC_STM32 flag is enabled by default when RTC is enabled.
    filter: CONFIG_SOC_FAMILY_STM32 and CONFIG_COUNTER_RTC_STM32
    extra_configs:
      # Timer Counter flag needs to be disabled for RTC node to be selected
      - CONFIG_COUNTER_TIMER_STM32=n
    tags:
      - rtc
```

## prj.conf
```kconfig
CONFIG_PRINTK=y
CONFIG_COUNTER=y
CONFIG_PM=y
CONFIG_PM_DEVICE=y
CONFIG_SHELL=y
CONFIG_UART_CONSOLE_INPUT_EXPIRED=y
CONFIG_PM_POLICY_CUSTOM=y
CONFIG_CLOCK_CONTROL=y
CONFIG_PM_CPU_SHELL=y
CONFIG_PM_DEVICE_SHELL=y
```

## boards/mec15xxevb_assy6853.overlay
```dts
&timer4 {
	status = "okay";
};

&uart1 {
	wakerx-gpios = <&gpio_140_176 25 GPIO_ACTIVE_HIGH>;
	wakeup-source;
};

&pcr {
	/* 48MHz test clock output on GPIO060 via tst_clk_out pinmux.
	 * Clock is active in normal operation and suspend-to-idle (PLL ON).
	 * Clock stops only in suspend-to-ram (DEEP_SLP+SLEEP_ALL, PLL OFF).
	 * Use a scope on GPIO060 to observe deep sleep entry and exit.
	 */
	pinctrl-0 = <&tst_clk_out_gpio060>;
	pinctrl-names = "default";
	status = "okay";
};
```

## boards/mec172xevb_assy6906.overlay
```dts
&timer3 {
	status = "okay";
	prescaler = <32767>;
};

&uart1 {
	wakerx-gpios = <&gpio_140_176 25 GPIO_ACTIVE_HIGH>;
	wakeup-source;
};

&pcr {
	/* 48MHz test clock output on GPIO060 via tst_clk_out pinmux.
	 * Clock is active in normal operation and suspend-to-idle (PLL ON).
	 * Clock stops only in suspend-to-ram (DEEP_SLP+SLEEP_ALL, PLL OFF).
	 * Use a scope on GPIO060 to observe deep sleep entry and exit.
	 */
	pinctrl-0 = <&tst_clk_out_gpio060>;
	pinctrl-names = "default";
	status = "okay";
};
```

## boards/mec_assy6941_mec1753_qlj.overlay
```dts
&timer0 {
	compatible = "microchip,xec-btimer";
	prescaler = <3>; /* 12 MHz */
	status = "okay";
};

&timer1 {
	compatible = "microchip,xec-counter-btmr";
	prescaler = <3>; /* 12 MHz */
	alarm-timer = <&timer0>;
	status = "okay";
};
```

## src/main.c
```c
/*
 * Copyright (c) 2019 Linaro Limited
 *
 * SPDX-License-Identifier: Apache-2.0
 */

#include <zephyr/kernel.h>

#include <zephyr/device.h>
#include <zephyr/drivers/counter.h>
#include <zephyr/sys/printk.h>

#define DELAY 2000000
#define ALARM_CHANNEL_ID 0
#define ALARM_FLAGS 0

struct counter_alarm_cfg alarm_cfg;

#if defined(CONFIG_BOARD_SAMD20_XPRO)
#define SAMPLE_TIMER DT_NODELABEL(tc4)
#elif defined(CONFIG_SOC_FAMILY_ATMEL_SAM)
#define SAMPLE_TIMER DT_NODELABEL(tc0)
#elif defined(CONFIG_COUNTER_MICROCHIP_MCP7940N)
#define SAMPLE_TIMER DT_NODELABEL(extrtc0)
#elif defined(CONFIG_COUNTER_NRF_RTC)
#define SAMPLE_TIMER DT_NODELABEL(rtc0)
#elif defined(CONFIG_COUNTER_NRF_TIMER)
#define SAMPLE_TIMER DT_CHOSEN(counter)
#elif defined(CONFIG_COUNTER_TIMER_STM32)
#define SAMPLE_TIMER DT_INST(0, st_stm32_counter)
#elif defined(CONFIG_COUNTER_RTC_STM32)
#define SAMPLE_TIMER DT_INST(0, st_stm32_rtc)
#elif defined(CONFIG_COUNTER_SMARTBOND_TIMER)
#define SAMPLE_TIMER DT_NODELABEL(timer3)
#elif defined(CONFIG_COUNTER_NATIVE_SIM)
#define SAMPLE_TIMER DT_NODELABEL(counter0)
#elif defined(CONFIG_COUNTER_XLNX_AXI_TIMER)
#define SAMPLE_TIMER DT_INST(0, xlnx_xps_timer_1_00_a)
#elif defined(CONFIG_COUNTER_TMR_ESP32)
#define SAMPLE_TIMER DT_INST(0, espressif_esp32_counter)
#elif defined(CONFIG_COUNTER_MCUX_SYSCTR)
#define SAMPLE_TIMER DT_NODELABEL(sys_ctr)
#elif defined(CONFIG_COUNTER_MCUX_CTIMER)
#define SAMPLE_TIMER DT_NODELABEL(ctimer0)
#elif defined(CONFIG_COUNTER_MSPM0_TIMER)
#define SAMPLE_TIMER DT_ALIAS(counter)
#elif defined(CONFIG_COUNTER_NXP_S32_SYS_TIMER)
#define SAMPLE_TIMER DT_NODELABEL(stm0)
#elif defined(CONFIG_COUNTER_TIMER_GD32)
#define SAMPLE_TIMER DT_NODELABEL(timer0)
#elif defined(CONFIG_COUNTER_GECKO_RTCC)
#define SAMPLE_TIMER DT_NODELABEL(rtcc0)
#elif defined(CONFIG_COUNTER_SILABS_BURTC)
#define SAMPLE_TIMER DT_NODELABEL(burtc0)
#elif defined(CONFIG_COUNTER_GECKO_STIMER)
#define SAMPLE_TIMER DT_CHOSEN(silabs_sleeptimer)
#elif defined(CONFIG_COUNTER_INFINEON_CAT1) || defined(CONFIG_COUNTER_INFINEON_TCPWM)
#define SAMPLE_TIMER DT_NODELABEL(counter0_1)
#elif defined(CONFIG_COUNTER_AMBIQ)
#define SAMPLE_TIMER DT_NODELABEL(counter0)
#elif defined(CONFIG_COUNTER_SNPS_DW)
#define SAMPLE_TIMER DT_NODELABEL(timer0)
#elif defined(CONFIG_COUNTER_TIMER_RPI_PICO)
#ifdef CONFIG_SOC_SERIES_RP2040
#define SAMPLE_TIMER DT_NODELABEL(timer)
#elif CONFIG_SOC_SERIES_RP2350
#define SAMPLE_TIMER DT_NODELABEL(timer0)
#endif
#elif defined(CONFIG_COUNTER_TIMER_MAX32)
#define SAMPLE_TIMER DT_NODELABEL(counter0)
#elif defined(CONFIG_COUNTER_WUT_MAX32)
#define SAMPLE_TIMER DT_NODELABEL(counter_wut1)
#elif defined(CONFIG_COUNTER_RA_AGT)
#define SAMPLE_TIMER DT_NODELABEL(counter0)
#elif defined(CONFIG_COUNTER_RENESAS_RZ_GTM)
#define SAMPLE_TIMER DT_INST(0, renesas_rz_gtm_counter)
#elif defined(CONFIG_COUNTER_CC23X0_RTC)
#define SAMPLE_TIMER DT_NODELABEL(rtc0)
#elif defined(CONFIG_COUNTER_RENESAS_RZ_CMTW)
#define SAMPLE_TIMER DT_INST(0, renesas_rz_cmtw_counter)
#elif defined(CONFIG_COUNTER_MCHP_SAM_PIT64B)
#define SAMPLE_TIMER DT_NODELABEL(pit64b1)
#undef ALARM_FLAGS
#define ALARM_FLAGS COUNTER_ALARM_CFG_ABSOLUTE
#elif defined(CONFIG_COUNTER_MCHP_TC_G2)
#define SAMPLE_TIMER DT_NODELABEL(tc0_ch0)
#elif defined(CONFIG_COUNTER_MCUX_RTC_JDP)
#define SAMPLE_TIMER DT_NODELABEL(rtc)
#elif defined(CONFIG_COUNTER_MCUX_RTC)
#define SAMPLE_TIMER DT_NODELABEL(rtc)
#elif defined(CONFIG_COUNTER_RENESAS_RZA2M_OSTM)
#define SAMPLE_TIMER DT_INST(0, renesas_rza2m_ostm_counter)
#elif defined(CONFIG_SOC_FAMILY_MICROCHIP_PIC32CX_SG)
#define SAMPLE_TIMER DT_ALIAS(counter)
#elif defined(CONFIG_SOC_FAMILY_MICROCHIP_PIC32CM_JH)
#define SAMPLE_TIMER DT_ALIAS(counter)
#elif defined(CONFIG_COUNTER_ITE_IT51XXX)
#define SAMPLE_TIMER DT_NODELABEL(counter0)
#elif defined(CONFIG_SOC_SERIES_MEC15XX)
#define SAMPLE_TIMER DT_NODELABEL(timer4)
#elif defined(CONFIG_SOC_SERIES_MEC172X)
#define SAMPLE_TIMER DT_NODELABEL(timer3)
#elif defined(CONFIG_SOC_MEC1753_QSZ)
#define SAMPLE_TIMER DT_NODELABEL(timer3)
#else
#error Unable to find a counter device node in devicetree
#endif

static void test_counter_interrupt_fn(const struct device *counter_dev,
				      uint8_t chan_id, uint32_t ticks,
				      void *user_data)
{
	struct counter_alarm_cfg *config = user_data;
	uint32_t now_ticks;
	uint64_t now_usec;
	int now_sec;
	int err;

	err = counter_get_value(counter_dev, &now_ticks);
	if (!counter_is_counting_up(counter_dev)) {
		now_ticks = counter_get_top_value(counter_dev) - now_ticks;
	}

	if (err) {
		printk("Failed to read counter value (err %d)", err);
		return;
	}

	now_usec = counter_ticks_to_us(counter_dev, now_ticks);
	now_sec = (int)(now_usec / USEC_PER_SEC);

	printk("!!! Alarm !!!\n");
	printk("Now: %u\n", now_sec);

	/* Set a new alarm with a double length duration */
	config->ticks = config->ticks;// * 2U;

	printk("Set alarm in %u sec (%u ticks)\n",
	       (uint32_t)(counter_ticks_to_us(counter_dev,
					   config->ticks) / USEC_PER_SEC),
	       config->ticks);

	err = counter_set_channel_alarm(counter_dev, ALARM_CHANNEL_ID,
					user_data);
	if (err != 0) {
		printk("Alarm could not be set\n");
	}
}

int main(void)
{
	const struct device *const counter_dev = DEVICE_DT_GET(SAMPLE_TIMER);
	int err;

	printk("Counter3 alarm sample\n\n");

	if (!device_is_ready(counter_dev)) {
		printk("device not ready.\n");
		return 0;
	}

	counter_start(counter_dev);

	alarm_cfg.flags = ALARM_FLAGS;
	alarm_cfg.ticks = counter_us_to_ticks(counter_dev, DELAY*15);
	alarm_cfg.callback = test_counter_interrupt_fn;
	alarm_cfg.user_data = &alarm_cfg;

	err = counter_set_channel_alarm(counter_dev, ALARM_CHANNEL_ID,
					&alarm_cfg);

	printk("Set alarm in %u sec (%u ticks)\n",
	       (uint32_t)(counter_ticks_to_us(counter_dev,
					   alarm_cfg.ticks) / USEC_PER_SEC),
	       alarm_cfg.ticks);

	if (-EINVAL == err) {
		printk("Alarm settings invalid\n");
	} else if (-ENOTSUP == err) {
		printk("Alarm setting request not supported\n");
	} else if (err != 0) {
		printk("Error\n");
	}

	while (1) {
		k_sleep(K_FOREVER);
	}
	return 0;
}
```

## src/p_policy.c
```c
/* Copyright 2026 The ChromiumOS Authors
 * Use of this source code is governed by a BSD-style license that can be
 * found in the LICENSE file.
 */

// #include "system.h"

#include <zephyr/kernel.h>
#include <zephyr/pm/pm.h>
#include <zephyr/pm/policy.h>

static const struct pm_state_info residency_info[] =
	PM_STATE_INFO_LIST_FROM_DT_CPU(DT_NODELABEL(cpu0));

const struct pm_state_info *pm_policy_next_state(uint8_t cpu, int32_t ticks)
{
	ARG_UNUSED(cpu);

		/*
		 * Check all states shallowest-first. A lock on any state (e.g.
		 * the UART console wake lock on PM_STATE_SUSPEND_TO_IDLE) means
		 * "stay fully awake" — prevent all sleep states, not just the
		 * locked one. Without this, the deepest-first selection loop
		 * below would pick suspend-to-ram before ever seeing the
		 * suspend-to-idle lock, causing keypresses to be dropped.
		 */
		for (int i = 0; i < ARRAY_SIZE(residency_info); i++) {
			if (pm_policy_state_lock_is_active(
				    residency_info[i].state,
				    PM_ALL_SUBSTATES)) {
				return NULL;
			}
		}

		for (int i = ARRAY_SIZE(residency_info) - 1; i >= 0; i--) {
			if (ticks == K_TICKS_FOREVER ||
			    ticks >= k_us_to_ticks_ceil32(
					    residency_info[i].min_residency_us)) {
				return &residency_info[i];
			}
		}

	return NULL;
}
```
