## prj.conf
```kconfig
CONFIG_PRINTK=y
CONFIG_EEPROM=y
CONFIG_PM_DEVICE=y
```

## boards/mec172xevb_assy6906.overlay
```dts
/*
 * Copyright (c) 2023 Microchip Technology Inc.
 *
 * SPDX-License-Identifier: Apache-2.0
 */
/ {
     aliases {
             eeprom-0 = &eeprom;
     };
};
&eeprom{
status="okay";
	pinctrl-0 = <&eeprom_cs_gpio116
		      &eeprom_clk_gpio117
		      &eeprom_mosi_gpio074
		      &eeprom_miso_gpio075>;
	pinctrl-names = "default";
};

&pcr {
	status = "okay";
	pll-32k-src = <MCHP_XEC_PLL_CLK32K_SRC_SIL_OSC>;
	periph-32k-src = <MCHP_XEC_PERIPH_CLK32K_SRC_SO_SO>;

	/* debug only, not using 32KHZ_IN pin */
	pinctrl-0 = <&tst_clk_out_gpio060>;

	pinctrl-names = "default";
};
```

## boards/mec_assy6906_mech1723nsz.overlay
```dts
/*
 * Copyright (c) 2023 Microchip Technology Inc.
 *
 * SPDX-License-Identifier: Apache-2.0
 */

/* mec_assy6906 EVB with MEC1723N-SZ daughter card
 * MEC1723 has internal 2KB EEPROM and controller.
 * Internal pins are disabled to reduce leakage.
 */

/ {
	aliases {
		eeprom-0 = &eeprom;
	};
};

&eeprom {
	status = "okay";
	pinctrl-0 = < &pspi_cs_n_gpio116
		      &pspi_clk_gpio117
		      &pspi_sdi_gpio075
		      &pspi_sdo_gpio074 >;
	pinctrl-names = "default";
};
```

## boards/mec_assy6941_mec1743qlj.overlay
```dts
/*
 * Copyright (c) 2023 Microchip Technology Inc.
 *
 * SPDX-License-Identifier: Apache-2.0
 */

/* mec_assy6941 EVB with MEC1743Q-LJ daughter card
 * MEC1743 has internal 8KB EEPROM and controller.
 * Internal pins are disabled to reduce leakage.
 */

/ {
	aliases {
		eeprom-0 = &eeprom;
	};
};

&eeprom {
	status = "okay";
	pinctrl-0 = < &pspi_cs_n_gpio256
		      &pspi_clk_gpio257
		      &pspi_sdi_gpio252
		      &pspi_sdo_gpio251 >;
	pinctrl-names = "default";
};
```

## boards/mec_assy6941_mec1753qsz.overlay
```dts
/*
 * Copyright (c) 2023 Microchip Technology Inc.
 *
 * SPDX-License-Identifier: Apache-2.0
 */

/* mec_assy6941 EVB with MEC1753Q-SZ daughter card
 * MEC1753 has internal 8KB EEPROM and controller.
 * Internal pins are disabled to reduce leakage.
 */

/ {
	aliases {
		eeprom-0 = &eeprom;
	};
};

&eeprom {
	status = "okay";
	pinctrl-0 = < &pspi_cs_n_gpio256
		      &pspi_clk_gpio257
		      &pspi_sdi_gpio252
		      &pspi_sdo_gpio251 >;
	pinctrl-names = "default";
};
```

## src/main.c
```c
/*
 * Copyright (c) 2021 Thomas Stranger
 *
 * SPDX-License-Identifier: Apache-2.0
 */

#include <zephyr/kernel.h>
#include <zephyr/sys/printk.h>
#include <zephyr/drivers/eeprom.h>
#include <zephyr/device.h>

#define EEPROM_SAMPLE_OFFSET 0
#define EEPROM_SAMPLE_MAGIC  0xEE9703

struct perisistant_values {
	uint32_t magic;
	uint32_t boot_count;
};

/*
 * Get a device structure from a devicetree node with alias eeprom-0
 */
static const struct device *get_eeprom_device(void)
{
	const struct device *const dev = DEVICE_DT_GET(DT_ALIAS(eeprom_0));

	if (!device_is_ready(dev)) {
		printk("\nError: Device \"%s\" is not ready; "
		       "check the driver initialization logs for errors.\n",
		       dev->name);
		return NULL;
	}

	printk("Found EEPROM device \"%s\"\n", dev->name);
	return dev;
}

int main(void)
{
	const struct device *eeprom = get_eeprom_device();
	size_t eeprom_size;
	struct perisistant_values values;
	int rc;

	if (eeprom == NULL) {
		return 0;
	}

	eeprom_size = eeprom_get_size(eeprom);
	printk("Using eeprom with size of: %zu.\n", eeprom_size);

	rc = eeprom_read(eeprom, EEPROM_SAMPLE_OFFSET, &values, sizeof(values));
	if (rc < 0) {
		printk("Error: Couldn't read eeprom: err: %d.\n", rc);
		return 0;
	}

	if (values.magic != EEPROM_SAMPLE_MAGIC) {
		values.magic = EEPROM_SAMPLE_MAGIC;
		values.boot_count = 0;
	}

	values.boot_count++;
	printk("Device booted %d times.\n", values.boot_count);

	rc = eeprom_write(eeprom, EEPROM_SAMPLE_OFFSET, &values, sizeof(values));
	if (rc < 0) {
		printk("Error: Couldn't write eeprom: err:%d.\n", rc);
		return 0;
	}

	printk("Reset the MCU to see the increasing boot counter.\n\n");
	while(1)
	{
		for(rc=0;rc<255;rc++)
			printk("Reset the MCU to see the increasing boot counter.\n\n");
k_sleep(K_MSEC(3000));	

	}
	return 0;
}
```
